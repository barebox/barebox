// SPDX-License-Identifier: GPL-2.0-only

#include "imx6q-skov-imx6.dts"
#include "imx6qdl-qemu.dtsi"

/* Without "skov,imx6", whose board code reads the variant from GPIOs */
/ {
	compatible = "skov,imx6q-skov-reve-mi1010ait-1cp1", "fsl,imx6q";
};

/* QEMU doesn't emulate the IPU, but its driver probes and sets the clocks */
&ipu1 {
	status = "okay";
};

&ldb {
	status = "okay";
};

&lvds0 {
	status = "okay";
};

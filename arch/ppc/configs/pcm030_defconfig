## arch/ppc/configs/pcm030_defconfig
```kconfig
CONFIG_TEXT_BASE=0x3e00000
CONFIG_MALLOC_SIZE=0x1000000
CONFIG_HUSH_FANCY_PROMPT=y
CONFIG_CMDLINE_EDITING=y
CONFIG_AUTO_COMPLETE=y
CONFIG_BOOTM_SHOW_TYPE=y
CONFIG_PARTITION=y
CONFIG_DEFAULT_ENVIRONMENT_GENERIC_NEW=y
CONFIG_DEFAULT_ENVIRONMENT_PATH="arch/ppc/boards/pcm030/env"
CONFIG_LONGHELP=y
CONFIG_CMD_IOMEM=y
CONFIG_CMD_MEMINFO=y
CONFIG_CMD_REGINFO=y
CONFIG_CMD_GO=y
CONFIG_CMD_RESET=y
CONFIG_CMD_UIMAGE=y
CONFIG_CMD_PARTITION=y
CONFIG_CMD_EXPORT=y
CONFIG_CMD_LOADENV=y
CONFIG_CMD_MAGICVAR=y
CONFIG_CMD_MAGICVAR_HELP=y
CONFIG_CMD_SAVEENV=y
CONFIG_CMD_UNCOMPRESS=y
CONFIG_CMD_SLEEP=y
CONFIG_CMD_DHCP=y
CONFIG_CMD_PING=y
CONFIG_CMD_TFTP=y
CONFIG_CMD_ECHO_E=y
CONFIG_CMD_EDIT=y
CONFIG_CMD_READLINE=y
CONFIG_CMD_TIMEOUT=y
CONFIG_CMD_CRC=y
CONFIG_CMD_CRC_CMP=y
CONFIG_CMD_FLASH=y
CONFIG_CMD_OFTREE=y
CONFIG_CMD_TIME=y
CONFIG_NET=y
CONFIG_DRIVER_NET_MPC5200=y
CONFIG_I2C=y
CONFIG_I2C_IMX=y
CONFIG_MTD=y
CONFIG_DRIVER_CFI=y
CONFIG_CFI_BUFFER_WRITE=y
CONFIG_EEPROM_AT24=y
CONFIG_FS_TFTP=y
CONFIG_ZLIB=y
```

## arch/ppc/mach-mpc5xxx/Kconfig
```kconfig
if ARCH_MPC5XXX

config ARCH_TEXT_BASE
	hex
	default 0x00000000 if RELOCATABLE
	default 0x01000000 if MACH_PHYCORE_MPC5200B_TINY

config HAS_REGINFO
	bool
	default y if ARCH_MPC5200

choice
	prompt "Select your board"

config MACH_PHYCORE_MPC5200B_TINY
	bool "Phycore mpc5200b tiny"
	help
	  Say Y here if you are using the Phytec Phycore MPC5200B Tiny
	  board aka pcm030.
endchoice

config MPC5200
	bool
	depends on MACH_PHYCORE_MPC5200B_TINY
	default y

config ARCH_MPC5200
	bool
	depends on MACH_PHYCORE_MPC5200B_TINY
	default y

config MPC5xxx
	bool
	depends on MACH_PHYCORE_MPC5200B_TINY
	default y

menu "Board specific settings"

config MACH_PHYCORE_MPC5200B_TINY_REV
	int "Board Revision"
	default 1
	depends on MACH_PHYCORE_MPC5200B_TINY
	help
	  Revision 0 and revision 1 of the tiny board have
	  incompatible flash settings. Unless you have a very
	  old board you should set this option to 1

endmenu

endif
```

## arch/ppc/mach-mpc85xx/Kconfig
```kconfig
if ARCH_MPC85XX

config MMU
	default y

config BTB
	bool
	default y

config TEXT_BASE
	hex
	default 0xeff80000 if P1010RDB || P2020RDB || P1022DS
	default 0xfff80000 if DA923RC

config RESET_VECTOR_ADDRESS
	hex
	default 0xfffffffc if DA923RC
	default 0xeffffffc if P1010RDB || P2020RDB || P1022DS

config MPC85xx
	bool
	default y

config BOOKE
	bool
	default y

config E500
	bool
	default y

choice
	prompt "Select your board"
config P1010RDB
	bool "P1010RDB"
    select P1010
    select DDR_SPD
    select FSL_DDR3
	help
	  Say Y here if you are using the Freescale P1010RDB

config P2020RDB
	bool "P2020RDB"
    select P2020
    select FSL_ELBC
	help
	  Say Y here if you are using the Freescale P2020RDB

config P1022DS
	bool "P1022DS"
    select P1022
    select DDR_SPD
    select FSL_DDR3
    select FSL_ELBC
	help
	  Say Y here if you are using the Freescale P1022DS

config DA923RC
	bool "DA923RC"
    select MPC8544
    select DDR_SPD
    select FSL_DDR2
	help
	Say Y here if you are using the GE Intelligent Platforms DA923RC
endchoice
endif

config P1010
    select FSL_IFC
    select FSL_ERRATUM_IFC_A002769
    select FSL_ERRATUM_P1010_A003549
    select FSL_ERRATUM_IFC_A003399
	bool

config P2020
	bool

config P1022
	bool

config MPC8544
	bool

config FSL_DDR2
	bool

config FSL_DDR3
	bool

config FSL_IFC
	bool

config FSL_ELBC
	bool

config FSL_ERRATUM_IFC_A002769
    bool

config FSL_ERRATUM_IFC_A003399
    bool

config FSL_ERRATUM_P1010_A003549
    bool
```

## arch/riscv/Kconfig
```kconfig
# SPDX-License-Identifier: GPL-2.0-only

config RISCV
	def_bool y
	select GENERIC_FIND_NEXT_BIT
	select GPIOLIB
	select OFTREE
	select OFDEVICE
	select COMMON_CLK
	select COMMON_CLK_OF_PROVIDER
	select CLKDEV_LOOKUP
	select HAS_DMA
	select ARCH_DMA_DEFAULT_COHERENT
	select HAVE_PBL_IMAGE
	select HAVE_PBL_MULTI_IMAGES
	select HAVE_IMAGE_COMPRESSION
	select ARCH_HAS_SJLJ
	select HAS_KALLSYMS
	select RISCV_TIMER if RISCV_SBI
	select HW_HAS_PCI

config ARCH_TEXT_BASE
	hex
	default 0x0

choice
	prompt "Base ISA"
	default ARCH_RV32I

config ARCH_RV32I
	bool "RV32I"
	select CPU_SUPPORTS_32BIT_KERNEL
	select GENERIC_LIB_ASHLDI3
	select GENERIC_LIB_ASHRDI3
	select GENERIC_LIB_LSHRDI3
	select 32BIT

config ARCH_RV64I
	bool "RV64I"
	select CPU_SUPPORTS_64BIT_KERNEL
	select 64BIT

endchoice

source "arch/riscv/Kconfig.socs"

config CPU_SUPPORTS_32BIT_KERNEL
	bool

config CPU_SUPPORTS_64BIT_KERNEL
	bool

config PHYS_ADDR_T_64BIT
	bool

config 32BIT
	bool
	depends on CPU_SUPPORTS_32BIT_KERNEL

config 64BIT
	bool
	depends on CPU_SUPPORTS_64BIT_KERNEL
	select ARCH_DMA_ADDR_T_64BIT
	select PHYS_ADDR_T_64BIT

config BOARD_RISCV_GENERIC_DT
	select BOARD_GENERIC_DT
	bool "Build generic RISC-V device tree 2nd stage image"
	help
	  This enables compilation of a generic image that can be started 2nd
	  stage from barebox or from qemu. It picks up a device tree passed
	  in a1 like the Kernel does, so it could be used anywhere where a Kernel
	  image could be used. The image will be called images/barebox-dt-2nd.img

menu "RISC-V specific settings"

config RISCV_OPTIMZED_STRING_FUNCTIONS
	bool "use assembler optimized string functions"
	help
	  Say yes here to use assembler optimized memcpy / memset functions.
	  These functions work faster than the normal versions but increase
	  your binary size.

config RISCV_EXCEPTIONS
	bool "enable exception handling support"
	default y
	select ARCH_HAS_DATA_ABORT_MASK

config RISCV_UNWIND
	bool "enable stack unwinding support"
	select ARCH_HAS_STACK_DUMP
	select ARCH_WANT_FRAME_POINTERS
	help
	  This option enables stack unwinding support in barebox
	  using the information automatically generated by the
	  compiler. The resulting kernel image is slightly bigger but
	  the performance is not affected.

config HAS_NMON
	bool

config NMON
	bool "nmon"
	depends on HAS_NMON
	depends on DEBUG_LL
	help
	  Say yes here to add the nmon to pbl.
	  nmon -- nano-monitor program for the RISC-V processors.
	  It can operate with NO working RAM, using only
	  the processor registers.

config NMON_HELP
	bool "nmon help message"
	depends on NMON
	help
	  Say yes here to get the nmon commands message on
	  every nmon start.

# selected by boards where barebox runs in machine mode
config RISCV_M_MODE
	bool

# selected by boards where barebox runs in supervisor mode
config RISCV_S_MODE
	bool

config RISCV_MULTI_MODE
	def_bool RISCV_S_MODE && RISCV_M_MODE

config RISCV_SBI
	def_bool RISCV_S_MODE

endmenu
```

## arch/riscv/Kconfig.socs
```kconfig
# SPDX-License-Identifier: GPL-2.0-only

menu "SoC selection"

config SOC_ERIZO
	bool "Erizo SoC"
	depends on ARCH_RV32I
	select HAS_DEBUG_LL
	select HAS_NMON
	select USE_COMPRESSED_DTB
	select RISCV_M_MODE
	select RISCV_TIMER

config BOARD_ERIZO_GENERIC
	depends on SOC_ERIZO
	def_bool y

config SOC_VIRT
	bool "QEMU Virt Machine"
	select RISCV_S_MODE
	select BOARD_RISCV_GENERIC_DT
	select HAS_CACHE
	select HAS_DEBUG_LL
	help
	  Generates an image tht can be be booted by QEMU. The image is called
	  barebox-dt-2nd.img

config BOARD_RISCV_VIRT
	depends on SOC_VIRT
	bool "QEMU Virt Machine"
	select OF_OVERLAY
	select BOARD_QEMU_VIRT
	default y
	help
	  Enables environment and state on top of QEMU RISC-V Virt machine
	  cfi-flash.

config BOARD_RISCVEMU
	depends on SOC_VIRT
	bool "TinyEMU Virt Machine (riscvemu)"
	select OF_OVERLAY
	default y
	help
	  TinyEMU's Virt machine differs from QEMU in poweroff and restart
	  mechanisms. This adds the necessary support.

config CPU_SIFIVE
	bool
	select HAS_CACHE

config SOC_SIFIVE
	bool "SiFive SoCs"
	select CPU_SIFIVE
	select RISCV_S_MODE
	select CLK_SIFIVE
	select CLK_SIFIVE_PRCI
	select RISCV_TIMER
	select HAS_MACB
	select HAS_DEBUG_LL
	help
	  This enables support for SiFive SoC platform hardware.

if SOC_SIFIVE

config BOARD_HIFIVE
	bool "HiFive"
	depends on ARCH_RV64I
	select USE_COMPRESSED_DTB

endif

config SOC_STARFIVE
	bool "StarFive SoCs"
	select ARCH_HAS_RESET_CONTROLLER
	select RISCV_S_MODE
	select HAS_DEBUG_LL
	select HAS_NMON
	help
	  This enables support for SiFive SoC platform hardware.

if SOC_STARFIVE

config SOC_STARFIVE_JH71XX
	bool
	select CPU_SIFIVE

config SOC_STARFIVE_JH7100
	bool
	select SOC_STARFIVE_JH71XX
	select SIFIVE_L2
	select OF_DMA_COHERENCY
	help
	  Unlike JH7110 and later, CPU on the JH7100 are not cache-coherent
	  with respect to DMA masters like GMAC and DW MMC controller.
	  Select this if barebox needs to do DMA on this SoC.

config BOARD_BEAGLEV
	bool "BeagleV"
	depends on ARCH_RV64I
	select SOC_STARFIVE_JH71XX
	select USE_COMPRESSED_DTB

config BOARD_BEAGLEV_BETA
	bool "BeagleV Beta (with JH7100)"
	depends on BOARD_BEAGLEV
	select SOC_STARFIVE_JH7100
	help
	  Select this for hardware using the earlier JH7100 SoC. The JH7110
	  used with later production runs is cache-coherent and thus can do
	  without the special DMA handling enabled by this option. It's safe
	  to enable this option for other SoCs.

endif

config SOC_ALLWINNER_SUN20I
	bool "Allwinner Sun20i SoCs"
	depends on ARCH_RV64I
	select HAS_DEBUG_LL
	select HAS_CACHE

if SOC_ALLWINNER_SUN20I

config BOARD_ALLWINNER_D1
	bool "Allwinner D1 Nezha"
	select RISCV_S_MODE
	select RISCV_M_MODE
	def_bool y

endif

comment "CPU features"

config SIFIVE_L2
	bool "SiFive L2 cache controller"
	depends on CPU_SIFIVE

config SOC_LITEX
	bool "LiteX SoCs"
	depends on ARCH_RV32I
	select HAS_DEBUG_LL
	select HAS_NMON
	select USE_COMPRESSED_DTB
	select RISCV_TIMER

config BOARD_LITEX_LINUX
	bool "litex linux board"
	depends on SOC_LITEX
	select RISCV_M_MODE
	def_bool y

endmenu
```

## arch/riscv/configs/erizo_generic_defconfig
```kconfig
# CONFIG_GLOBALVAR is not set
CONFIG_TEXT_BASE=0x80000000
CONFIG_MEMORY_LAYOUT_FIXED=y
CONFIG_STACK_BASE=0x800e0000
CONFIG_STACK_SIZE=0x20000
CONFIG_MALLOC_BASE=0x80100000
CONFIG_MALLOC_SIZE=0x100000
CONFIG_MALLOC_TLSF=y
CONFIG_PANIC_HANG=y
CONFIG_HUSH_FANCY_PROMPT=y
CONFIG_CMDLINE_EDITING=y
CONFIG_AUTO_COMPLETE=y
# CONFIG_ERRNO_MESSAGES is not set
# CONFIG_TIMESTAMP is not set
# CONFIG_BOOTM is not set
# CONFIG_ENV_HANDLING is not set
CONFIG_POLLER=y
CONFIG_DEBUG_LL=y
CONFIG_LONGHELP=y
CONFIG_CMD_IOMEM=y
CONFIG_CMD_IMD=y
CONFIG_CMD_MEMINFO=y
CONFIG_CMD_GO=y
CONFIG_CMD_LOADY=y
CONFIG_CMD_CMP=y
CONFIG_CMD_MD5SUM=y
CONFIG_CMD_SHA1SUM=y
CONFIG_CMD_MSLEEP=y
CONFIG_CMD_SLEEP=y
CONFIG_CMD_MEMTEST=y
CONFIG_CMD_MM=y
CONFIG_CMD_FLASH=y
CONFIG_CMD_GPIO=y
CONFIG_CMD_I2C=y
CONFIG_CMD_SPI=y
CONFIG_CMD_OF_DUMP=y
CONFIG_CMD_TIME=y
CONFIG_CMD_DHRYSTONE=y
CONFIG_OFDEVICE=y
CONFIG_DRIVER_SERIAL_NS16550=y
CONFIG_DRIVER_SPI_GPIO=y
CONFIG_I2C=y
CONFIG_I2C_GPIO=y
CONFIG_MTD=y
# CONFIG_MTD_OOB_DEVICE is not set
CONFIG_MTD_M25P80=y
CONFIG_CLOCKSOURCE_DUMMY_RATE=60000
CONFIG_EEPROM_AT24=y
CONFIG_GPIO_GENERIC_PLATFORM=y
# CONFIG_PINCTRL is not set
CONFIG_DIGEST_CRC32_GENERIC=y
```

## arch/riscv/configs/litex_linux_defconfig
```kconfig
CONFIG_SOC_LITEX=y
CONFIG_STACK_SIZE=0x20000
CONFIG_MALLOC_SIZE=0xf00000
CONFIG_MALLOC_TLSF=y
CONFIG_PANIC_HANG=y
CONFIG_BAUDRATE=1000000
CONFIG_HUSH_FANCY_PROMPT=y
CONFIG_CMDLINE_EDITING=y
CONFIG_AUTO_COMPLETE=y
# CONFIG_TIMESTAMP is not set
CONFIG_BOOTM_SHOW_TYPE=y
CONFIG_BOOTM_VERBOSE=y
CONFIG_BOOTM_INITRD=y
CONFIG_BOOTM_OFTREE=y
CONFIG_BOOTM_OFTREE_UIMAGE=y
CONFIG_DEFAULT_ENVIRONMENT_GENERIC_NEW=y
CONFIG_DEBUG_LL=y
CONFIG_LONGHELP=y
CONFIG_CMD_IOMEM=y
CONFIG_CMD_IMD=y
CONFIG_CMD_MEMINFO=y
CONFIG_CMD_GO=y
CONFIG_CMD_LOADY=y
CONFIG_CMD_EXPORT=y
CONFIG_CMD_CMP=y
CONFIG_CMD_MD5SUM=y
CONFIG_CMD_SHA1SUM=y
CONFIG_CMD_MSLEEP=y
CONFIG_CMD_SLEEP=y
CONFIG_CMD_DHCP=y
CONFIG_CMD_MIITOOL=y
CONFIG_CMD_PING=y
CONFIG_CMD_TFTP=y
CONFIG_CMD_ECHO_E=y
CONFIG_CMD_EDIT=y
CONFIG_CMD_MEMTEST=y
CONFIG_CMD_MM=y
CONFIG_CMD_CLK=y
CONFIG_CMD_GPIO=y
CONFIG_CMD_LED=y
CONFIG_CMD_SPI=y
CONFIG_CMD_LED_TRIGGER=y
CONFIG_CMD_OF_DUMP=y
CONFIG_CMD_TIME=y
CONFIG_CMD_DHRYSTONE=y
CONFIG_NET=y
CONFIG_NET_NETCONSOLE=y
CONFIG_DRIVER_NET_LITEETH=y
CONFIG_AR8327N_PHY=y
CONFIG_AT803X_PHY=y
CONFIG_DAVICOM_PHY=y
CONFIG_DP83867_PHY=y
CONFIG_LXT_PHY=y
CONFIG_MARVELL_PHY=y
CONFIG_MICREL_PHY=y
CONFIG_NATIONAL_PHY=y
CONFIG_REALTEK_PHY=y
CONFIG_SMSC_PHY=y
CONFIG_DRIVER_SPI_LITEX_SPIFLASH=y
CONFIG_MTD=y
# CONFIG_MTD_OOB_DEVICE is not set
CONFIG_MTD_M25P80=y
CONFIG_CLOCKSOURCE_DUMMY_RATE=20000
CONFIG_SRAM=y
CONFIG_LED=y
CONFIG_LED_GPIO=y
CONFIG_LED_GPIO_OF=y
CONFIG_LED_TRIGGERS=y
CONFIG_GPIO_74XX_MMIO=y
CONFIG_GPIO_GENERIC_PLATFORM=y
# CONFIG_PINCTRL is not set
CONFIG_FS_TFTP=y
CONFIG_FS_NFS=y
CONFIG_DIGEST_CRC32_GENERIC=y
```

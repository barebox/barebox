/*
 * Include file to switch board DTS form using hardcoded memory node
 * to dynamic memory size detection based on DDR controller settings
 */

/ {

	/delete-node/ memory@40000000;
};

&ddrc {
	status = "okay";
};


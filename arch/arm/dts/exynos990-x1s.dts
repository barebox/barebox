// SPDX-License-Identifier: GPL-2.0 OR BSD-3-Clause
/*
 * Samsung Galaxy S20 5G (x1s/SM-G981B) barebox device tree source
 *
 * Copyright (c) 2025, Ivaylo Ivanov <ivo.ivanov.ivanov1@gmail.com>
 */

/dts-v1/;
#include <arm64/exynos/exynos990-x1s.dts>

/ {
	barebox,deep-probe;
};

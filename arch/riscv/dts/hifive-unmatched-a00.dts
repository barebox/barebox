/* SPDX-License-Identifier: GPL-2.0 OR X11 */

#include <riscv/sifive/hifive-unmatched-a00.dts>

/ {
	barebox,disable-deep-probe;
};

/* probing on QEMU v5.2.0 triggers load access fault @0x10040014 */
&qspi0 { status = "disabled"; };
&qspi1 { status = "disabled"; };
&spi0  { status = "disabled"; };

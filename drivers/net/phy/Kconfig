## drivers/pci/Kconfig
```kconfig
# SPDX-License-Identifier: GPL-2.0-only
config HW_HAS_PCI
	bool

if HW_HAS_PCI

menu "PCI bus options"

config PCI
	bool "Support for PCI controller"
	depends on HW_HAS_PCI
	help
	  Find out whether you have a PCI motherboard. PCI is the name of a
	  bus system, i.e. the way the CPU talks to the other stuff inside
	  your box. If you have PCI, say Y, otherwise N.


config PCI_DEBUG
	bool "PCI Debugging"
	depends on PCI
	help
	  Say Y here if you want the PCI core to produce a bunch of debug
	  messages to the system log.  Select this if you are having a
	  problem with PCI support and want to see more of what is going on.

	  When in doubt, say N.

config PCI_DYNAMIC_OF_NODES
	bool "Create devicetree nodes for runtime-enumerated PCI devices"
	depends on PCI && OFDEVICE
	help
	  Synthesize a devicetree node for every PCI device discovered during
	  bus scan that does not already have one in the static devicetree.
	  Nodes are attached to the live tree under the host-bridge / parent
	  bridge node, so they are visible to barebox itself and flow into the
	  devicetree passed to the kernel at boot.

	  This lets consumers (e.g. of_eth_register_ethaddr() for stamping a
	  MAC address) reference PCI endpoints by node path without
	  hand-writing the pci@D,F / dev@D,F hierarchy in the source DTS.

	  Only the bare minimum is generated: a node with a "reg" property
	  encoding the device/function so Linux's of_pci_find_child_device()
	  can attach the node to the device it rediscovers from hardware.
	  Linux recomputes everything else (compatible from VID/DID, bus-range
	  and ranges from config space, etc.) so adding it here would just be
	  duplicated state with no consumer.

	  When in doubt, say N.

config PCIE_DW
	bool

config PCI_MVEBU
	bool "Marvell EBU PCIe driver"
	depends on ARCH_MVEBU
	select OF_PCI
	select PCI

config PCI_TEGRA
	bool "NVDIA Tegra PCIe driver"
	depends on ARCH_TEGRA
	select OF_ADDRESS_PCI
	select OF_PCI
	select PCI

config PCI_IMX6
	bool "Freescale i.MX6/7/8 PCIe controller"
	depends on ARCH_IMX6 || ARCH_IMX7 || ARCH_IMX8MQ
	select PCIE_DW
	select OF_PCI
	select PCI

config PCI_LAYERSCAPE
	bool "Freescale Layerscape PCIe controller"
	depends on ARCH_LAYERSCAPE || COMPILE_TEST
	select PCIE_DW
	select OF_PCI
	select PCI

config PCI_ROCKCHIP
	bool "Rockchip PCIe controller"
	depends on ARCH_ROCKCHIP
	select PCIE_DW
	select OF_PCI
	select PCI

config PCI_EFI
	bool "EFI PCI protocol"
	depends on EFI_PAYLOAD
	select PCI

config PCI_ECAM_GENERIC
	tristate "Generic ECAM-based PCI host controller support"
	select OF_PCI
	select PCI
	help
	  Say Y here if you want to enable support for generic ECAM-based
	  PCI host controllers, such as the one emulated by QEMU.

endmenu

endif
```

## drivers/phy/Kconfig
```kconfig
# SPDX-License-Identifier: GPL-2.0-only
#
# PHY
#

menuconfig GENERIC_PHY
	bool "PHY Core"
	help
	  Generic PHY support.

	  This framework is designed to provide a generic interface for PHY
	  devices present in the kernel. This layer will have the generic
	  API by which phy drivers can create PHY using the phy framework and
	  phy users can obtain reference to the PHY. All the users of this
	  framework should select this config.

if GENERIC_PHY

config USB_NOP_XCEIV
	bool "Generic USB nop phy"
	help
	  This driver is to be used by all the usb transceiver which are either
	  built-in with usb ip or which are autonomous and doesn't require any
	  phy programming such as ISP1x04 etc.

source "drivers/phy/freescale/Kconfig"
source "drivers/phy/rockchip/Kconfig"

config PHY_STM32_USBPHYC
	tristate "STM32 USB HS PHY Controller"
	depends on ARCH_STM32MP || COMPILE_TEST
	depends on COMMON_CLK
	help
	  Enable this to support the High-Speed USB transceivers that are part
	  of some STMicroelectronics STM32 SoCs.

	  This driver controls the entire USB PHY block: the USB PHY controller
	  (USBPHYC) and the two 8-bit wide UTMI+ interfaces. First interface is
	  used by an HS USB Host controller, and the second one is shared
	  between an HS USB OTG controller and an HS USB Host controller,
	  selected by a USB switch.

endif
```

## drivers/phy/freescale/Kconfig
```kconfig
# SPDX-License-Identifier: GPL-2.0-only

config PHY_FSL_IMX8MQ_USB
	bool "Freescale i.MX8MQ/P USB3 PHY"
	default ARCH_IMX8MQ || ARCH_IMX8MP
	help
	  Enable this to add support for the USB PHY found on
	  the i.MX8M Quad and Plus.
```

## drivers/phy/rockchip/Kconfig
```kconfig
# SPDX-License-Identifier: GPL-2.0-only
config PHY_ROCKCHIP_INNO_USB2
	bool "Rockchip INNO USB2PHY Driver"
	depends on (ARCH_ROCKCHIP || COMPILE_TEST) && OFDEVICE
	depends on COMMON_CLK
	help
	  Support for Rockchip USB2.0 PHY with Innosilicon IP block.

config PHY_ROCKCHIP_NANENG_COMBO_PHY
	bool "Rockchip NANENG COMBO PHY Driver"
	depends on ARCH_ROCKCHIP && OFDEVICE
	help
	  Enable this to support the Rockchip PCIe/USB3.0/SATA/QSGMII
	  combo PHY with NaNeng IP block.

config PHY_ROCKCHIP_SNPS_PCIE3
	bool "Rockchip Snps PCIe3 PHY Driver"
	depends on ARCH_ROCKCHIP || COMPILE_TEST
	help
	  Enable this to support the Rockchip snps PCIe3 PHY.

config PHY_ROCKCHIP_USBDP
	bool "Rockchip USBDP COMBO PHY Driver"
	depends on ARCH_ROCKCHIP
	select TYPEC
	help
	  Enable this to support the Rockchip USB3.0/DP combo PHY with
	  Samsung IP block. This is required for USB3 support on RK3588.
```

## drivers/pinctrl/Kconfig
```kconfig
menu "Pin controllers"

config PINCTRL
	bool "Pin controller core support"
	default y if OFDEVICE
	help
	  Pincontrollers allow to setup the iomux unit of SoCs. The pin
	  controller core is needed when pin muxing shall be configured
	  from the devicetree. Legacy drivers here may not need this core
	  support but instead provide their own SoC specific APIs

# The following drivers are needed even without PINCTRL because
# the either have a legacy iomux interface or also register a gpio
# chip.
config PINCTRL_AT91
	bool
	help
	    The pinmux controller found on AT91 SoCs.

config PINCTRL_AT91PIO4
        bool "AT91 PIO4 pinctrl driver"
        depends on OFDEVICE
        depends on ARCH_AT91
        select GPIOLIB
        select OF_GPIO
        help
          Say Y here to enable the at91 pinctrl/gpio driver for Atmel PIO4
          controller available on sama5d2 SoC.

config PINCTRL_BCM283X
	bool "GPIO and pinmux support for BCM283X"
	depends on ARCH_BCM283X
	help
	    The pinmux controller on BCM2835

config PINCTRL_IMX_IOMUX_V1
	bool
	help
	  This iomux controller is found on i.MX1,21,27.

config PINCTRL_IMX_IOMUX_V2
	bool
	help
	  This iomux controller is found on i.MX31.

config PINCTRL_IMX_IOMUX_V3
	bool
	help
	  This iomux controller is found on i.MX25,35,51,53,6.

if PINCTRL

if !OFDEVICE
comment "OFDEVICE is not enabled."
comment "Without device tree support PINCTRL won't do anything"
endif

config PINCTRL_MXS
	bool "MXS pinctrl"
	depends on ARCH_MXS
	default ARCH_MXS
	help
	  This pinmux controller is found on i.MX23,28

config PINCTRL_ROCKCHIP
	select GPIO_GENERIC
	select MFD_SYSCON
	bool
	help
	  The pinmux controller found on Rockchip SoCs.

config PINCTRL_SINGLE
	bool "pinctrl single"

config PINCTRL_TEGRA20
	bool
	default y if ARCH_TEGRA_2x_SOC
	help
	  The pinmux controller found on the Tegra 20 line of SoCs.

config PINCTRL_TEGRA30
	bool
	default y if ARCH_TEGRA_3x_SOC
	default y if ARCH_TEGRA_124_SOC
	help
	  The pinmux controller found on the Tegra 30+ line of SoCs.

config PINCTRL_TEGRA_XUSB
	bool
	default y if ARCH_TEGRA_124_SOC
	select GENERIC_PHY
	help
	  The pinmux controller found on the Tegra 124 line of SoCs used for
	  the SerDes lanes.

source "drivers/pinctrl/mvebu/Kconfig"

config PINCTRL_VF610
	bool
	default y if ARCH_VF610
	help
	  Pinmux controller found on Vybrid VF610 family of SoCs

config PINCTRL_STM32
	bool
	default y if ARCH_STM32MP
	help
	  Pinmux and GPIO controller found on STM32 family
endif

endmenu
```

## drivers/pinctrl/mvebu/Kconfig
```kconfig
config PINCTRL_ARMADA_370
	default y if ARCH_ARMADA_370
	bool

config PINCTRL_ARMADA_XP
	bool
	default y if ARCH_ARMADA_XP

config PINCTRL_DOVE
	bool
	default y if ARCH_DOVE

config PINCTRL_KIRKWOOD
	bool
	default y if ARCH_KIRKWOOD
```

## drivers/pinctrl/sunxi/Kconfig
```kconfig
# SPDX-License-Identifier: GPL-2.0-only
if ARCH_SUNXI

config PINCTRL_SUNXI
	bool
	select GPIOLIB

config PINCTRL_SUN50I_A64
	bool "Support for Allwinner A64 PIO"
	default ARCH_SUNXI
	select PINCTRL_SUNXI

endif
```

## drivers/pmdomain/Kconfig
```kconfig
# SPDX-License-Identifier: GPL-2.0-only
menu "PM Domains"

source "drivers/pmdomain/imx/Kconfig"
source "drivers/pmdomain/ti/Kconfig"

endmenu
```

## drivers/pmdomain/imx/Kconfig
```kconfig
# SPDX-License-Identifier: GPL-2.0-only
menu "i.MX PM Domains"

config IMX_GPCV2_PM_DOMAINS
	bool "i.MX GPCv2 PM domains"
	depends on ARCH_IMX7 || ARCH_IMX8M || ARCH_IMX93 || COMPILE_TEST
	select PM_GENERIC_DOMAINS
	default y if ARCH_IMX7 || ARCH_IMX8M || ARCH_IMX93

config IMX8M_BLK_CTRL
	bool "i.MX8MP HSIO blk-ctrl" if COMPILE_TEST
	default ARCH_IMX8MP && IMX_GPCV2_PM_DOMAINS
	depends on PM_GENERIC_DOMAINS
	depends on COMMON_CLK

config IMX93_BLK_CTRL
	bool "i.MX93 MEDIA blk-ctrl" if COMPILE_TEST
	default ARCH_IMX93 && IMX_GPCV2_PM_DOMAINS
	depends on PM_GENERIC_DOMAINS
	depends on COMMON_CLK

endmenu
```

## drivers/pmdomain/rockchip/Kconfig
```kconfig
# SPDX-License-Identifier: GPL-2.0-only
if ARCH_ROCKCHIP || COMPILE_TEST

config ROCKCHIP_PM_DOMAINS
	bool "Rockchip generic power domain"
	depends on REGULATOR
	select PM_GENERIC_DOMAINS
	help
	  Say y here to enable power domain support.
	  The PMU is dedicated for managing the power of the whole chip and may
	  be needed, so peripherals that barebox is using are powered.

endif
```

## drivers/pmdomain/ti/Kconfig
```kconfig
# SPDX-License-Identifier: GPL-2.0-only
config TI_SCI_PM_DOMAINS
	bool "TI SCI PM Domains Driver"
	depends on TI_SCI_PROTOCOL
	depends on PM_GENERIC_DOMAINS
	help
	  Generic power domain implementation for TI device implementing
	  the TI SCI protocol.

config TI_K3_PM_DOMAINS
	bool "TI K3 PM Domains Driver"
	depends on MACH_K3_CORTEX_R5 || COMPILE_TEST
```

## drivers/power/reset/Kconfig
```kconfig
# SPDX-License-Identifier: GPL-2.0-only
#

config REBOOT_MODE
	bool

config SYSCON_REBOOT_MODE
	bool "Generic SYSCON regmap reboot mode driver"
	depends on OFDEVICE
	depends on MFD_SYSCON
	select REBOOT_MODE
	help
	  Say y here will enable reboot mode driver. This will
	  get reboot mode arguments and store it in SYSCON mapped
	  register, then the bootloader can read it to take different

config NVMEM_REBOOT_MODE
	bool "Generic NVMEM reboot mode driver"
	depends on OFDEVICE
	depends on NVMEM
	select REBOOT_MODE
	help
	  Say y here will enable reboot mode driver. This will
	  get reboot mode arguments and store it in a NVMEM cell,
	  then the bootloader can read it and take different
	  action according to the mode.

config POWER_RESET_SYSCON
	bool "Generic SYSCON regmap reset driver"
	depends on OFDEVICE
	select MFD_SYSCON
	help
	  Reboot support for generic SYSCON mapped register reset.

config POWER_RESET_SYSCON_POWEROFF
	bool "Generic SYSCON regmap poweroff driver"
	depends on OFDEVICE
	select MFD_SYSCON
	help
	  Poweroff support for generic SYSCON mapped register poweroff.

config POWER_RESET_GPIO
	bool "GPIO power-off driver"
	depends on OF_GPIO
	help
	  This driver supports turning off your board via a GPIO line.
	  If your board needs a GPIO high/low to power down, say Y and
	  create a binding in your devicetree.

config POWER_RESET_GPIO_RESTART
	bool "GPIO restart driver"
	depends on OF_GPIO
	help
	  This driver supports restarting your board via a GPIO line.
	  If your board needs a GPIO high/low to restart, say Y and
	  create a binding in your devicetree.

config POWER_RESET_HTIF_POWEROFF
	bool "HTIF poweroff driver"
	depends on RISCV
	help
	  Adds poweroff support via the syscall device on systems
	  supporting the UC Berkely Host/Target Interface (HTIF).
```

## drivers/pwm/Kconfig
```kconfig
# SPDX-License-Identifier: GPL-2.0-only
menuconfig PWM
	bool "PWM Support"
	help
	  This enables PWM support through the generic PWM framework.
	  You only need to enable this, if you also want to enable
	  one or more of the PWM drivers below.

	  If unsure, say N.

if PWM
config PWM_PXA
	bool "PXA PWM Support"
	default y if ARCH_PXA2XX
	depends on ARCH_PXA2XX
	help
	  This enables PWM support for Intel/Marvell PXA chips, such
	  as the PXA25x, PXA27x.

config PWM_ATMEL
	bool "Atmel PWM Support"
	depends on ARCH_AT91
	help
	  This enables PWM support for Ateml AT91 SoCs

config PWM_IMX
	bool "i.MX PWM Support"
	depends on ARCH_IMX || COMPILE_TEST
	help
	  This enables PWM support for Freescale i.MX SoCs

config PWM_MXS
	bool "i.MXs PWM Support"
	depends on ARCH_MXS
	select STMP_DEVICE
	help
	  This enables PWM support for Freescale i.MX23/i.MX28 SoCs

config PWM_STM32
	bool "STM32 PWM Support"
	depends on ARCH_STM32 || COMPILE_TEST
	help
	  This enables PWM support for STM32 MCUs and MPUs.

config PWM_ROCKCHIP
	tristate "Rockchip PWM support"
	depends on ARCH_ROCKCHIP || COMPILE_TEST
	help
	  Generic PWM framework driver for the PWM controller found on
	  Rockchip SoCs.

endif
```

## drivers/regulator/Kconfig
```kconfig
# SPDX-License-Identifier: GPL-2.0-only
menuconfig REGULATOR
	bool "voltage regulator support"

if REGULATOR

config REGULATOR_FIXED
	bool "fixed/gpio regulator"
	depends on GENERIC_GPIO
	depends on OFDEVICE
	help
	  This enables a simple fixed regulator. It is used for regulators
	  which are not software controllable or controllable via gpio.

config REGULATOR_BCM283X
	bool
	depends on ARCH_BCM283X
	default y

config REGULATOR_PFUZE
	bool "Freescale PFUZE100/200/3000 regulator driver"
	depends on I2C
	depends on ARCH_IMX || COMPILE_TEST

config REGULATOR_STM32_PWR
	bool "STMicroelectronics STM32 PWR"
	depends on ARCH_STM32MP
	help
	  This driver supports internal regulators (1V1, 1V8, 3V3) in the
	  STMicroelectronics STM32 chips.

config REGULATOR_STM32_VREFBUF
	tristate "STMicroelectronics STM32 VREFBUF"
	depends on ARCH_STM32 || COMPILE_TEST
	help
	  This driver supports STMicroelectronics STM32 VREFBUF (voltage
	  reference buffer) which can be used as voltage reference for
	  internal ADCs, DACs and also for external components through
	  dedicated Vref+ pin.

config REGULATOR_STPMIC1
	tristate "STMicroelectronics STPMIC1 PMIC Regulators"
	depends on MFD_STPMIC1
	help
	  This driver supports STMicroelectronics STPMIC1 PMIC voltage
	  regulators and switches. The STPMIC1 regulators supply power to
	  an application processor as well as to external system
	  peripherals such as DDR, Flash memories and system devices.

config REGULATOR_ANATOP
	tristate "Freescale i.MX on-chip ANATOP LDO regulators"
	depends on MFD_SYSCON
	help
	  Say y here to support Freescale i.MX on-chip ANATOP LDOs
	  regulators. It is recommended that this option be
	  enabled on i.MX6 platform.


config REGULATOR_ARM_SCMI
	tristate "SCMI based regulator driver"
	depends on ARM_SCMI_PROTOCOL && OFDEVICE
	help
	  This adds the regulator driver support for ARM platforms using SCMI
	  protocol for device voltage management.
	  This driver uses SCMI Message Protocol driver to interact with the
	  firmware providing the device Voltage functionality.

config REGULATOR_RK808
	tristate "Rockchip RK805/RK808/RK809/RK817/RK818 Power regulators"
	depends on MFD_RK808
	help
	  Select this option to enable the power regulator of ROCKCHIP
	  PMIC RK805,RK809&RK817,RK808 and RK818.
	  This driver supports the control of different power rails of device
	  through regulator interface. The device supports multiple DCDC/LDO
	  outputs which can be controlled by i2c communication.

endif
```

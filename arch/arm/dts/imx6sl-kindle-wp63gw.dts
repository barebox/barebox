// SPDX-License-Identifier: GPL-2.0-or-later
/*
 * Copyright (C) 2025 Alexander Kurz <akurz@blala.de>
 */

/dts-v1/;
#include "imx6sl-kindle-common.dtsi"
#include <dt-bindings/interrupt-controller/irq.h>
#include <dt-bindings/gpio/gpio.h>
#include <dt-bindings/input/input.h>

/ {
	model = "kindle-wp63gw";
	compatible = "amazon,imx6sl-kindle-wp63gw",  "fsl,imx6sl";
	barebox,deep-probe;
};

&iomuxc {
	pinctrl-names = "default";
	pinctrl-0 = <&pinctrl_hog>;

	imx6sl-kindle-wp63gw {
		pinctrl_hog: hoggrp {
			fsl,pins = <
				/* Hall sensor */
				MX6SL_PAD_KEY_ROW7__GPIO4_IO07	0x17059
				/* zForce touch */
				MX6SL_PAD_I2C2_SCL__GPIO3_IO14	0x17059
				MX6SL_PAD_I2C2_SDA__GPIO3_IO15	0x17059
				MX6SL_PAD_KEY_ROW5__GPIO4_IO03	0x17059
				MX6SL_PAD_KEY_ROW6__GPIO4_IO05	0x17059
				/* EMMC_3v2_EN, EMMC_1v8_EN */
				MX6SL_PAD_FEC_RXD0__GPIO4_IO17	0x17059
				MX6SL_PAD_FEC_MDC__GPIO4_IO23	0x17059
				/* WLAN pwd */
				MX6SL_PAD_KEY_ROW2__GPIO3_IO29	0x17059
			>;
		};
	};
};

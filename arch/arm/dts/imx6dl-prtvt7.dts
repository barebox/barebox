// SPDX-License-Identifier: GPL-2.0-or-later
/dts-v1/;

#include <arm/nxp/imx/imx6dl-prtvt7.dts>
#include "imx6qdl-prti6q-emmc.dtsi"

/ {
	barebox,deep-probe;
};

&state_emmc {
	magic = <0x72766467>;
	#address-cells = <1>;
	#size-cells = <1>;

	brand@1b0 {
		reg = <0x1b0 0x4>;
		type = "enum32";
		names = "unbranded", "agco", "vermeer";
		default = <0>;
	};
};

/*
 * Copyright 2013 Freescale Semiconductor, Inc.
 *
 * This program is free software; you can redistribute it and/or modify
 * it under the terms of the GNU General Public License as published by
 * the Free Software Foundation; either version 2 of the License, or
 * (at your option) any later version.
 */

#include <arm/vf610-twr.dts>
#include "vf610-ddrmc.dtsi"

&usbdev0 {
	status = "disabled";
};

&enet_ext {
	clock-output-names = "enet_ext";
};

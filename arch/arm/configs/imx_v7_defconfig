## arch/arm/configs/omap3530_beagle_xload_defconfig
```kconfig
CONFIG_ARCH_OMAP=y
# CONFIG_OMAP3_COPY_CLOCK_SRAM is not set
CONFIG_OMAP_BUILD_IFT=y
CONFIG_MACH_BEAGLE=y
CONFIG_AEABI=y
# CONFIG_CMD_ARM_CPUINFO is not set
# CONFIG_ARM_EXCEPTIONS is not set
CONFIG_TEXT_BASE=0x40200000
CONFIG_MEMORY_LAYOUT_FIXED=y
CONFIG_STACK_BASE=0x87BF7F10
CONFIG_MALLOC_BASE=0x87BFFF10
CONFIG_MALLOC_DUMMY=y
CONFIG_PROMPT="X-load Beagle>"
CONFIG_SHELL_NONE=y
# CONFIG_ERRNO_MESSAGES is not set
# CONFIG_TIMESTAMP is not set
# CONFIG_CONSOLE_FULL is not set
# CONFIG_DEFAULT_ENVIRONMENT is not set
CONFIG_DRIVER_SERIAL_NS16550=y
CONFIG_DRIVER_SERIAL_NS16550_OMAP_EXTENSIONS=y
# CONFIG_SPI is not set
CONFIG_MTD=y
CONFIG_NAND=y
# CONFIG_NAND_WRITE is not set
# CONFIG_NAND_ECC_SOFT is not set
# CONFIG_NAND_ECC_HW_SYNDROME is not set
# CONFIG_NAND_ECC_HW_NONE is not set
# CONFIG_NAND_INFO is not set
# CONFIG_NAND_BBT is not set
# CONFIG_NAND_READ_OOB is not set
CONFIG_NAND_OMAP_GPMC=y
CONFIG_MCI=y
CONFIG_MCI_STARTUP=y
# CONFIG_MCI_WRITE is not set
CONFIG_MCI_OMAP_HSMMC=y
# CONFIG_FS_RAMFS is not set
# CONFIG_FS_DEVFS is not set
CONFIG_FS_FAT=y
```

## arch/arm/configs/omap3_evm_defconfig
```kconfig
CONFIG_ARCH_OMAP=y
CONFIG_MACH_OMAP3EVM=y
CONFIG_AEABI=y
CONFIG_TEXT_BASE=0x40200000
CONFIG_PROMPT="OMAP3_EVM> "
CONFIG_SHELL_SIMPLE=y
# CONFIG_ERRNO_MESSAGES is not set
# CONFIG_TIMESTAMP is not set
# CONFIG_DEFAULT_ENVIRONMENT is not set
CONFIG_LONGHELP=y
CONFIG_CMD_MEMINFO=y
# CONFIG_CMD_BOOTM is not set
CONFIG_CMD_GO=y
CONFIG_CMD_LOADB=y
CONFIG_CMD_RESET=y
# CONFIG_CMD_MOUNT is not set
# CONFIG_CMD_UMOUNT is not set
# CONFIG_CMD_CAT is not set
# CONFIG_CMD_CP is not set
# CONFIG_CMD_MKDIR is not set
# CONFIG_CMD_RM is not set
# CONFIG_CMD_RMDIR is not set
CONFIG_DRIVER_SERIAL_NS16550=y
CONFIG_DRIVER_SERIAL_NS16550_OMAP_EXTENSIONS=y
# CONFIG_SPI is not set
```

## arch/arm/configs/panda_xload_defconfig
```kconfig
CONFIG_ARCH_OMAP=y
# CONFIG_OMAP_GPMC is not set
CONFIG_OMAP_BUILD_IFT=y
CONFIG_MACH_PANDA=y
CONFIG_THUMB2_BAREBOX=y
CONFIG_MMU=y
CONFIG_TEXT_BASE=0x40300000
CONFIG_MALLOC_SIZE=0x2000000
CONFIG_PROMPT="barebox> "
CONFIG_SHELL_NONE=y
# CONFIG_ERRNO_MESSAGES is not set
# CONFIG_TIMESTAMP is not set
CONFIG_CONSOLE_SIMPLE=y
CONFIG_DRIVER_SERIAL_NS16550=y
CONFIG_DRIVER_SERIAL_NS16550_OMAP_EXTENSIONS=y
# CONFIG_SPI is not set
CONFIG_MCI=y
CONFIG_MCI_STARTUP=y
CONFIG_MCI_OMAP_HSMMC=y
# CONFIG_FS_RAMFS is not set
# CONFIG_FS_DEVFS is not set
CONFIG_FS_FAT=y
```

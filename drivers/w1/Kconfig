## firmware/Kconfig
```kconfig
# SPDX-License-Identifier: GPL-2.0-only

menu "Firmware files"

config EXTRA_FIRMWARE_DIR
	string "Firmware blobs root directory"
	default "firmware"

config MISSING_FIRMWARE_ERROR
	bool "Fail the build when required firmware is missing"
	default y
	# This prevents firmware errors from breaking allyesconfig builds
	depends on !COMPILE_TEST
	help
	  In-tree Defconfigs that enable multiple boards with different firmware
	  binary requirements would say y here, so you don't need unrelated firmware
	  for the build to succeed.

	  Defconfigs custom-tailored to products would say n here as all boards
	  being built should be functional and have their firmware available.

	  If in doubt, say Y and refer to the documentation on where to acquire the
	  needed firmware.

config FIRMWARE_IMX_LPDDR4_PMU_TRAIN
	bool

config FIRMWARE_IMX_DDR4_PMU_TRAIN
	bool

config FIRMWARE_IMX8MM_ATF
	bool

config FIRMWARE_IMX8MN_ATF
	bool

config FIRMWARE_IMX8MP_ATF
	bool

config FIRMWARE_IMX8MQ_ATF
	bool

config FIRMWARE_IMX93_ATF
	bool

config FIRMWARE_AGILEX5_ATF
	bool

config FIRMWARE_IMX8MM_OPTEE
	bool "install OP-TEE on i.MX8MM boards"
	depends on FIRMWARE_IMX8MM_ATF && PBL_OPTEE
	help
	  This enables OP-TEE loading and starting on i.MX8MM. Place the OP-TEE binary
	  in CONFIG_EXTRA_FIRMWARE_DIR/imx8mm-bl32.bin. When this option is enabled then
	  the TF-A binary will be used from CONFIG_EXTRA_FIRMWARE_DIR/imx8mm-bl31.bin-optee.

config FIRMWARE_IMX8MN_OPTEE
	bool "install OP-TEE on i.MX8MN boards"
	depends on FIRMWARE_IMX8MN_ATF && PBL_OPTEE
	help
	  This enables OP-TEE loading and starting on i.MX8MN. Place the OP-TEE binary
	  in CONFIG_EXTRA_FIRMWARE_DIR/imx8mn-bl32.bin. When this option is enabled then
	  the TF-A binary will be used from CONFIG_EXTRA_FIRMWARE_DIR/imx8mn-bl31.bin-optee.

config FIRMWARE_IMX8MP_OPTEE
	bool "install OP-TEE on i.MX8MP boards"
	depends on FIRMWARE_IMX8MP_ATF && PBL_OPTEE
	help
	  This enables OP-TEE loading and starting on i.MX8MP. Place the OP-TEE binary
	  in CONFIG_EXTRA_FIRMWARE_DIR/imx8mp-bl32.bin. When this option is enabled then
	  the TF-A binary will be used from CONFIG_EXTRA_FIRMWARE_DIR/imx8mp-bl31.bin-optee.

config FIRMWARE_IMX8MQ_OPTEE
	bool "install OP-TEE on i.MX8MQ boards"
	depends on FIRMWARE_IMX8MQ_ATF && PBL_OPTEE
	help
	  This enables OP-TEE loading and starting on i.MX8MQ. Place the OP-TEE binary
	  in CONFIG_EXTRA_FIRMWARE_DIR/imx8mq-bl32.bin. When this option is enabled then
	  the TF-A binary will be used from CONFIG_EXTRA_FIRMWARE_DIR/imx8mq-bl31.bin-optee.

config FIRMWARE_IMX93_OPTEE
	bool "install OP-TEE on i.MX93 boards"
	depends on FIRMWARE_IMX93_ATF && PBL_OPTEE
	help
	  This enables OP-TEE loading and starting on i.MX93. Place the OP-TEE binary
	  in CONFIG_EXTRA_FIRMWARE_DIR/imx93-bl32.bin. When this option is enabled then
	  the TF-A binary will be used from CONFIG_EXTRA_FIRMWARE_DIR/imx93-bl31.bin-optee.
	  Additionally OP-TEE requires a RAM firmware loaded into the ELE. This is expected
	  in CONFIG_EXTRA_FIRMWARE_DIR/mx93a1-ahab-container.img. You can obtain it from
	  https://www.nxp.com/lgfiles/NMG/MAD/YOCTO/firmware-ele-imx-0.1.1.bin

config FIRMWARE_IMX93_OPTEE_A0
	bool "install OP-TEE on i.MX93 older A0 revision boards"
	depends on FIRMWARE_IMX93_OPTEE
	help
	  Additionally OP-TEE requires a RAM firmware loaded into the ELE. This is expected
	  in CONFIG_EXTRA_FIRMWARE_DIR/mx93a0-ahab-container.img. You can obtain it from
	  https://www.nxp.com/lgfiles/NMG/MAD/YOCTO/firmware-ele-imx-0.1.0.bin

config FIRMWARE_TQMA6UL_OPTEE
	bool
	depends on MACH_TQMA6UL && PBL_OPTEE
	default y

config FIRMWARE_CCBV2_OPTEE
	bool
	depends on MACH_WEBASTO_CCBV2 && PBL_OPTEE
	default y

config FIRMWARE_LS1028A_ATF
	bool

config FIRMWARE_LS1046A_ATF
	bool

config FIRMWARE_K3_AM62L_OPTEE
	bool "install OP-TEE on K3 AM62L boards"
	depends on MACH_AM62LX

config HAVE_FIRMWARE_VERIFY_NEXT_IMAGE
	bool

config FIRMWARE_VERIFY_NEXT_IMAGE
	depends on HAVE_FIRMWARE_VERIFY_NEXT_IMAGE
	bool "verify next image to load"
	help
	  The boot process of some SoCs uses multiple stages where the first stage is
	  a stripped down barebox loaded by the SoC's ROM and the next state is a full
	  barebox loaded by the first stage. In a trusted boot scenario the next stage
	  has to be verified by the first stage,

	  This option allows to specify the next image to be loaded. Put the next stage
	  image to firmware/next-image.bin. The next-image.bin won't be added to the
	  barebox binary, but a sha256 hash of the image will be generated and compiled
	  into the first stage which can be used to verify the next stage.

	  Note that this option only enabled generation of the sha256 hash. Loading and
	  starting the next stage is highly SoC dependent and it's the SoC code's
	  responsibility to actually verify the hash and to only start successfully
	  verified images. The function to check the next stage image hash is
	  firmware_next_image_verify(), make sure your SoC code uses it.

endmenu
```

## fs/9p/Kconfig
```kconfig
# SPDX-License-Identifier: GPL-2.0-only
config 9P_FS
	tristate "Plan 9 Resource Sharing Support (9P2000)"
	depends on NET_9P
	help
	  If you say Y here, you will get experimental support for
	  Plan 9 resource sharing via the 9P2000 protocol.

	  See <http://v9fs.sf.net> for more information.

	  If unsure, say N.

config 9P_FS_WRITE
	tristate "9P2000 Write Support"
	depends on 9P_FS
	select FS_WRITABLE
	help
	  Enable support for writing in 9P filesystems.
```

## fs/Kconfig
```kconfig
menu "Filesystem support"

config FS
	bool
	default y
	select FILETYPE

config FS_AUTOMOUNT
	bool

config FS_CRAMFS
	bool
	select ZLIB
	prompt "cramfs support"

source fs/ext4/Kconfig

config FS_RAMFS
	bool
	default y
	prompt "ramfs support"

config FS_DEVFS
	bool
	default y
	prompt "devfs support"

config FS_TFTP
	bool
	prompt "tftp support"
	depends on NET

config FS_OMAP4_USBBOOT
	bool
	prompt "Filesystem over usb boot"
	depends on OMAP4_USBBOOT

config FS_NFS
	depends on NET
	bool
	prompt "nfs support"

config FS_EFI
	depends on EFI_BOOTUP
	bool
	prompt "EFI filesystem support"
	help
	  This filesystem driver provides access to the filesystems provided
	  by the EFI Firmware via the EFI Simple File System Protocol.

config FS_EFIVARFS
	depends on EFI_BOOTUP
	bool
	prompt "EFI variable filesystem support (efivarfs)"
	help
	  This filesystem driver provides access to EFI variables.

source fs/fat/Kconfig
source fs/ubifs/Kconfig

config FS_BPKFS
	bool
	select CRC32
	prompt "BPKFS support"
	help
	  Simple update file format developed for Somfy, tools and library are
	  available under LGPLv2 (https://www.gitorious.org/libbpk).
	  This format in the v1.0 allow you to store 6 types a binary stream for
	  a unique hardware id:
	   - bootloader
	   - bootloader_version
	   - description.gz
	   - kernel
	   - rootfs
	   - firmware_version

config FS_UIMAGEFS
	bool
	select CRC32
	prompt "uImage FS support"

config FS_SMHFS
	depends on ARM_SEMIHOSTING
	bool
	prompt "Semihosting FS support"
	help
	  If enabled this filesystem provides access to the files
	  located on a debugging host connected to the target running
	  Barebox

source fs/pstore/Kconfig
source fs/squashfs/Kconfig

config FS_RATP
	bool
	depends on RATP
	prompt "RATP filesystem support"
	help
	  This enables support for transferring files over RATP. A host can
	  export a directory which can then be mounted under barebox.

endmenu
```

## fs/ext4/Kconfig
```kconfig
# SPDX-License-Identifier: GPL-2.0-only

config FS_EXT4
	bool
	prompt "ext4 filesystem support"
```

## fs/fat/Kconfig
```kconfig
# SPDX-License-Identifier: GPL-2.0-only

menuconfig FS_FAT
	bool
	select FS_LEGACY
	prompt "FAT filesystem support"

if FS_FAT

config FS_FAT_WRITE
	bool
	prompt "FAT write support"
	help
	  Enable support for writing in FAT partitions.
	  Note: This doesn't apply to FAT usage in barebox PBL.


config FS_FAT_LFN
	def_bool y
	prompt "Support long filenames"
	help
	  Enable support for file names other than 8.3.
	  Note: This doesn't apply to FAT usage in barebox PBL.

endif
```

## fs/jffs2/Kconfig
```kconfig
# SPDX-License-Identifier: GPL-2.0-only

menuconfig FS_JFFS2
	bool
	select CRC32
	depends on MTD
	prompt "jffs2 support"

if FS_JFFS2

config FS_JFFS2_FS_DEBUG
	int "JFFS2 debugging verbosity (0 = quiet, 2 = noisy)"
	default "0"

config FS_JFFS2_COMPRESSION_OPTIONS
	bool "Advanced compression options for JFFS2"
	depends on FS_JFFS2
	help
	  Enabling this option allows you to explicitly choose which
	  compression modules, if any, are enabled in JFFS2. Removing
	  compressors can mean you cannot read existing file systems,
	  and enabling experimental compressors can mean that you
	  write a file system which cannot be read by the bootloader.

	  If unsure, you should _definitely_ say 'N'.

if FS_JFFS2_COMPRESSION_OPTIONS

config FS_JFFS2_COMPRESSION_ZLIB
	bool
	select ZLIB
	prompt "ZLIB compression support"
	help
	  Enable zlib, if compression type 0x06 is missed at run-time.

config FS_JFFS2_COMPRESSION_LZO
	bool
	select LZO_DECOMPRESS
	prompt "LZO compression support"

config FS_JFFS2_COMPRESSION_RTIME
	bool
	prompt "RTIME compression support"

config FS_JFFS2_COMPRESSION_RUBIN
	bool
	prompt "Rubin compression support"

endif

endif
```

## fs/squashfs/Kconfig
```kconfig
menuconfig FS_SQUASHFS
	bool
	prompt "squashfs support"
	help
	  Saying Y here includes support for SquashFS 4.0 (a Compressed
	  Read-Only File System).  Squashfs is a highly compressed read-only
	  filesystem for Linux.  It uses zlib, lzo or xz compression to
	  compress both files, inodes and directories.  Inodes in the system
	  are very small and all blocks are packed to minimise data overhead.
	  Block sizes greater than 4K are supported up to a maximum of 1 Mbytes
	  (default block size 128K).  SquashFS 4.0 supports 64 bit filesystems
	  and files (larger than 4GB), full uid/gid information, hard links and
	  timestamps.

	  Squashfs is intended for general read-only filesystem use, for
	  archival use (i.e. in cases where a .tar.gz file may be used), and in
	  embedded systems where low overhead is needed.  Further information
	  and tools are available from http://squashfs.sourceforge.net.

config SQUASHFS_ZLIB
	bool
	depends on FS_SQUASHFS
	depends on ZLIB
	default y

if !SQUASHFS_ZLIB
	comment "ZLIB support disabled"
endif

config SQUASHFS_LZ4
	bool
	depends on FS_SQUASHFS
	depends on LZ4_DECOMPRESS
	default y

if !SQUASHFS_LZ4
	comment "LZ4 support disabled"
endif

config SQUASHFS_LZO
	bool
	depends on FS_SQUASHFS
	depends on LZO_DECOMPRESS
	default y

if !SQUASHFS_LZO
	comment "LZO support disabled"
endif

config SQUASHFS_XZ
	bool
	depends on FS_SQUASHFS
	depends on XZ_DECOMPRESS
	default y

if !SQUASHFS_XZ
	comment "XZ support disabled"
endif
```

## fs/ubifs/Kconfig
```kconfig
menuconfig FS_UBIFS
	bool
	depends on MTD_UBI
	prompt "ubifs support"

if FS_UBIFS

config FS_UBIFS_COMPRESSION_LZO
	bool
	select LZO_DECOMPRESS
	prompt "LZO compression support"

config FS_UBIFS_COMPRESSION_ZLIB
	bool
	select ZLIB
	prompt "ZLIB compression support"

endif
```

## images/k3-am625-beagleplay.its
```
/dts-v1/;

/ {
	description = "barebox for BeaglePlay board";

	images {
		barebox {
			description = "barebox for BeaglePlay board";
			type = "firmware";
			os = "linux";
			arch = "arm";
			compression = "none";
			load = <0x80800000>;
			entry = <0x80800000>;
			data = /incbin/("barebox-beagleplay.img");
		};
	};

	configurations {
		default = "conf-0";

		conf-0 {
			description = "barebox for BeaglePlay board";
			firmware = "barebox";
			loadables = "barebox";
		};
	};
};
```

## lib/Kconfig
```kconfig
# SPDX-License-Identifier: GPL-2.0-only

menu "Library routines"
config PARAMETER
	bool

config UNCOMPRESS
	bool
	select FILETYPE

config JSMN
	bool "JSMN JSON Parser" if COMPILE_TEST
	help
	  A minimalistic JSON parser.

config XXHASH
	bool

config ZLIB
	bool "include gzip uncompression support"
	select UNCOMPRESS

config BZLIB
	bool "include bzip2 uncompression support"
	select UNCOMPRESS

config LZ4_DECOMPRESS
	bool "include lz4 uncompression support"
	select UNCOMPRESS

config ZSTD_DECOMPRESS
	bool "include zstd uncompression support"
	select UNCOMPRESS
	select XXHASH

config XZ_DECOMPRESS
	bool "include xz uncompression support"
	select UNCOMPRESS
	select XZ_DEC_X86
	select XZ_DEC_POWERPC
	select XZ_DEC_IA64
	select XZ_DEC_ARM
	select XZ_DEC_ARMTHUMB
	select XZ_DEC_SPARC

config XZ_DEC_X86
        bool

config XZ_DEC_POWERPC
        bool

config XZ_DEC_IA64
        bool

config XZ_DEC_ARM
        bool

config XZ_DEC_ARMTHUMB
        bool

config XZ_DEC_SPARC
        bool

config REED_SOLOMON
	bool

config BASE64
	bool "include base64 encode/decode support"

config CONSTRUCTORS
	bool

config GENERIC_FIND_NEXT_BIT
	def_bool n

config PROCESS_ESCAPE_SEQUENCE
	def_bool n

source "lib/lzo/Kconfig"

config BCH_CONST_PARAMS
	bool

config BCH
	bool

config BITREV
	bool

config FNMATCH
	bool

config QSORT
	bool

config XYMODEM
	bool
	select CRC_ITU_T

config LIBSCAN
	bool

config LIBUBIGEN
	bool

config IMAGE_SPARSE
	bool

config STMP_DEVICE
	bool "STMP device support" if COMPILE_TEST

config FSL_QE_FIRMWARE
	select CRC32
	bool

config LIBFDT
	bool

config RATP
	select CRC_ITU_T
	select DEV_MEM
	select COMMAND_SUPPORT
	select POLLER
	depends on CONSOLE_FULL
	depends on !SHELL_NONE
	bool "RATP protocol support"
	help
	  Reliable Asynchronous Transfer Protocol (RATP) is a protocol for reliably
	  transferring packets over serial links described in RFC916. This implementation
	  is used for controlling barebox over serial ports.

config ALLOW_PRNG_FALLBACK
	bool "Allow fallback to PRNG if HWRNG not available."
	help
	  WARNING: it is not secure!!

	  get_crypto_bytes() users like cmd_password relay on HWRNG. If HWRNG is not
	  available and this option is disabled, cmd_password will fail.
	  Enable it on your own risk.

config CRC_CCITT
	bool "CRC-CCITT functions"
	help
	  This option is provided for the case where no in-kernel-tree
	  modules require CRC-CCITT functions, but a module built outside
	  the kernel tree does. Such modules that use library CRC-CCITT
	  functions require M here.

config CRC8
        bool "CRC8 function"
	help
	  This option provides CRC8 function. Drivers may select this
	  when they need to do cyclic redundancy check according CRC8
	  algorithm. Module will be called crc8.

source "lib/gui/Kconfig"

source "lib/fonts/Kconfig"

source "lib/logo/Kconfig"

source "lib/bootstrap/Kconfig"

config PROGRESS_NOTIFIER
	bool "Progress Notifier" if COMPILE_TEST
	help
	  This is selected by boards that register a notifier to visualize
	  progress, like blinking a LED during an update.

config VERSION_CMP
	bool
	help
	  This is selected by code that needs to compare versions
	  in a manner compatible with
	    https://uapi-group.org/specifications/specs/version_format_specification

config PRINTF_UUID
	bool
	default y if PRINTF_FULL

config PRINTF_WCHAR
	bool
	default y if PRINTF_FULL

config PRINTF_HEXSTR
	bool
	default y if PRINTF_FULL

config GENERIC_LIB_ASHLDI3
	bool

config GENERIC_LIB_ASHRDI3
	bool

config GENERIC_LIB_LSHRDI3
	bool

config GENERIC_LIB_MULDI3
	bool

config NLS
        bool "Native language support"

config BLOBGEN
	select BASE64
	bool "include blob encode/decode support"

config ARCH_HAS_STACK_DUMP
	bool

config ARCH_HAS_DATA_ABORT_MASK
	bool

config ARCH_HAS_ZERO_PAGE
	bool

config HAVE_EFFICIENT_UNALIGNED_ACCESS
	bool

config GENERIC_ALLOCATOR
	bool
	help
	  Support is curently limited to allocaing a complete mmio-sram at once.

endmenu
```

/*
 * Include file to switch board DTS form using hardcoded memory node
 * (if specified) to dynamic memory size detection based on DDR
 * controller settings
 */

/ {
	/delete-node/ memory;
	/delete-node/ memory@80000000;
};

&aips2 {
	ddrc@307a0000 {
		compatible = "fsl,imx7d-ddrc";
		reg = <0x307a0000 0x10000>;
	};
};

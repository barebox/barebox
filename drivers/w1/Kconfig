## drivers/w1/Kconfig
```kconfig
menuconfig W1
	bool "Dallas's 1-wire support"
	---help---
	  Dallas' 1-wire bus is useful to connect slow 1-pin devices
	  such as iButtons and thermal sensors.

	  If you want W1 support, you should say Y here.

if W1

source drivers/w1/masters/Kconfig
source drivers/w1/slaves/Kconfig

config W1_DUAL_SEARCH
	bool "dual search"
	---help---
	  Some device need to be searched twice to be detected

endif # W1
```

## drivers/w1/slaves/Kconfig
```kconfig
#
# 1-wire slaves configuration
#

menu "1-wire Slaves"

config W1_SLAVE_DS2431
	bool "1kb EEPROM family support (DS2431)"
	help
	  Say Y here if you want to use a 1-wire
	  1kb EEPROM family device (DS2431)

config W1_SLAVE_DS2431_WRITE
	bool "write support"
	depends on W1_SLAVE_DS2431

config W1_SLAVE_DS2433
	bool "EEPROM family support (DS2433 4Kb or DS28EC20 20kb)"
	help
	  Say Y here if you want to use a 1-wire
	  EEPROM family device (DS2433 4Kb or DS28EC20 20kb).

config W1_SLAVE_DS2433_WRITE
	bool "write support"
	depends on W1_SLAVE_DS2433

endmenu
```

## drivers/watchdog/Kconfig
```kconfig
# SPDX-License-Identifier: GPL-2.0-only

config WATCHDOG_IMX_RESET_SOURCE
	bool

menuconfig WATCHDOG
	bool "Watchdog support"
	help
	  Many platforms support a watchdog to keep track of a working machine.
	  This framework provides routines to handle these watchdogs.

if WATCHDOG

config WATCHDOG_POLLER
	bool "Watchdog periodic feeder support"
	select POLLER
	help
	  Provides support for periodic watchdog feeder.

config WATCHDOG_AR9344
	bool "QCA AR9344"
	depends on SOC_QCA_AR9344 || SOC_QCA_AR9331 || COMPILE_TEST
	help
	  Add support for watchdog on the QCA AR9344 SoC.

config WATCHDOG_AT91SAM9
	bool "Watchdog for AT91SAM9 and SAMA5 SoCs"
	depends on ARCH_AT91
	help
	  Support for the watchdog in AT91SAM9X and SAMA5D{2,3,4} SoCs.

config WATCHDOG_EFI
	bool "Generic EFI Watchdog Driver"
	depends on EFI_PAYLOAD
	help
	  Add support for the EFI watchdog.

config WATCHDOG_DAVINCI
	bool "TI Davinci"
	depends on ARCH_DAVINCI || COMPILE_TEST
	help
	  Add support for watchdog on the TI Davinci SoC.

config WATCHDOG_DW
	bool "Synopsys DesignWare watchdog"
	select RESET_CONTROLLER
	help
	  Add support for the Synopsys DesignWare watchdog timer.

config WATCHDOG_MXS28
	bool "i.MX28"
	depends on ARCH_IMX28 || COMPILE_TEST
	help
	  Add support for watchdog management for the i.MX28 SoC.

config WATCHDOG_IMX
	bool "i.MX watchdog"
	depends on ARCH_IMX || ARCH_LAYERSCAPE || COMPILE_TEST
	help
	  Add support for watchdog found on Freescale i.MX SoCs.

config WATCHDOG_IMXULP
	bool "i.MX ULP watchdog"
	depends on ARCH_IMX || COMPILE_TEST
	help
	  Add support for watchdog found on Freescale i.MX SoCs.

config WATCHDOG_JZ4740
	bool "Ingenic jz4740 SoC hardware watchdog"
	depends on MACH_MIPS_XBURST || COMPILE_TEST
	help
	  Hardware driver for the built-in watchdog timer on Ingenic jz4740 SoCs.

config WATCHDOG_OMAP
	bool "TI OMAP"
	depends on ARCH_OMAP || COMPILE_TEST
	help
	  Add support for watchdog on the TI OMAP SoC.

config WATCHDOG_ORION
	bool "Watchdog for Armada XP"
	depends on ARCH_ARMADA_XP || COMPILE_TEST
	help
	  Add support for watchdog on the Marvall Armada XP

config WATCHDOG_KVX
	bool "KVX Core watchdog"
	depends on KVX
	help
	  Add support for the KVX core watchdog.

config WATCHDOG_BCM2835
	bool "Watchdog for BCM283x SoCs"
	depends on ARCH_BCM283X || COMPILE_TEST
	help
	  Add support for watchdog on the Broadcom BCM283X SoCs.

config RAVE_SP_WATCHDOG
	bool "RAVE SP Watchdog timer"
	depends on RAVE_SP_CORE
	help
	  Support for the watchdog on RAVE SP device.

config STM32_IWDG_WATCHDOG
	bool "STM32 IWDG"
	depends on ARCH_STM32 || COMPILE_TEST
	select MFD_SYSCON
	help
	  Enable to support configuration of the STM32's on-SoC IWDG watchdog.
	  Once started by the user, the IWDG can't be disabled.

config STPMIC1_WATCHDOG
	bool "STPMIC1 Watchdog"
	depends on MFD_STPMIC1
	help
	  Enable to support configuration of the stpmic1's built-in watchdog.

config RN568_WATCHDOG
	bool "Ricoh RN5t568 PMIC based Watchdog"
	depends on MFD_RN568PMIC
	help
	  Enable to support system control via the PMIC based watchdog.

config F71808E_WDT
	bool "Fintek F718xx, F818xx Super I/O Watchdog"
	depends on X86
	depends on FINTEK_SUPERIO
	help
	  This is the driver for the hardware watchdog on the Fintek F71808E,
	  F71862FG, F71868, F71869, F71882FG, F71889FG, F81865 and F81866
	  Super I/O controllers.

config GPIO_WATCHDOG
	tristate "Watchdog device controlled through GPIO-line"
	depends on OF_GPIO
	help
	  If you say yes here you get support for watchdog device
	  controlled through GPIO-line.

config ITCO_WDT
	bool "Intel TCO Timer/Watchdog"
	depends on X86
	depends on PCI
	help
	  Hardware driver for the intel TCO timer based watchdog devices.
	  These drivers are included in the Intel 82801 I/O Controller
	  Hub family (from ICH0 up to ICH10) and in the Intel 63xxESB
	  controller hub.

	  The TCO (Total Cost of Ownership) timer is a watchdog timer
	  that will reboot the machine after its second expiration.

	  On some motherboards the driver may fail to reset the chipset's
	  NO_REBOOT flag which prevents the watchdog from rebooting the
	  machine.

config STARFIVE_WDT
	tristate "StarFive Watchdog Timer"
	depends on SOC_STARFIVE && OFDEVICE
	help
	  If you say yes here you get support for the watchdog device
	  on StarFive SoCs.

config WDAT_WDT
	bool "ACPI Watchdog Action Table (WDAT)"
	depends on X86
	depends on ACPI
	help
	  This driver adds support for systems with ACPI Watchdog Action
	  Table (WDAT) table. Servers typically have this but it can be
	  found on some desktop machines as well. This driver will take
	  over the native iTCO watchdog driver found on many Intel CPUs.

config CADENCE_WATCHDOG
	tristate "Cadence Watchdog Timer"
	help
	  Say Y here if you want to include support for the watchdog
	  timer in the Xilinx Zynq.

endif
```

## efi/Kconfig
```kconfig
# SPDX-License-Identifier: GPL-2.0-only

menu "EFI (Extensible Firmware Interface) Support"

config EFI_PAYLOAD
	bool "barebox as EFI payload/app (consumer)"
	depends on HAVE_EFI_PAYLOAD || COMPILE_TEST
	select PBL_FULLY_PIC if ARM64
	select EFI
	select EFI_GUID
	select EFI_DEVICEPATH
	select PRINTF_UUID
	select PRINTF_WCHAR
	select BLOCK
	select PARTITION_DISK
	select HW_HAS_PCI
	select MALLOC_TLSF
	help
	  Select this option if you want a barebox.efi image generated that
	  can be loaded from existing UEFI firmware and that consumes services
	  and protocols provided by that UEFI firmware instead of having to
	  interact directly with the hardware.

if EFI_PAYLOAD
source "efi/payload/Kconfig"
endif

config EFI
	bool

if EFI

config EFI_GUID
	bool
	help
	  With this option a table of EFI guids is compiled in.

config EFI_DEVICEPATH
	bool

config EFI_PAYLOAD_DEFAULT_PATH
	string
	default "EFI/BOOT/BOOTARM.EFI"		if ARM32
	default "EFI/BOOT/BOOTAA64.EFI"		if ARM64
	default "EFI/BOOT/BOOTIA32.EFI"		if X86_32
	default "EFI/BOOT/BOOTx64.EFI"		if X86_64
	default "EFI/BOOT/BOOTRISCV32.EFI"	if ARCH_RV32I
	default "EFI/BOOT/BOOTRISCV64.EFI"	if ARCH_RV64I
	default "EFI/BOOT/BAREBOX.EFI"

endif

endmenu
```

## efi/loader/Kconfig
```kconfig
# SPDX-License-Identifier: GPL-2.0-only
# SPDX-Comment: Origin-URL: https://github.com/u-boot/u-boot/blob/a0fe8cedcbe8c76403a77e57eac228b8f778a3ae/lib/efi_loader/Kconfig

config EFI_LOADER_BOOTMGR
	bool "Rudimentary UEFI Boot Manager support"
	select BOOT
	select BOOT_DEFAULTS
	default y
	help
	  This boot manager doesn't yet make use of Boot# variables, but instead
	  hardcodes order to lookup removable and then builtin storage devices
	  for EFI payloads located at the removable media path indicated by
	  CONFIG_EFI_PAYLOAD_DEFAULT_PATH within their respective devices.

config EFI_LOADER_DEBUG_SUPPORT
	bool "EFI Debug Support"
	default y
	help
	  Select this option if you want to setup the EFI Debug Support
	  Table and the EFI_SYSTEM_TABLE_POINTER which is used by the debug
	  agent or an external debugger to determine loaded image information
	  in a quiescent manner.

menu "UEFI services"

config EFI_LOADER_GET_TIME
	bool "GetTime() runtime service"
	depends on RTC_CLASS
	default y
	help
	  Provide the GetTime() runtime service at boottime. This service
	  can be used by an EFI application to read the real time clock.

config EFI_LOADER_SET_TIME
	bool "SetTime() runtime service"
	depends on RTC_CLASS
	default y
	help
	  Provide the SetTime() runtime service at boottime. This service
	  can be used by an EFI application to adjust the real time clock.

endmenu

source "efi/loader/protocols/Kconfig"
```

## efi/loader/protocols/Kconfig
```kconfig
# SPDX-License-Identifier: GPL-2.0

menu "UEFI protocol support"

config EFI_LOADER_GOP
	bool "Graphics output protocol"
	depends on VIDEO
	select IMAGE_RENDERER
	default y
	help
    	  The graphics output protocol (GOP) provides UEFI applications access
    	  to a framebuffer for graphical output. This allows booting of UEFI
    	  applications and operating systems that require graphics support.

    	  The protocol exposes the video mode information and framebuffer
    	  details to UEFI payloads, enabling them to render graphics, display
    	  boot menus, and provide visual feedback during boot.

    	  If you have video support enabled and want to boot UEFI applications
    	  that require graphics (such as GRUB with graphical menus or Linux
    	  with EFIFB), say Y here.

config EFI_LOADER_HII
	bool "HII protocols"
	default y
	help
	  The Human Interface Infrastructure is a complicated framework that
	  allows UEFI applications to draw fancy menus and hook strings using
	  a translation framework.

	  barebox implements enough of its features to be able to run the UEFI
	  Shell, but not more than that.

config EFI_LOADER_UNICODE_COLLATION_PROTOCOL2
	bool "Unicode collation protocol"
	default y
	help
	  The Unicode collation protocol is used for lexical comparisons. It is
	  required to run the UEFI shell.

config EFI_LOADER_UNICODE_CAPITALIZATION
	bool "Support Unicode capitalization"
	default y
	depends on EFI_LOADER_UNICODE_COLLATION_PROTOCOL2
	select UNICODE_CAPITALIZATION
	help
	  Select this option to enable correct handling of the capitalization of
	  Unicode codepoints in the range 0x0000-0xffff. If this option is not
	  set, only the the correct handling of the letters of the codepage
	  used by the FAT file system is ensured.

config EFI_LOADER_RNG
	bool "EFI_RNG_PROTOCOL support"
	depends on HWRNG
	default y
	help
	  Provide a EFI_RNG_PROTOCOL implementation using the hardware random
	  number generator of the platform.

config EFI_LOADER_DEVICE_PATH_TO_TEXT
	bool "Device path to text protocol"
	default y
	help
	  The device path to text protocol converts device nodes and paths to
	  human readable strings.

config EFI_LOADER_DEVICE_PATH_UTIL
	bool "Device path utilities protocol"
	default y
	help
	  The device path utilities protocol creates and manipulates device
	  paths and device nodes. It is required to run the EFI Shell.

endmenu
```

## efi/payload/Kconfig
```kconfig
# SPDX-License-Identifier: GPL-2.0-only

config EFI_PAYLOAD_ESP_IMAGE
	bool "Generate barebox.esp image from payload"
	depends on EFI_STUB || !PBL_IMAGE

config EFI_HANDOVER_PROTOCOL
	bool "EFI Handover protocol (DEPRECATED)"
	depends on X86
	default y
	help
	  Select this in order to include support for booting Linux
	  over the deprecated EFI handover protocol, which defines alternative
	  entry points into the EFI stub.

	  This is a practice that has no basis in the UEFI specification,
	  and requires a priori knowledge on the part of the bootloader about
	  Linux/x86 specific ways of passing the command line and initrd,
	  and where in memory those assets may be loaded.

	  This method of booting has been deprecated in Linux v6.2 in favor
	  of the StartImage() boot service and should not be required with
	  Linux v5.7 and above.

	  If you say y here, the handover protocol will be used, unless
	  global.linux.efi.handover=0 was set.

	  If unsure, keep the default of y. The StartImage support for booting
	  Linux is still new in barebox and will be made the default once we
	  gain more confidence in its implementation.

config EFI_PAYLOAD_BOOTM
	bool "EFI bootm protocol"
	default !X86

config EFI_STUB
       def_bool HAVE_EFI_STUB
```

## efi/runtime/Kconfig
```kconfig
# SPDX-License-Identifier: GPL-2.0

config EFI_RUNTIME_GET_TIME
	bool

config EFI_RUNTIME_SET_TIME
	bool

config EFI_RUNTIME_GET_WAKEUP_TIME
	bool

config EFI_RUNTIME_SET_WAKEUP_TIME
	bool

config EFI_RUNTIME_GET_VARIABLE
	bool

config EFI_RUNTIME_GET_NEXT_VARIABLE_NAME
	bool

config EFI_RUNTIME_SET_VARIABLE
	bool

config EFI_RUNTIME_SET_VIRTUAL_ADDRESS_MAP
	bool

config EFI_RUNTIME_CONVERT_POINTER
	bool

config EFI_RUNTIME_GET_NEXT_HIGH_MONOTONIC_COUNT
	bool

config EFI_RUNTIME_RESET_SYSTEM
	def_bool y

config EFI_RUNTIME_UPDATE_CAPSULE
	bool

config EFI_RUNTIME_QUERY_CAPSULE_CAPABILITIES
	bool

config EFI_RUNTIME_QUERY_VARIABLE_INFO
	bool
```

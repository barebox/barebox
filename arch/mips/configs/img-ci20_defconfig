## arch/powerpc/mach-mpc85xx/Kconfig
```kconfig
# SPDX-License-Identifier: GPL-2.0-only

if ARCH_MPC85XX

config MMU
	default y

config BTB
	bool
	default y

config TEXT_BASE
	hex
	default 0x00f00000 if QEMU_PPCE500
	default 0xeff80000 if P1010RDB || P2020RDB || P1022DS
	default 0xfff80000 if DA923RC

config RESET_VECTOR_ADDRESS
	hex
	default 0x00000000 if QEMU_PPCE500
	default 0xfffffffc if DA923RC
	default 0xeffffffc if P1010RDB || P2020RDB || P1022DS

config MPC85xx
	bool
	default y

config BOOKE
	bool
	default y

config E500
	bool
	default y

choice
	prompt "Select your board"

config P1010RDB
	bool "P1010RDB"
    select P1010
    select DDR_SPD
    select FSL_DDR3
	help
	  Say Y here if you are using the Freescale P1010RDB

config P2020RDB
	bool "P2020RDB"
    select P2020
    select FSL_ELBC
	help
	  Say Y here if you are using the Freescale P2020RDB

config P1022DS
	bool "P1022DS"
    select P1022
    select DDR_SPD
    select FSL_DDR3
    select FSL_ELBC
	help
	  Say Y here if you are using the Freescale P1022DS

config DA923RC
	bool "DA923RC"
    select MPC8544
    select DDR_SPD
    select FSL_DDR2
	help
	Say Y here if you are using the GE Intelligent Platforms DA923RC

config QEMU_PPCE500
	bool "QEMU ppce500"
	select HAS_DEBUG_LL
	select LIBFDT
	select GPIOLIB
	help
	  Say Y here for QEMU ppce500 generic paravirt e500 support.
	  CCSRBAR is at 36-bit physical address 0xFE0000000.

endchoice
endif

config P1010
    select FSL_IFC
    select FSL_ERRATUM_IFC_A002769
    select FSL_ERRATUM_P1010_A003549
    select FSL_ERRATUM_IFC_A003399
	bool

config P2020
	bool

config P1022
	bool

config MPC8544
	bool

config FSL_DDR2
	bool

config FSL_DDR3
	bool

config FSL_IFC
	bool

config FSL_ELBC
	bool

config FSL_ERRATUM_IFC_A002769
    bool

config FSL_ERRATUM_IFC_A003399
    bool

config FSL_ERRATUM_P1010_A003549
    bool
```

## arch/ppc/Kconfig
```kconfig
config PPC
	bool
	select HAVE_CONFIGURABLE_TEXT_BASE
	select HAS_KALLSYMS
	select HAS_MODULES
	select HAS_CACHE
	select GENERIC_FIND_NEXT_BIT
	select OFTREE
	default y

choice
	prompt "Processor type"

config ARCH_MPC5XXX
	bool "Freescale MPC5xxx"

config ARCH_MPC85XX
	bool "Freescale MPC85xx"
endchoice

source arch/ppc/mach-mpc5xxx/Kconfig
source arch/ppc/mach-mpc85xx/Kconfig
```

## arch/ppc/configs/da923rc_defconfig
```kconfig
CONFIG_ARCH_MPC85XX=y
CONFIG_DA923RC=y
CONFIG_BAREBOX_MAX_IMAGE_SIZE=0x80000
CONFIG_BANNER=y
CONFIG_CMD_READLINE=y
CONFIG_CMD_GETOPT=y
CONFIG_LONGHELP=y
CONFIG_GLOB=y
CONFIG_CMDLINE_EDITING=y
CONFIG_AUTO_COMPLETE=y
CONFIG_CMD_PARTITION=y
CONFIG_CMD_BOOTM_ZLIB=y
CONFIG_CMD_BOOTM_BZLIB=y
CONFIG_ZLIB=y
CONFIG_BZLIB=y
CONFIG_CMD_EDIT=y
CONFIG_CMD_EXPORT=y
CONFIG_CMD_FLASH=y
CONFIG_CMD_GO=y
CONFIG_DEFAULT_ENVIRONMENT_GENERIC=n
CONFIG_CMD_LOADENV=y
CONFIG_CMD_PRINTENV=y
CONFIG_CMD_SAVEENV=y
CONFIG_CMD_READLINK=y
CONFIG_CMD_RESET=y
CONFIG_CMD_SLEEP=y
CONFIG_CMD_TIMEOUT=y
CONFIG_CMD_UNCOMPRESS=y
CONFIG_NET=y
CONFIG_CMD_PING=y
CONFIG_NET_TFTP=y
CONFIG_NET_TFTP_PUSH=y
CONFIG_FS_TFTP=y
CONFIG_CMD_TFTP=y
CONFIG_DRIVER_NET_GIANFAR=y
CONFIG_CMD_MIITOOL=y
CONFIG_DRIVER_CFI=y
CONFIG_DRIVER_CFI_BANK_WIDTH_1=n
CONFIG_DRIVER_CFI_BANK_WIDTH_2=y
CONFIG_DRIVER_CFI_BANK_WIDTH_4=n
CONFIG_CFI_BUFFER_WRITE=y
CONFIG_MTD=y
CONFIG_MTD_WRITE=y
CONFIG_MTD_UBI=y
CONFIG_CMD_UBI=y
CONFIG_FS_UBIFS=y
CONFIG_FS_UBIFS_COMPRESSION_LZO=y
CONFIG_CMD_UNLZO=y
CONFIG_LZO_DECOMPRESS=y
CONFIG_MALLOC_SIZE=0x4000000
CONFIG_PROMPT="GE> "
CONFIG_BAUDRATE=9600
CONFIG_RELOCATABLE=y
CONFIG_DRIVER_SERIAL_NS16550=y
CONFIG_SPI=n
CONFIG_I2C=y
CONFIG_I2C_IMX=y
CONFIG_CMD_I2C=y
CONFIG_CMD_VERSION=n
CONFIG_OFTREE=y
CONFIG_CMD_OFTREE_PROBE=y
CONFIG_CMD_OFTREE=y
CONFIG_CMD_MEMTEST=y
CONFIG_CMD_IOMEM=y
```

## arch/ppc/configs/owc_da923rc_defconfig
```kconfig
CONFIG_ARCH_MPC85XX=y
CONFIG_DA923RC=y
CONFIG_BAREBOX_MAX_IMAGE_SIZE=0x80000
CONFIG_MALLOC_SIZE=0x4000000
CONFIG_RELOCATABLE=y
CONFIG_PROMPT="GE> "
CONFIG_BAUDRATE=9600
CONFIG_GLOB=y
CONFIG_CMDLINE_EDITING=y
CONFIG_AUTO_COMPLETE=y
CONFIG_LONGHELP=y
CONFIG_CMD_IOMEM=y
# CONFIG_CMD_VERSION is not set
CONFIG_CMD_GO=y
CONFIG_CMD_RESET=y
CONFIG_CMD_PARTITION=y
CONFIG_CMD_EXPORT=y
CONFIG_CMD_LOADENV=y
CONFIG_CMD_PRINTENV=y
CONFIG_CMD_SAVEENV=y
CONFIG_CMD_READLINK=y
CONFIG_CMD_UNCOMPRESS=y
CONFIG_CMD_GETOPT=y
CONFIG_CMD_SLEEP=y
CONFIG_CMD_MIITOOL=y
CONFIG_CMD_PING=y
CONFIG_CMD_TFTP=y
CONFIG_CMD_EDIT=y
CONFIG_CMD_READLINE=y
CONFIG_CMD_TIMEOUT=y
CONFIG_CMD_MEMTEST=y
CONFIG_CMD_FLASH=y
CONFIG_CMD_I2C=y
CONFIG_CMD_OFTREE=y
CONFIG_NET=y
CONFIG_DRIVER_SERIAL_NS16550=y
CONFIG_DRIVER_NET_GIANFAR=y
# CONFIG_SPI is not set
CONFIG_I2C=y
CONFIG_I2C_IMX=y
CONFIG_MTD=y
CONFIG_DRIVER_CFI=y
# CONFIG_DRIVER_CFI_BANK_WIDTH_1 is not set
# CONFIG_DRIVER_CFI_BANK_WIDTH_4 is not set
CONFIG_CFI_BUFFER_WRITE=y
CONFIG_MTD_UBI=y
CONFIG_FS_TFTP=y
CONFIG_FS_UBIFS=y
CONFIG_FS_UBIFS_COMPRESSION_LZO=y
CONFIG_ZLIB=y
CONFIG_BZLIB=y
```

## arch/ppc/configs/p1022ds_defconfig
```kconfig
CONFIG_ARCH_MPC85XX=y
CONFIG_P1022DS=y
CONFIG_MALLOC_SIZE=0x4000000
CONFIG_RELOCATABLE=y
CONFIG_GLOB=y
CONFIG_CMDLINE_EDITING=y
CONFIG_AUTO_COMPLETE=y
CONFIG_BOOTM_VERBOSE=y
CONFIG_LONGHELP=y
CONFIG_CMD_IOMEM=y
CONFIG_CMD_GO=y
CONFIG_CMD_RESET=y
CONFIG_CMD_EXPORT=y
CONFIG_CMD_LOADENV=y
CONFIG_CMD_PRINTENV=y
CONFIG_CMD_SAVEENV=y
CONFIG_CMD_SLEEP=y
CONFIG_CMD_MIITOOL=y
CONFIG_CMD_PING=y
CONFIG_CMD_TFTP=y
CONFIG_CMD_EDIT=y
CONFIG_CMD_MEMTEST=y
CONFIG_CMD_FLASH=y
CONFIG_CMD_I2C=y
CONFIG_CMD_BAREBOX_UPDATE=y
CONFIG_CMD_OFTREE=y
CONFIG_NET=y
CONFIG_DRIVER_SERIAL_NS16550=y
CONFIG_DRIVER_NET_GIANFAR=y
CONFIG_I2C=y
CONFIG_I2C_IMX=y
CONFIG_MTD=y
CONFIG_DRIVER_CFI=y
# CONFIG_DRIVER_CFI_INTEL is not set
# CONFIG_DRIVER_CFI_BANK_WIDTH_1 is not set
# CONFIG_DRIVER_CFI_BANK_WIDTH_4 is not set
CONFIG_FS_TFTP=y
CONFIG_ZLIB=y
CONFIG_BZLIB=y
```

## arch/ppc/configs/p2020rdb_defconfig
```kconfig
CONFIG_ARCH_MPC85XX=y
CONFIG_P2020RDB=y
CONFIG_P2020=y
CONFIG_LONGHELP=y
CONFIG_GLOB=y
CONFIG_CMDLINE_EDITING=y
CONFIG_AUTO_COMPLETE=y
CONFIG_CMD_SLEEP=y
CONFIG_CMD_PARTITION=y
CONFIG_CMD_BOOTM_ZLIB=y
CONFIG_CMD_BOOTM_BZLIB=y
CONFIG_ZLIB=y
CONFIG_BZLIB=y
CONFIG_CMD_EDIT=y
CONFIG_CMD_EXPORT=y
CONFIG_CMD_FLASH=y
CONFIG_CMD_RESET=y
CONFIG_CMD_GO=y
CONFIG_DEFAULT_ENVIRONMENT_GENERIC=n
CONFIG_CMD_LOADENV=y
CONFIG_CMD_PRINTENV=y
CONFIG_CMD_SAVEENV=y
CONFIG_CMD_READLINK=y
CONFIG_FSL_ELBC=y
CONFIG_CMD_TIMEOUT=y
CONFIG_CMD_UNCOMPRESS=y
CONFIG_DRIVER_CFI=y
CONFIG_DRIVER_CFI_AMD=y
CONFIG_DRIVER_CFI_INTEL=n
CONFIG_DRIVER_CFI_BANK_WIDTH_1=n
CONFIG_DRIVER_CFI_BANK_WIDTH_2=y
CONFIG_DRIVER_CFI_BANK_WIDTH_4=n
CONFIG_MTD=y
CONFIG_MALLOC_SIZE=0x2800000
CONFIG_BAUDRATE=115200
CONFIG_DRIVER_SERIAL_NS16550=y
CONFIG_RELOCATABLE=y
CONFIG_DRIVER_NET_GIANFAR=y
CONFIG_NET=y
CONFIG_CMD_PING=y
CONFIG_FS_TFTP=y
CONFIG_NET_TFTP=y
CONFIG_CMD_TFTP=y
CONFIG_PING=y
CONFIG_I2C=y
CONFIG_I2C_IMX=y
CONFIG_CMD_I2C=y
CONFIG_CMD_MIITOOL=y
CONFIG_CMD_MEMTEST=y
CONFIG_CMD_IOMEM=y
CONFIG_CMD_VERSION=n
CONFIG_OFTREE=y
CONFIG_CMD_OFTREE_PROBE=y
CONFIG_CMD_OFTREE=y
```

// SPDX-License-Identifier: (GPL-2.0+ OR BSD-3-Clause)

#include <arm/st/stm32mp135f-dk.dts>
#include "stm32mp131.dtsi"

/ {
	model = "STM32MP135F-DK";

	chosen {
		stdout-path = "serial0:115200n8";

		environment {
			compatible = "barebox,environment";
			device-path = &sdmmc1, "partname:barebox-environment";
		};
	};
};

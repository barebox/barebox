## drivers/rtc/Kconfig
```kconfig
# SPDX-License-Identifier: GPL-2.0-only
#
# RTC class/drivers configuration
#

config RTC_LIB
	bool
	select GREGORIAN_CALENDER

menuconfig RTC_CLASS
	bool "Real Time Clock"
	default n
	select RTC_LIB
	help
	  Generic RTC class support. If you say yes here, you will
	  be allowed to plug one or more RTCs to your system. You will
	  probably want to enable one or more of the interfaces below.

if RTC_CLASS

config RTC_NVMEM
	bool "RTC non volatile storage support" if COMPILE_TEST
	depends on NVMEM
	default y
	help
	  Say yes here to add support for the non volatile (often battery
	  backed) storage present on RTCs.

comment "I2C RTC drivers"
	depends on I2C

if I2C

config RTC_DRV_DS1307
	tristate "Dallas/Maxim DS1307/38"
	help
	  If you say yes here you get support for various compatible RTC
	  chips (often with battery backup) connected with I2C. This driver
	  should handle DS1307, DS1338 and probably other chips.

	  The first seven registers on these chips hold an RTC, and other
	  registers may add features such as NVRAM, a trickle charger for
	  the RTC/NVRAM backup power, and alarms.

config RTC_DRV_ABRACON
	tristate "Abracon RTCs"

config RTC_DRV_PCF85063
	tristate "NXP PCF85063"
	select REGMAP_I2C
	help
	  If you say yes here you get support for the PCF85063 RTC chip

config RTC_DRV_PCF85363
	tristate "NXP PCF85363"
	depends on I2C
	select REGMAP_I2C
	help
	  If you say yes here you get support for the PCF85363 RTC chip.

endif # I2C

config RTC_DRV_IMXDI
	tristate "Freescale IMX DryIce Real Time Clock"
	depends on ARCH_IMX
	help
	   Support for Freescale IMX DryIce RTC

config RTC_DRV_JZ4740
	tristate "Ingenic JZ4740 RTC"
	depends on MACH_MIPS_XBURST
	help
	  If you say yes here you get support for the Ingenic JZ4740 SoC RTC
	  controller.

endif # RTC_CLASS
```

## drivers/serial/Kconfig
```kconfig
# SPDX-License-Identifier: GPL-2.0-only
menu "serial drivers"
	depends on !CONSOLE_NONE

config SERIAL_DEV_BUS
	bool "Serial device bus"
	select POLLER
	depends on CONSOLE_FULL
	help
	  Core support for devices connected via a serial port.

config DRIVER_SERIAL_ARM_DCC
	depends on ARM && !CPU_V8
	bool "ARM Debug Communications Channel (DCC) serial driver"

config SERIAL_AMBA_PL011
	bool "ARM AMBA PL011 serial port support"
	depends on ARM_AMBA
	help
	  This selects the ARM(R) AMBA(R) PrimeCell PL011 UART. If you have
	  an Integrator/PP2, Integrator/CP or Versatile platform, say Y here.

	  If unsure, say N.

config DRIVER_SERIAL_AR933X
	bool "AR933X serial driver"
	depends on MACH_MIPS_ATH79
	help
	  If you have an Atheros AR933X SOC based board and want to use the
	  built-in UART of the SoC, say Y to this option.

config DRIVER_SERIAL_EFI
	bool "EFI serial"
	depends on EFI_PAYLOAD

config DRIVER_SERIAL_IMX
	depends on ARCH_IMX
	default y
	bool "i.MX serial driver"

config DRIVER_SERIAL_STM32
	depends on ARCH_STM32
	bool "stm32 serial driver"

config DRIVER_SERIAL_STM378X
	depends on ARCH_MXS
	default y
	bool "i.MX23/i.MX28 debug UART serial driver"

config DRIVER_SERIAL_AUART
	depends on ARCH_MXS
	select STMP_DEVICE
	bool "i.MX23/i.MX28 application UART serial driver"

config DRIVER_SERIAL_LINUX_CONSOLE
	depends on SANDBOX
	default y
	bool "linux console driver"

config DRIVER_SERIAL_EFI_STDIO
	depends on EFI_PAYLOAD
	bool "EFI stdio driver"

config DRIVER_SERIAL_MPC5XXX
	depends on MPC5200
	default y
	bool "MPC5200 serial driver"

config DRIVER_SERIAL_CLPS711X
	depends on ARCH_CLPS711X
	default y
	bool "CLPS711X serial driver"

config DRIVER_SERIAL_NS16550
	default n
	bool "NS16550 serial driver"
	help
	  Enable this to get support for NS16550 based serial devices

config DRIVER_SERIAL_ATMEL
	depends on ARCH_AT91
	default y
	bool "Atmel serial driver"

config DRIVER_SERIAL_NS16550_PCI
	depends on DRIVER_SERIAL_NS16550
	depends on PCI
	default y
	bool "NS16550 PCI serial driver"
	help
	  Enable this to get support for NS16550 UARTs connected over PCI

config DRIVER_SERIAL_PL010
	depends on ARCH_EP93XX
	default y
	bool "ARM AMBA PL010 support"
	help
	  Enable this to get support for AMBA PL010 based serial devices

config DRIVER_SERIAL_PXA
	bool "PXA serial driver"
	depends on ARCH_PXA

config DRIVER_SERIAL_OMAP4_USBBOOT
	bool "serial driver over omap4 usb"
	default n
	depends on OMAP4_USBBOOT
	help
	  Enable this to get console support over the usb bus used to boot an OMAP4

config DRIVER_SERIAL_CADENCE
	bool "Cadence UART driver"
	help
	  Say Y here if you have a Cadence serial IP core.

config DRIVER_SERIAL_DIGIC
	bool "Canon DIGIC serial driver"
	depends on ARCH_DIGIC

config DRIVER_SERIAL_LPUART
	depends on ARCH_VF610
	default y
	bool "LPUART serial driver"

config DRIVER_SERIAL_LPUART32
	depends on ARCH_IMX
	bool "LPUART32 serial driver"

config VIRTIO_CONSOLE
	tristate "Virtio console"
	depends on VIRTIO
	help
	  Virtio console for use with hypervisors.

	  Also serves as a general-purpose serial device for data
	  transfer between the guest and host.

config SERIAL_SIFIVE
	tristate "SiFive UART support"
	depends on OFDEVICE
	help
	  Select this option if you are building barebox for a device that
	  contains a SiFive UART IP block.  This type of UART is present on
	  SiFive FU540 SoCs, among others.

config SERIAL_SBI
	tristate "RISCV Serial support over SBI's HTIF"
	depends on OFDEVICE
	depends on RISCV_SBI
	help
	  Select this option if you are building barebox for a RISCV platform
	  that implements a serial over SBI.

endmenu
```

## drivers/soc/Kconfig
```kconfig
menu "SoC drivers"

source "drivers/soc/imx/Kconfig"
source "drivers/soc/kvx/Kconfig"
source "drivers/soc/rockchip/Kconfig"
source "drivers/soc/ti/Kconfig"

endmenu
```

## drivers/soc/imx/Kconfig
```kconfig
# SPDX-License-Identifier: GPL-2.0-only
menu "i.MX SoC drivers"

config IMX8M_FEATCTRL
	bool "i.MX8M feature controller"
	depends on ARCH_IMX8M
	select FEATURE_CONTROLLER
	select IMX_OCOTP
	select NVMEM
	default y
	help
	  This driver disables device tree nodes that are not applicable
	  to Lite variants of i.MX8M SoCs.

endmenu
```

## drivers/soc/kvx/Kconfig
```kconfig
menu "KVX SoC drivers"

config KVX_SOCINFO
        bool "KVX SoC Info driver"
	depends on KVX
	select NVMEM
	select KVX_OTP_NV
	default y

endmenu
```

## drivers/soc/rockchip/Kconfig
```kconfig
# SPDX-License-Identifier: GPL-2.0-only

if ARCH_ROCKCHIP || COMPILE_TEST

menu "Rockchip SoC drivers"

config ROCKCHIP_IODOMAIN
	tristate "Rockchip IO domain support"
	depends on OFDEVICE
	help
	  Say y here to enable support io domains on Rockchip SoCs. It is
	  necessary for the io domain setting of the SoC to match the
	  voltage supplied by the regulators.

endmenu

endif
```

## drivers/soc/ti/Kconfig
```kconfig
config K3_ESM
	bool
	depends on ARCH_K3 && MACH_K3_CORTEX_R5
	default y

config TI_K3_RINGACC
	tristate "K3 Ring accelerator Sub System"
	depends on ARCH_K3 || COMPILE_TEST
	help
	  Say y here to support the K3 Ring accelerator module.
	  The Ring Accelerator (RINGACC or RA)  provides hardware acceleration
	  to enable straightforward passing of work between a producer
	  and a consumer. There is one RINGACC module per NAVSS on TI AM65x SoCs
	  If unsure, say N.
```

## drivers/sound/Kconfig
```kconfig
# SPDX-License-Identifier: GPL-2.0-only
menuconfig SOUND
	bool "Sound drivers"
	select POLLER
	help
	  Say Y here for sound support. At the moment that's just beep tones.
	  Tones are played asynchronously in a poller. Check the beep command
	  for how to exercise the API.

if SOUND

config SOUND_SDL
	bool "SDL sound driver for sandbox"
	depends on HAVE_LIBSDL2 && OFDEVICE
	select SDL

config PWM_BEEPER
	bool "PWM beeper support"
	depends on PWM && OFDEVICE
	help
	  Say Y here to get support for PWM based beeper devices.

config GPIO_BEEPER
	bool "GPIO beeper support"
	depends on GPIOLIB && OFDEVICE
	help
	  Say Y here to get support for GPIO based beeper devices.

config SYNTH_SQUARES
	bool "Synthesize square waves only"
	help
	  For beeping on PCM sound cards, barebox needs to synthesize samples,
	  which can take too much poller time for crisp playback and/or quick
	  booting. If your playback stutters, say Y here. This will have all
	  synthesizers output a gain-adjusted square wave instead, which is
	  less time-consuming to compute.

endif
```

## drivers/spi/Kconfig
```kconfig
# SPDX-License-Identifier: GPL-2.0-only
menu "SPI drivers"

config SPI
	bool "Enable SPI driver support"
	default y

if SPI

config SPI_MEM
	bool "SPI memory extension"
	help
	  Enable this option if you want to enable the SPI memory extension.
	  This extension is meant to simplify interaction with SPI memories
	  by providing a high-level interface to send memory-like commands.

config DRIVER_SPI_ATH79
	bool "Atheros AR71XX/AR724X/AR913X/AR933X SPI controller driver"
	depends on MACH_MIPS_ATH79

config DRIVER_SPI_ATMEL
	bool "Atmel (AT91) SPI Master driver"
	depends on ARCH_AT91

config SPI_ATMEL_QUADSPI
	tristate "Atmel Quad SPI Controller"
	depends on ARCH_AT91
	depends on SPI_MEM
	help
	  This enables support for the Quad SPI controller in master mode.
	  This driver does not support generic SPI. The implementation only
	  supports spi-mem interface.

config DRIVER_SPI_FSL_QUADSPI
	bool "Freescale QSPI controller"
	depends on SPI_MEM
	help
	  This enables support for the Quad SPI controller in master mode.
          Up to four flash chips can be connected on two buses with two
          chipselects each.
          This controller does not support generic SPI messages. It only
          supports the high-level SPI memory interface.

config SPI_FSL_DSPI
	bool "Freescale DSPI controller"
	depends on ARCH_LAYERSCAPE
	help
	  This enables support for the Freescale DSPI controller in master
	  mode. LS1021A and ColdFire platforms use the controller.

config DRIVER_SPI_GPIO
	bool "GPIO SPI Master driver"
	depends on GPIOLIB

config DRIVER_SPI_IMX
	bool "i.MX SPI Master driver"
	depends on ARCH_IMX

config DRIVER_SPI_IMX_0_0
	bool
	depends on ARCH_IMX27
	default y

config DRIVER_SPI_IMX_0_7
	bool
	depends on ARCH_IMX25 || ARCH_IMX31 || ARCH_IMX35 || ARCH_IMX50 || ARCH_IMX53
	default y

config DRIVER_SPI_IMX_2_3
	bool
	depends on ARCH_IMX50 || ARCH_IMX51 || ARCH_IMX53 || ARCH_IMX6 || ARCH_IMX7 || ARCH_IMX8M
	default y

config DRIVER_SPI_LITEX_SPIFLASH
	bool "Litex SPIFLASH bitbang master driver"

config DRIVER_SPI_MXS
	bool "i.MX (23,28) SPI Master driver"
	depends on ARCH_IMX28
	select STMP_DEVICE

config DRIVER_SPI_MVEBU
	bool "Marvell MVEBU SoC SPI master driver"
	depends on ARCH_ARMADA_370 || ARCH_ARMADA_XP || ARCH_DOVE || ARCH_KIRKWOOD

config DRIVER_SPI_OMAP3
	bool "OMAP3 McSPI Master driver"
	depends on ARCH_OMAP3 || ARCH_AM33XX

config DRIVER_SPI_DSPI
	tristate "Freescale DSPI SPI Master driver"
	depends on ARCH_VF610
	default y
	help
	  This enables support for the Freescale DSPI controller in master
	  mode. VF610 platform uses the controller.

config SPI_ZYNQ_QSPI
	tristate "Xilinx Zynq QSPI controller"
	depends on ARCH_ZYNQ
	depends on SPI_MEM
	help
	  This enables support for the Zynq Quad SPI controller in master mode.
	  This controller only supports SPI memory interface.

config DRIVER_SPI_STM32
	bool "STM32 SPI driver"
	depends on ARCH_STM32MP || COMPILE_TEST
	help
	  Enable the STM32 Serial Peripheral Interface (SPI) driver for STM32MP
	  SoCs.

config SPI_NXP_FLEXSPI
	tristate "NXP Flex SPI controller"
	depends on ARCH_IMX8M || ARCH_IMX93 || COMPILE_TEST
	help
	  This enables support for the Flex SPI controller in master mode.
	  Up to four slave devices can be connected on two buses with two
	  chipselects each.
	  This controller does not support generic SPI messages and only
	  supports the high-level SPI memory interface.

config SPI_SIFIVE
	tristate "SiFive SPI controller"
	depends on SOC_SIFIVE || COMPILE_TEST
	help
	  This exposes the SPI controller IP from SiFive.

endif

endmenu
```

## drivers/tee/Kconfig
```kconfig
# SPDX-License-Identifier: GPL-2.0-only
# Generic Trusted Execution Environment Configuration
menuconfig TEE
	tristate "Trusted Execution Environment support"
	select ARM_SMCCC
	help
	  This implements a generic interface towards a Trusted Execution
	  Environment (TEE). A TEE is a trusted OS running in some secure
	  environment, for example, TrustZone on ARM cpus, or a separate
	  secure co-processor etc. See also:
	  https://en.wikipedia.org/wiki/Trusted_execution_environment

if TEE

source "drivers/tee/optee/Kconfig"

endif
```

## drivers/tee/optee/Kconfig
```kconfig
# SPDX-License-Identifier: GPL-2.0-only
# OP-TEE Trusted Execution Environment Configuration

if TEE

config OPTEE
	tristate "OP-TEE communication"
	select HAVE_OPTEE
	select ARM_SMCCC
	depends on MMU
	help
	  This driver implements bidirectional communication with the OP-TEE
	  Trusted Execution Environment (TEE). OP-TEE is a Trusted OS designed
	  primarily to rely on the ARM TrustZone(R) technology as the
	  underlying hardware isolation mechanism.
	  This driver can request services from OP-TEE, but doesn't
	  yet provide a supplicant to handle Remote Procedure Calls (RPC).
	  For more information see: https://www.op-tee.org

	  This driver doesn't actually load OP-TEE. For that see
	  CONFIG_BOOTM_OPTEE and PBL_OPTEE.

	  If unsure, say n here.

config OPTEE_DEVFS
	bool "Provide /dev/tee0 interface"
	depends on OPTEE && FS_DEVFS && EXPERIMENTAL
	help
	  Userspace accesses OP-TEE via ioctls and mmaps of the /dev/tee0
	  device. This are no current in-tree users of this interface,
	  but it's useful for compiling libteeclient + optee_tests for
	  use inside barebox to verify proper operation of CONFIG_OPTEE.

config OPTEE_AVB_PERSISTENT_VALUES
	bool "Android Verified Boot (AVB) persistent values support"
	depends on OPTEE
	help
	  AVB 2.0 spec. revision 1.1 introduces support for named persistent values
	  that must be tamper evident and allows AVB to store arbitrary key-value
	  pairs. AVB itself is not implemented in barebox, but enabling this option
	  allows barebox to use the AVB persistent value store.

endif

config OF_FIXUP_OPTEE
	def_bool y
	depends on HAVE_OPTEE && ARM
```

## drivers/usb/Kconfig
```kconfig
# SPDX-License-Identifier: GPL-2.0-only
config USB
	bool

menuconfig USB_HOST
	select USB
	bool "USB Host support"

if USB_HOST

source "drivers/usb/imx/Kconfig"

source "drivers/usb/dwc2/Kconfig"

source "drivers/usb/dwc3/Kconfig"

source "drivers/usb/host/Kconfig"

source "drivers/usb/otg/Kconfig"

source "drivers/usb/storage/Kconfig"

source "drivers/usb/misc/Kconfig"

endif

source "drivers/usb/typec/Kconfig"

source "drivers/usb/gadget/Kconfig"

source "drivers/usb/musb/Kconfig"
```

## drivers/usb/dwc2/Kconfig
```kconfig
# SPDX-License-Identifier: GPL-2.0-only
config USB_DWC2
	bool
	depends on USB && HAS_DMA
	select USB_OTGDEV
	select OFDEVICE
	help
	  DesignWare Core USB2 OTG driver.

config USB_DWC2_HOST
	bool "DWC2 Host mode support"
	depends on USB_HOST
	select USB_DWC2
	help
	  Select this when you want to use DWC2 in host mode.

config USB_DWC2_GADGET
	bool "DWC2 Gadget mode support"
	depends on USB_GADGET
	select USB_DWC2
	help
	  Select this when you want to use DWC2 in gadget mode.
```

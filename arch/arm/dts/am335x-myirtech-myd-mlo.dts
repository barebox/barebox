// SPDX-License-Identifier: GPL-2.0-or-later
/* SPDX-FileCopyrightText: Alexander Shiyan, <shc_work@mail.ru> */

/dts-v1/;

#include "am335x-myirtech-myd.dts"
#include "am33xx-strip.dtsi"
#include "am33xx-clocks-strip.dtsi"

/delete-node/ &{/sound};

/ {
	barebox,disable-deep-probe;
};

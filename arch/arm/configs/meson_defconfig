## arch/arm/configs/meson_defconfig
```kconfig
CONFIG_ARCH_MESON=y
CONFIG_ARCH_MESON_GX=y
CONFIG_ARCH_MESON_G12=y
CONFIG_ARCH_MESON_A9=y
CONFIG_64BIT=y
CONFIG_ARM_OPTIMZED_STRING_FUNCTIONS=y
CONFIG_ARM_PSCI_CLIENT=y
CONFIG_NAME="meson_defconfig"
CONFIG_MMU=y
CONFIG_KALLSYMS=y
CONFIG_PROMPT="barebox> "
CONFIG_HUSH_FANCY_PROMPT=y
CONFIG_CMDLINE_EDITING=y
CONFIG_AUTO_COMPLETE=y
CONFIG_MENU=y
CONFIG_BOOTM_SHOW_TYPE=y
CONFIG_BOOTM_VERBOSE=y
CONFIG_BOOTM_INITRD=y
CONFIG_BOOTM_FITIMAGE=y
CONFIG_BLSPEC=y
CONFIG_CONSOLE_ALLOW_COLOR=y
CONFIG_PARTITION_DISK_EFI=y
CONFIG_DEFAULT_ENVIRONMENT_GENERIC_NEW=y
CONFIG_RESET_SOURCE=y
CONFIG_MACHINE_ID=y
CONFIG_CMD_DMESG=y
CONFIG_LONGHELP=y
CONFIG_CMD_IOMEM=y
CONFIG_CMD_MEMINFO=y
CONFIG_CMD_ARM_MMUINFO=y
CONFIG_CMD_REGULATOR=y
CONFIG_CMD_NVMEM=y
CONFIG_CMD_MMC=y
CONFIG_CMD_MMC_EXTCSD=y
CONFIG_CMD_GO=y
CONFIG_CMD_RESET=y
CONFIG_CMD_PARTITION=y
CONFIG_CMD_EXPORT=y
CONFIG_CMD_DEFAULTENV=y
CONFIG_CMD_LOADENV=y
CONFIG_CMD_PRINTENV=y
CONFIG_CMD_MAGICVAR=y
CONFIG_CMD_MAGICVAR_HELP=y
CONFIG_CMD_SAVEENV=y
CONFIG_CMD_CMP=y
CONFIG_CMD_FILETYPE=y
CONFIG_CMD_LN=y
CONFIG_CMD_MD5SUM=y
CONFIG_CMD_SHA256SUM=y
CONFIG_CMD_UNCOMPRESS=y
CONFIG_CMD_LET=y
CONFIG_CMD_MSLEEP=y
CONFIG_CMD_READF=y
CONFIG_CMD_SLEEP=y
CONFIG_CMD_ECHO_E=y
CONFIG_CMD_EDIT=y
CONFIG_CMD_READLINE=y
CONFIG_CMD_TIMEOUT=y
CONFIG_CMD_CRC=y
CONFIG_CMD_MM=y
CONFIG_CMD_CLK=y
CONFIG_CMD_DETECT=y
CONFIG_CMD_GPIO=y
CONFIG_CMD_LED=y
CONFIG_CMD_SMC=y
CONFIG_CMD_WD=y
CONFIG_CMD_OF_COMPATIBLE=y
CONFIG_CMD_OF_DIFF=y
CONFIG_CMD_OF_NODE=y
CONFIG_CMD_OF_PROPERTY=y
CONFIG_CMD_OF_FIXUP=y
CONFIG_CMD_OF_FIXUP_STATUS=y
CONFIG_CMD_OF_OVERLAY=y
CONFIG_CMD_OFTREE=y
CONFIG_CMD_TIME=y
CONFIG_OF_BAREBOX_DRIVERS=y
CONFIG_OF_OVERLAY_LIVE=y
CONFIG_MCI=y
CONFIG_MCI_TUNING=y
CONFIG_MCI_STARTUP=y
CONFIG_MCI_MMC_BOOT_PARTITIONS=y
CONFIG_MCI_MESON_GX=y
CONFIG_LED=y
CONFIG_LED_GPIO=y
CONFIG_LED_GPIO_OF=y
CONFIG_WATCHDOG=y
CONFIG_WATCHDOG_POLLER=y
CONFIG_WATCHDOG_MESON_GXBB=y
CONFIG_NVMEM=y
CONFIG_NVMEM_MESON_EFUSE=y
CONFIG_REGULATOR=y
CONFIG_REGULATOR_FIXED=y
CONFIG_ARM_SCMI_PROTOCOL=y
CONFIG_MESON_CLK_MEASURE=y
CONFIG_FS_EXT4=y
CONFIG_FS_FAT=y
CONFIG_FS_FAT_WRITE=y
CONFIG_DIGEST_SHA1_GENERIC=y
CONFIG_ZSTD_DECOMPRESS=y
```

## arch/arm/mach-meson/Kconfig
```kconfig
# SPDX-License-Identifier: GPL-2.0-only

if ARCH_MESON

config ARCH_MESON_GX
	bool "Amlogic Meson GXBB, GXL and GXM"
	help
	  Say Y here to support the Amlogic GXBB (S905), GXL (S905X, S905D,
	  S905W, S805X, S805Y) and GXM (S912) SoCs. barebox is started as
	  BL33 by the vendor firmware, as barebox-dt-2nd.img with the
	  board's device tree appended.

config ARCH_MESON_G12
	bool "Amlogic Meson G12A, G12B and SM1"
	help
	  Say Y here to support the Amlogic G12A, G12B and SM1 SoCs. barebox
	  is started as BL33 by the vendor firmware, as barebox-dt-2nd.img
	  with the board's device tree appended.

endif
```

## arch/arm/mach-pxa/Kconfig
```kconfig
# SPDX-License-Identifier: GPL-2.0-only

if ARCH_PXA

# ----------------------------------------------------------

config ARCH_PXA3XX
	bool
	select CPU_XSC3
	select HAVE_CLK
	select COMMON_CLK
	select COMMON_CLK_OF_PROVIDER

config ARCH_PXA300
	bool
	select ARCH_PXA3XX

config ARCH_PXA310
	bool
	select ARCH_PXA3XX

config BAREBOX_UPDATE_PXA_NAND
	prompt "barebox update NAND handler"
	bool
	depends on ARCH_PXA3XX && BAREBOX_UPDATE && MTD
	help
	  Say Y here for an update handler that writes the image built by
	  scripts/pxa-image - the NTIM header, the OBM and barebox - to the
	  mtd partition the Boot ROM boots from.

comment "Intel/Marvell PXA boards"

config MACH_RAUMFELD_SPEAKER
	bool "Raumfeld Speaker"
	select ARCH_PXA300
	help
	  Say Y here if you are using the Raumfeld Speaker, a PXA303
	  based WLAN speaker. The Boot ROM loads barebox from NAND, so
	  it does the pinmuxing, clock and DRAM setup itself.

endif
```

## arch/arm/mach-socfpga/Kconfig
```kconfig
# SPDX-License-Identifier: GPL-2.0-only

menu "SoCFPGA Features"
	depends on ARCH_SOCFPGA

config ARCH_SOCFPGA_CYCLONE5
	bool
	select CPU_V7
	select ARM_SMP_TWD
	select OFDEVICE if !ARCH_SOCFPGA_XLOAD
	select OFTREE if !ARCH_SOCFPGA_XLOAD
	select GPIOLIB if !ARCH_SOCFPGA_XLOAD

config ARCH_SOCFPGA_ARRIA10
	bool
	select CPU_V7
	select ARM_SMP_TWD
	select RESET_CONTROLLER
	select OFDEVICE
	select OFTREE
	select MCI_DW_PBL

config ARCH_SOCFPGA_AGILEX5
	bool
	select CPU_V8
	select RESET_CONTROLLER
	select RESET_SIMPLE
	select OFDEVICE
	select OFTREE
	select FIRMWARE_AGILEX5_ATF
	select ARM_ATF
	select ARM_SMCCC
	select GPIOLIB

if 32BIT

comment "Cyclone V boards"

config MACH_SOCFPGA_ALTERA_SOCDK
	select ARCH_SOCFPGA_CYCLONE5
	bool "Altera SoCFPGA Development Kit"

config MACH_SOCFPGA_EBV_SOCRATES
	select ARCH_SOCFPGA_CYCLONE5
	bool "EBV Socrates"

config MACH_SOCFPGA_ENCLUSTRA_SA2
	select ARCH_SOCFPGA_CYCLONE5
	bool "Enclustra SA2"

config MACH_SOCFPGA_ENCLUSTRA_SA2_SI5338
	depends on MACH_SOCFPGA_ENCLUSTRA_SA2
	bool "Configure the SI5338 clock generator on ST1 baseboard"

config MACH_SOCFPGA_TERASIC_DE0_NANO_SOC
	select ARCH_SOCFPGA_CYCLONE5
	bool "Terasic DE0-NANO-SoC aka Atlas"

config MACH_SOCFPGA_TERASIC_DE10_NANO
	select ARCH_SOCFPGA_CYCLONE5
	bool "Terasic DE10-NANO"

config MACH_SOCFPGA_TERASIC_SOCKIT
	select ARCH_SOCFPGA_CYCLONE5
	bool "Terasic SoCKit"

comment "Arria 10 boards"

config MACH_SOCFPGA_ENCLUSTRA_AA1
	select ARCH_SOCFPGA_ARRIA10
	bool "Enclustra AA1"

config MACH_SOCFPGA_REFLEX_ACHILLES
	select ARCH_SOCFPGA_ARRIA10
	bool "Reflex Achilles"

endif

if 64BIT

comment "Agilex 5 boards"

menuconfig MACH_SOCFPGA_ARROW_AXE5_EAGLE
	bool "Arrow AXE5 Eagle"
	select ARCH_SOCFPGA_AGILEX5

config MACH_SOCFPGA_ARROW_AXE5_EAGLE_XLOAD
	bool "Build Arrow AXE5 Eagle FSBL without piggy data"
	depends on MACH_SOCFPGA_ARROW_AXE5_EAGLE
	select SOCFPGA_AGILEX5_XLOAD
	select SPI_CADENCE_QUADSPI_PBL
	help
	  This option reduces the binary size of the FSBL and makes it
	  independent of the enabled features of the SSBL, but requires SSBL
	  xload support.

config MACH_SOCFPGA_ARROW_AXE5_EAGLE_XLOAD_ADDR
	prompt "Start address of the Arrow AXE5 SSBL on flash"
	hex
	default 0x01000000
	help
	  barebox tries to load an SSBL from this address in the QSPI flash.

	  Keep this address in sync with your QSPI image configuration.

config MACH_SOCFPGA_ARROW_AXE5_EAGLE_XLOAD_SIZE
	prompt "Maximum size of the Arrow AXE5 SSBL on flash"
	hex
	default 0x00400000
	help
	  The maximum size of the SSBL in the QSPI flash.

	  Keep this size in sync with your QSPI image configuration.

endif

comment "board features"

config ARCH_SOCFPGA_XLOAD
	bool
	depends on ARCH_SOCFPGA_CYCLONE5
	prompt "Build SoCFPGA preloader image"

config SOCFPGA_AGILEX5_XLOAD
	bool
	depends on ARCH_SOCFPGA_AGILEX5
	prompt "Support SSBL xloading on Agilex 5"
	help
	  On Agilex 5, the FSBL binary is limited to a size of ~256k. Enable
	  XLOAD support to load the SSBL from a separate medium and allow
	  larger bootloader images.

	  Note that the SSBL loading has to be configured in the board code.

endmenu
```

## arch/arm/mach-sunxi/Kconfig
```kconfig
config MACH_REDBOXMINI
	bool "RedBox Mini TV Box (Allwinner H5)"
	select ARCH_ALLWINNER_SUN50I_H5
	help
	  Say Y here if you are using the RedBox Mini TV Box.
```

## drivers/block/dm/Kconfig
```kconfig
menuconfig DM_BLK
	bool "Device mapper"
	help
	  Composable virtual block devices made up of mappings to
	  other data sources. Modeled after, and intended to be
	  compatible with, the Linux kernel's device mapper subsystem.

config DM_BLK_LINEAR
	bool "Linear target"
	depends on DM_BLK
	help
	  Maps a contiguous region of an existing device into a dm
	  device.

config DM_BLK_VERITY
	bool "Verity target"
	depends on DM_BLK
	help
	  Transparent integrity checking of underlying device using a
	  pre-computed Merkle tree.

config DM_LVM
	bool "LVM2 support"
	depends on DM_BLK_LINEAR
	select QSORT
	help
	  Support for the Logical Volume Manager (LVM2) on-disk format.
	  Parses the metadata of physical volumes to assemble volume
	  groups and lets logical volumes be activated as device mapper
	  devices. Only linear logical volumes are currently supported.
```

## drivers/clk/meson/Kconfig
```kconfig
# SPDX-License-Identifier: GPL-2.0-only

config COMMON_CLK_MESON_REGMAP
	bool
	select MFD_SYSCON

config COMMON_CLK_MESON_DUALDIV
	bool
	select COMMON_CLK_MESON_REGMAP

config COMMON_CLK_MESON_MPLL
	bool
	select COMMON_CLK_MESON_REGMAP

config COMMON_CLK_MESON_PLL
	bool
	select COMMON_CLK_MESON_REGMAP

config COMMON_CLK_MESON_VID_PLL_DIV
	bool
	select COMMON_CLK_MESON_REGMAP

config COMMON_CLK_MESON_VCLK
	bool
	select COMMON_CLK_MESON_REGMAP

config COMMON_CLK_MESON_CLKC_UTILS
	bool
	select MFD_SYSCON

config COMMON_CLK_MESON_AO_CLKC
	bool
	select COMMON_CLK_MESON_REGMAP
	select COMMON_CLK_MESON_CLKC_UTILS
	select RESET_CONTROLLER

config COMMON_CLK_MESON_CPU_DYNDIV
	bool
	select COMMON_CLK_MESON_REGMAP

config COMMON_CLK_MESON_GXBB
	bool "Amlogic Meson GXBB/GXL/GXM clock controllers"
	depends on COMMON_CLK_OF_PROVIDER
	depends on ARCH_MESON || COMPILE_TEST
	default ARCH_MESON_GX
	select COMMON_CLK_MESON_REGMAP
	select COMMON_CLK_MESON_CLKC_UTILS
	select COMMON_CLK_MESON_DUALDIV
	select COMMON_CLK_MESON_VID_PLL_DIV
	select COMMON_CLK_MESON_MPLL
	select COMMON_CLK_MESON_PLL
	select COMMON_CLK_MESON_AO_CLKC
	select MFD_SYSCON
	help
	  Support for the Always-On and main clock controllers of the
	  Amlogic GXBB (S905), GXL (S905X/D/W, S805X/Y) and GXM (S912)
	  SoCs.

config COMMON_CLK_MESON_G12A
	bool "Amlogic Meson G12A/G12B/SM1 clock controllers"
	depends on COMMON_CLK_OF_PROVIDER
	depends on ARCH_MESON || COMPILE_TEST
	default ARCH_MESON_G12
	select COMMON_CLK_MESON_REGMAP
	select COMMON_CLK_MESON_CLKC_UTILS
	select COMMON_CLK_MESON_DUALDIV
	select COMMON_CLK_MESON_MPLL
	select COMMON_CLK_MESON_PLL
	select COMMON_CLK_MESON_AO_CLKC
	select COMMON_CLK_MESON_CPU_DYNDIV
	select COMMON_CLK_MESON_VID_PLL_DIV
	select COMMON_CLK_MESON_VCLK
	select MFD_SYSCON
	help
	  Support for the Always-On and main clock controllers of the
	  Amlogic G12A (S905X2/D2), G12B (S922X, A311D) and SM1
	  (S905X3/D3) SoCs.
```

## drivers/net/usb/Kconfig
```kconfig
# SPDX-License-Identifier: GPL-2.0-only
menuconfig NET_USB
	depends on USB_HOST
	select PHYLIB
	bool "USB network support"

if NET_USB

config NET_USB_ASIX
	bool "Asix compatible"

config USB_NET_AX88179_178A
	tristate "ASIX AX88179/178A USB 3.0/2.0 to Gigabit Ethernet"
	help
	  This option adds support for ASIX AX88179 based USB 3.0/2.0
	  to Gigabit Ethernet adapters.

	  This driver should work with at least the following devices:
	    * ASIX AX88179
	    * ASIX AX88178A
	    * Sitcomm LN-032

config NET_USB_SMSC95XX
	bool "SMSC95xx"

config NET_USB_RTL8152
	bool "Realtek RTL8152B/RTL8153 support"
	help
	  Say Y here if you would like to support Realtek RTL8152B/RTL8153 base
	  USB Ethernet Devices. This driver also supports compatible devices
	  from Samsung, Lenovo, TP-LINK and Nvidia.

config NET_USB_CDC_EEM
	bool "CDC EEM (Ethernet Emulation Model) support"
	select CRC32
	help
	  This option adds host-side support for USB CDC EEM (Ethernet
	  Emulation Model) devices. EEM is a simpler alternative to
	  CDC ECM for USB Ethernet, requiring only bulk endpoints.

endif
```

## drivers/pinctrl/meson/Kconfig
```kconfig
# SPDX-License-Identifier: GPL-2.0-only
menuconfig PINCTRL_MESON
	bool "Amlogic SoC pinctrl drivers"
	depends on ARCH_MESON || COMPILE_TEST
	depends on OFDEVICE
	default ARCH_MESON
	select GENERIC_PINCONF
	select GPIOLIB
	select OF_GPIO
	select HAVE_GPIO_PINCONF

if PINCTRL_MESON

config PINCTRL_MESON_AXG_PMX
	bool

config PINCTRL_MESON_G12A
	bool "Meson g12a Soc pinctrl driver"
	depends on ARM64 || COMPILE_TEST
	select PINCTRL_MESON_AXG_PMX
	default ARCH_MESON

config PINCTRL_AMLOGIC_A4
	bool "AMLOGIC pincontrol"
	depends on ARM64 || COMPILE_TEST
	default ARCH_MESON
	help
	  This is the driver for the pin controller found on Amlogic SoCs.

	  This driver is simplify subsequent support for new amlogic SoCs,
	  to support new Amlogic SoCs, only need to add the corresponding dts file,
	  no additional binding header files or C file are added.

endif
```

## drivers/soc/amlogic/Kconfig
```kconfig
# SPDX-License-Identifier: GPL-2.0-only
menu "Amlogic SoC drivers"

config MESON_CLK_MEASURE
	bool "Amlogic Meson SoC Clock Measure driver"
	depends on ARCH_MESON || COMPILE_TEST
	help
	  Say yes to support measuring a set of internal SoC clocks.
	  devinfo on the clock-measure device lists their rates.

config MESON_GX_SOCINFO
	bool "Amlogic Meson GX SoC Information driver"
	depends on ARCH_MESON || COMPILE_TEST
	default ARCH_MESON
	select MFD_SYSCON
	select SOC_BUS
	help
	  Say yes to support decoding of Amlogic Meson GX SoC family
	  information about the type, package and version.

endmenu
```

## drivers/usb/host/Kconfig
```kconfig
# SPDX-License-Identifier: GPL-2.0-only
config USB_EHCI
	bool "EHCI driver"
	depends on HAS_DMA

config USB_EHCI_OMAP
	depends on ARCH_OMAP3
	depends on USB_TWL4030
	bool "OMAP EHCI driver"

config USB_EHCI_ATMEL
	depends on ARCH_AT91
	depends on USB_EHCI
	select USB_OHCI_AT91
	bool "Atmel EHCI driver"

config USB_EHCI_ZYNQ
	bool "Support for Xilinx Zynq on-chip EHCI USB controller"
	depends on ARCH_ZYNQ
	depends on USB_EHCI
	select USB_ULPI
	help
	  Enable support for Zynq on-chip EHCI USB controller

config USB_EFI_IO_PROTOCOL
	bool "EFI USB I/O Protocol"
	depends on EFI_PAYLOAD
	help
	  Enable support for usb devices, initialized by the UEFI BIOS.
	  Use this with caution, as devices may afterwards have multiple drivers.
	  For example can a USB-Stick be treated as an IO Blockdevice by UEFI and
	  have a driver for it, but can also be initiated as a USB-Storage device,
	  which could lead to errors in handling the USB-Device.

config USB_OHCI
	bool "OHCI driver"
	depends on !MMU && HAS_DMA

config USB_OHCI_AT91
	depends on ARCH_AT91
	bool "AT91 OHCI driver"

config USB_XHCI
	bool "xHCI driver"
	depends on HAS_DMA
	help
	  The eXtensible Host Controller Interface (xHCI) is standard for
	  USB 3.0 "SuperSpeed" host controller hardware. xHCI specification
	  defines support for all USB device speeds from USB 3.0 down to
	  USB 1.1 without the need for companion controllers.

	  This driver currently only supports virtual USB 2.0 ports, if you
	  plan to use USB 3.0 devices, use a USB 2.0 cable in between.

config USB_XHCI_PCI
	tristate "xHCI over PCI driver"
	depends on USB_XHCI && PCI
	help
	  Say y here if your USB 3.0 controller is connected via PCI and
	  you wish to access the USB devices on the bus from barebox.
```

## drivers/usb/misc/Kconfig
```kconfig
# SPDX-License-Identifier: GPL-2.0-only
#
# USB Miscellaneous driver configuration
#
comment "USB Miscellaneous drivers"

config USB_HUB_USB251XB
	bool "USB251XB Hub Controller Configuration Driver"
	depends on I2C
	depends on OFDEVICE
	select NLS
	help
	  This option enables support for configuration via SMBus of the
	  Microchip USB251x/xBi USB 2.0 Hub Controller series. Configuration
	  parameters may be set in devicetree or platform data.
	  Say Y or M here if you need to configure such a device via SMBus.

config USB_ONBOARD_DEV
	bool "Onboard USB hubs and devices support"
	depends on OFDEVICE || COMPILE_TEST
	help
	  Say Y here if you want to support discrete onboard USB hubs
	  that don't require an additional control bus for initialization,
	  but need some non-trivial form of initialization, such as
	  enabling a power regulator. An example for such device is the
	  Realtek RTS5411 hub.

config USB_ONBOARD_DEV_USB5744
	bool "Onboard USB Microchip usb5744 hub with SMBus support"
	depends on USB_ONBOARD_DEV && I2C
	help
	  Say Y here if you want to support onboard USB Microchip usb5744
	  hub that requires SMBus initialization.

	  This options enables usb5744 i2c default initialization sequence
	  during hub start-up configuration stage. Without it, a hub that
	  has an i2c-bus is not powered.
```

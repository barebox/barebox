## drivers/usb/dwc3/Kconfig
```kconfig
config USB_DWC3
	tristate "DesignWare USB3 DRD Core Support"
	depends on USB && HAS_DMA
	select USB_XHCI
	help
	  Say Y or M here if your system has a Dual Role SuperSpeed
	  USB controller based on the DesignWare USB3 IP Core.

	  If you choose to build this driver is a dynamically linked
	  module, the module will be called dwc3.ko.

if USB_DWC3

choice
	bool "DWC3 Mode Selection"

config USB_DWC3_HOST
	bool "Host only mode"
	help
	  Select this when you want to use DWC3 in host mode only,
	  thereby the gadget feature will be regressed.

config USB_DWC3_GADGET
	bool "Gadget only mode"
	depends on USB_GADGET
	help
	  Select this when you want to use DWC3 in gadget mode only,
	  thereby the host feature will be regressed.

config USB_DWC3_DUAL_ROLE
	bool "Dual Role mode"
	help
	  This is the default mode of working of DWC3 controller where
	  both host and gadget features are enabled.

endchoice

config USB_DWC3_OF_SIMPLE
	tristate "Generic OF Simple Glue Layer"
	depends on COMMON_CLK
	default USB_DWC3
	help
	 Support USB2/3 functionality in simple SoC integrations.
	 Currently supports Xilinx and Qualcomm DWC USB3 IP.
	 Say 'Y' or 'M' if you have one such device.

endif
```

## drivers/usb/gadget/Kconfig
```kconfig
# SPDX-License-Identifier: GPL-2.0-only
menuconfig USB_GADGET
	select USB
	select POLLER
	select NLS
	bool "USB gadget support"

if USB_GADGET

config USB_GADGET_DUALSPEED
	bool

config USB_GADGET_DRIVER_ARC
	bool
	prompt "Arc OTG device core"
	depends on ARCH_IMX || ARCH_MXS
	default y
	select USB_GADGET_DUALSPEED

config USB_GADGET_DRIVER_AT91
	bool
	prompt "at91 gadget driver"
	depends on ARCH_AT91
	default y
	select USB_GADGET_DUALSPEED

config USB_GADGET_DRIVER_PXA27X
	bool
	prompt "PXA27x gadget driver"
	depends on ARCH_PXA27X
	default y
	select USB_GADGET_DUALSPEED

config USB_GADGET_AUTOSTART
	bool
	default y
	prompt "Automatically start usbgadget on boot"
	depends on GLOBALVAR
	select SYSTEM_PARTITIONS if USB_GADGET_MASS_STORAGE
	help
	  Enabling this option allows to automatically start a dfu or
	  fastboot gadget during boot. This behaviour is controlled with
	  the global.usbgadget.dfu_function, global.system.partitions
	  and global.fastboot.* variables.

comment "USB Gadget drivers"

config USB_GADGET_DFU
	bool
	prompt "Device Firmware Update Gadget"

config USB_GADGET_SERIAL
	bool
	depends on !CONSOLE_NONE
	prompt "Serial Gadget"

config USB_GADGET_FASTBOOT
	bool
	select BANNER
	select FASTBOOT_BASE
	prompt "Android Fastboot USB Gadget"

config USB_GADGET_MASS_STORAGE
	bool
	select BTHREAD
	prompt "USB Mass Storage Gadget"
	help
	  The Mass Storage Gadget acts as a USB Mass Storage disk drive.
	  As its storage repository it can use a regular file or a block
	  device. Multiple storages can be specified at once on
	  instantiation time.

endif
```

## drivers/usb/imx/Kconfig
```kconfig
config USB_IMX_CHIPIDEA
	bool "i.MX USB support (read help)"
	depends on ARCH_IMX
	help
	  The Freescale i.MX SoCs have a variant of the chipidea ci13xxx for
	  USB support. Traditionally in barebox this is supported through the
	  EHCI driver for USB host and the ARC USB gadget driver for device.
	  This option instead enables support for i.MX chipidea support which
	  acts as a toplevel driver for the i.MX USB support. The chipidea
	  support also configures the usbmisc registers which traditionally
	  are configured in the board file.
	  This driver is recommended for new designs, but it needs board
	  support to work.
	  It's safe to say yes here. Also select EHCI support for USB host.

config USB_IMX_PHY
	bool
	default y if ARCH_IMX6 && GENERIC_PHY
```

## drivers/usb/musb/Kconfig
```kconfig
config USB_MUSB
	bool "MUSB support"

if USB_MUSB

config USB_MUSB_DSPS
	tristate
	select OFDEVICE

config USB_MUSB_AM335X
	tristate "AM335x USB support"
	depends on ARCH_AM33XX
	select USB_MUSB_DSPS
	help
	  This driver provides the necessary bit to enable USB support
	  on the TI AM335x SoC.

config USB_MUSB_HOST
	bool "MUSB Host mode support"
	depends on USB_HOST
	help
	  Select this when you want to use MUSB in host mode.

config USB_MUSB_GADGET
	bool "MUSB Gadget mode support"
	depends on USB_GADGET
	help
	  Select this when you want to use MUSB in gadget mode.

endif
```

## drivers/usb/otg/Kconfig
```kconfig
# SPDX-License-Identifier: GPL-2.0
config USB_ULPI
	bool "ULPI Transceiver support"
	help
	  Support for transceivers that conforms ULPI specification.

config USB_TWL4030
	depends on MFD_TWL4030
	bool "TWL4030 Transceiver support"

config USB_OTGDEV
	bool
```

## drivers/usb/storage/Kconfig
```kconfig
# SPDX-License-Identifier: GPL-2.0-only
config USB_STORAGE
	tristate "USB Mass Storage support"
	select DISK
```

## drivers/usb/typec/Kconfig
```kconfig
# SPDX-License-Identifier: GPL-2.0-only


config TYPEC
	prompt "Compile USB Type-C framework support" if COMPILE_TEST
	bool

config TYPEC_TUSB320
	tristate "TI TUSB320 Type-C port controller"
	depends on I2C
	select REGMAP_I2C
	select TYPEC
	help
	  Say Y or here if your system has a TI TUSB320 Type-C port controller.
```

## drivers/video/Kconfig
```kconfig
# SPDX-License-Identifier: GPL-2.0-only
menuconfig VIDEO
	bool "Video drivers"
	help
	  Add support for framebuffer and splash screens

if VIDEO

config FRAMEBUFFER_CONSOLE
	bool
	depends on !CONSOLE_NONE
	select IMAGE_RENDERER
	select FONTS
	prompt "framebuffer console support"

config DRIVER_VIDEO_FB_SSD1307
	bool "Solomon SSD1307 framebuffer support"
	depends on (I2C || SPI) && GPIOLIB

config VIDEO_VPL
	depends on OFTREE
	bool

config DRIVER_VIDEO_ATMEL
	bool "Atmel LCDC framebuffer driver"
	depends on ARCH_AT91

config DRIVER_VIDEO_ATMEL_HLCD
	bool "Atmel HLCDC framebuffer driver"
	depends on ARCH_AT91

config DRIVER_VIDEO_EFI_GOP
	bool "EFI Graphics Output Protocol (GOP)"
	depends on EFI_PAYLOAD
	depends on X86

config DRIVER_VIDEO_IMX
	bool "i.MX framebuffer driver"
	depends on ARCH_IMX1 || ARCH_IMX21 || ARCH_IMX25 || ARCH_IMX27

config IMXFB_DRIVER_VIDEO_IMX_OVERLAY
	bool "i.MX framebuffer overlay support"
	depends on DRIVER_VIDEO_IMX && (ARCH_IMX27 || ARCH_IMX25 || ARCH_IMX21)

config DRIVER_VIDEO_IMX_IPU
	bool "i.MX31/35 framebuffer driver"
	depends on ARCH_IMX35 || ARCH_IMX31
	help
	  Add support for the IPU framebuffer device found on
	  i.MX31 and i.MX35 CPUs.

config DRIVER_VIDEO_IMX_IPU_OVERLAY
	bool "i.MX31/35 framebuffer overlay support"
	depends on DRIVER_VIDEO_IMX_IPU && (ARCH_IMX35 || ARCH_IMX31)

config DRIVER_VIDEO_STM
	bool "i.MX23/28 framebuffer driver"
	depends on ARCH_MXS
	help
	  Say 'Y' here to enable framebuffer and splash screen support for
	  i.MX23 and i.MX28 based systems.

config DRIVER_VIDEO_STM32_LTDC
	bool "STM32 LTDC framebuffer driver"
	select VIDEO_VPL
	depends on ARCH_STM32 || COMPILE_TEST
	help
	  Say 'Y' here to enable framebuffer and splash screen support for
	  STM32 and STM32MP1.

config DRIVER_VIDEO_OMAP
	bool "OMAP framebuffer driver"
	depends on ARCH_OMAP4 || COMPILE_TEST
	help
	  Add support for OMAP Display Controller. Currently this
	  driver only supports OMAP4 SoCs in DISPC parallel mode on
	  LCD2 (MIPI DPI).

config DRIVER_VIDEO_SDL
	bool "SDL framebuffer driver"
	depends on SANDBOX
	select SDL

config DRIVER_VIDEO_PXA
	bool "PXA27x framebuffer driver"
	depends on ARCH_PXA27X
	help
	  Add support for the frame buffer device found on the PXA270
	  CPU.

config DRIVER_VIDEO_BCM283X
	bool "BCM283X framebuffer driver"
	depends on ARCH_BCM283X
	help
	  Add support for the BCM283X/VideoCore frame buffer device.

source "drivers/video/imx-ipu-v3/Kconfig"

source "drivers/video/bochs/Kconfig"

config DRIVER_VIDEO_SIMPLEFB_CLIENT
	bool "Simple framebuffer client support"
	depends on OFTREE
	help
	  Add support for reusing a previously set up simple framebuffer.

config DRIVER_VIDEO_SIMPLEFB
	bool "Simple framebuffer fixup support"
	depends on OFTREE
	help
	  Add support for setting up the kernel's simple framebuffer driver
	  based on the active barebox framebuffer.

config DRIVER_VIDEO_RAMFB
	bool "QEMU RamFB support"
	select QEMU_FW_CFG
	help
	  Add support for setting up a QEMU RamFB driver.

config DRIVER_VIDEO_EDID
	bool "Add EDID support"
	help
	  This enabled support for reading and parsing EDID data from an attached
	  monitor.

config DRIVER_VIDEO_MIPI_DBI
	bool

config DRIVER_VIDEO_BACKLIGHT
	bool "Add backlight support"
	help
	  Enable this for backlight support.

config DRIVER_VIDEO_BACKLIGHT_PWM
	bool "PWM backlight support"
	depends on PWM && GPIOLIB
	depends on DRIVER_VIDEO_BACKLIGHT
	help
	  Enable this to get support for backlight devices driven by a PWM.

config BACKLIGHT_RAVE_SP
	tristate "RAVE SP Backlight driver"
	depends on RAVE_SP_CORE
	depends on DRIVER_VIDEO_BACKLIGHT
	help
	  Support for backlight control on RAVE SP device.

comment "Video encoder chips"

config DRIVER_VIDEO_MTL017
	bool "MTL017 LVDS encoder"
	select VIDEO_VPL
	depends on I2C
	depends on OFTREE
	help
	  The MTL017 is a parallel to lvds video encoder chip found on the
	  Efika MX Smartbook.

config DRIVER_VIDEO_TC358767
	bool "TC358767A Display Port encoder"
	select VIDEO_VPL
	depends on DRIVER_VIDEO_EDID
	depends on I2C
	depends on OFTREE
	help
	  The TC358767A is a DSI/DPI to eDP video encoder chip

config DRIVER_VIDEO_SIMPLE_PANEL
	bool "Simple panel support"
	select VIDEO_VPL
	depends on OFTREE && OFDEVICE
	help
	  This enabled support for simple panels, i.e. panels which consist of
	  a mode definition and enable gpios in the devicetree. Unlike the
	  Linux Kernel implementation this one is able to understand display-timings
	  nodes so that it's not necessary to keep a list of all known displays
	  with their corresponding timings in barebox.

config DRIVER_VIDEO_PANEL_ILITEK_ILI9341
	tristate "Ilitek ILI9341 240x320 QVGA panels"
	depends on OFTREE && SPI
	select DRIVER_VIDEO_MIPI_DBI
	select VIDEO_VPL
	help
	  Say Y here if you want to enable support for Ilitek IL9341
	  QVGA (240x320) RGB panels. support serial & parallel rgb
	  interface.

config DRIVER_VIDEO_PANEL_SITRONIX_ST7789V
	tristate "Sitronix ST7789V panel"
	depends on OFTREE && SPI
	select VIDEO_VPL
	help
	  Say Y here if you want to enable support for the Sitronix
	  ST7789V controller for 240x320 LCD panels

config DRIVER_VIDEO_PANEL_MIPI_DBI
	tristate "DRM support for MIPI DBI compatible panels"
	depends on OFTREE && SPI
	select DRIVER_VIDEO_MIPI_DBI
	select FIRMWARE
	select VIDEO_VPL
	help
          Say Y here if you want to enable support for MIPI DBI compatible
          panels. The controller command setup can be provided using a
          firmware file. For more information see
          https://github.com/notro/panel-mipi-dbi/wiki.

config DRIVER_VIDEO_DW_HDMI
	tristate "Designware HDMI support"
	select VIDEO_VPL
	select OFTREE
	help
	  Say Y here if you want to enable support for the Designware HDMI
	  controller. To make use of this driver you need platform specific
	  glue code to be selected as well.

endif
```

## drivers/video/bochs/Kconfig
```kconfig
# SPDX-License-Identifier: GPL-2.0-only

config DRIVER_VIDEO_BOCHS
	select DRIVER_VIDEO_EDID
	bool

config DRIVER_VIDEO_BOCHS_PCI
	bool "bochs dispi / QEMU standard VGA PCI driver"
	select DRIVER_VIDEO_BOCHS
	depends on PCI
	help
	  Say yes here if you have a PCI VGA display controller that
	  implements the bochs dispi VBE extension. This is a very simple
	  interface to drive the graphical output of virtual machines
	  like bochs, VirtualBox and Qemu (-device VGA).

config DRIVER_VIDEO_BOCHS_ISA
	bool "bochs dispi / QEMU standard VGA ISA driver"
	select DRIVER_VIDEO_BOCHS
	help
	  Say yes here if you have a ISA (I/O ports) VGA display controller that
	  implements the bochs dispi VBE extension. This is a very simple
	  interface to drive the graphical output of virtual machines
	  like bochs, VirtualBox and Qemu (-device isa-vga).
```

## drivers/video/imx-ipu-v3/Kconfig
```kconfig
# SPDX-License-Identifier: GPL-2.0-only
config DRIVER_VIDEO_IMX_IPUV3
	bool "i.MX IPUv3 driver"
	depends on ARCH_IMX
	select VIDEO_VPL
	select OFTREE
	help
	  Support the IPUv3 found on Freescale i.MX51/53/6 SoCs

if DRIVER_VIDEO_IMX_IPUV3

config DRIVER_VIDEO_IMX_IPUV3_LVDS
	bool "IPUv3 LVDS support"
	select OFDEVICE

config DRIVER_VIDEO_IMX_IPUV3_HDMI
	bool "IPUv3 HDMI support"
	select DRIVER_VIDEO_EDID
	select DRIVER_VIDEO_DW_HDMI
	select OFDEVICE

config DRIVER_VIDEO_IMX_IPUV3_PARALLEL
	bool "IPUv3 parallel display support"
	select OFDEVICE

endif
```

## drivers/video/rockchip/Kconfig
```kconfig
config DRIVER_VIDEO_ROCKCHIP
	bool "Rockchip framebuffer drivers"

if DRIVER_VIDEO_ROCKCHIP

config DRIVER_VIDEO_ROCKCHIP_VOP2
        bool "Rockchip vop2 framebuffer driver"
        select VIDEO_VPL
        select OFTREE

config DRIVER_VIDEO_ROCKCHIP_HDMI
        bool "Rockchip HDMI driver"
        select VIDEO_VPL
        select OFTREE
        select DRIVER_VIDEO_EDID
        select DRIVER_VIDEO_DW_HDMI

endif
```

## drivers/virtio/Kconfig
```kconfig
# SPDX-License-Identifier: GPL-2.0-only
config VIRTIO
	bool
	help
	  This option is selected by any driver which implements the virtio
	  bus, such as CONFIG_VIRTIO_MMIO, CONFIG_VIRTIO_PCI.

config ARCH_HAS_RESTRICTED_VIRTIO_MEMORY_ACCESS
	bool
	help
	  This option is selected if the architecture may need to enforce
	  VIRTIO_F_ACCESS_PLATFORM

menuconfig VIRTIO_MENU
	bool "Virtio drivers"
	default y

if VIRTIO_MENU

config VIRTIO_MMIO
	bool "Platform bus driver for memory mapped virtio devices"
	depends on HAS_DMA
	select VIRTIO
	help
	 This drivers provides support for memory mapped virtio
	 platform device driver. This is usually used with Qemu.

config VIRTIO_PCI
	tristate "PCI driver for virtio devices"
	depends on PCI && HAS_DMA
	select VIRTIO
	help
	  This driver provides support for virtio based paravirtual device
	  drivers over PCI. This requires that your VMM has appropriate PCI
	  virtio backends.  Most QEMU based VMMs should support these devices
	  (like KVM or Xen).

endif # VIRTIO_MENU
```

## arch/arm/mach-tegra/Kconfig
```kconfig
# SPDX-License-Identifier: GPL-2.0-only

if ARCH_TEGRA

# ---------------------------------------------------------

config ARCH_TEGRA_2x_SOC
	bool

config ARCH_TEGRA_3x_SOC
	bool

config ARCH_TEGRA_124_SOC
	bool

menu "select Tegra boards to be built"

config MACH_TORADEX_COLIBRI_T20
	bool "Toradex Colibri T20"
	select ARCH_TEGRA_2x_SOC

config MACH_TOSHIBA_AC100
	bool "Toshiba AC100"
	select ARCH_TEGRA_2x_SOC

config MACH_NVIDIA_BEAVER
	bool "NVIDIA Beaver"
	select ARCH_TEGRA_3x_SOC
	select I2C
	select I2C_TEGRA

config MACH_NVIDIA_JETSON
	bool "NVIDIA Jetson TK1"
	select ARCH_TEGRA_124_SOC
	select I2C
	select I2C_TEGRA

endmenu

# ---------------------------------------------------------

endif
```

## arch/arm/mach-uemd/Kconfig
```kconfig
if ARCH_UEMD

config ARCH_TEXT_BASE
	hex
	default 0x40800000

choice
	prompt "UEMD Board type"

config MACH_MB7707
	bool "MB7707"

endchoice

endif
```

## arch/arm/mach-versatile/Kconfig
```kconfig
# SPDX-License-Identifier: GPL-2.0-only

if ARCH_VERSATILE

config MACH_VERSATILEPB
	bool
	default y
	select ARM_AMBA
	select CPU_ARM926T
	select CPU_ARM1176

source "arch/arm/boards/versatile/Kconfig"

endif
```

## arch/arm/mach-vexpress/Kconfig
```kconfig
# SPDX-License-Identifier: GPL-2.0-only

if ARCH_VEXPRESS

config MACH_VEXPRESS
	bool "ARM Vexpress"

config MACH_VIRT
	bool "QEMU virt"
	select BOARD_ARM_VIRT
	select ARM_PSCI_CLIENT

endif
```

## arch/arm/mach-zynq/Kconfig
```kconfig
# SPDX-License-Identifier: GPL-2.0-only

if ARCH_ZYNQ

config ZYNQ_DEBUG_LL_UART_BASE
	hex
	default 0xe0001000 if MACH_ZEDBOARD

config ARCH_ZYNQ7000
	bool
	select CPU_V7
	select COMMON_CLK
	select COMMON_CLK_OF_PROVIDER
	select ARM_SMP_TWD
	select HAS_MACB
	select OFTREE
	select OFDEVICE

menu "select Zynq boards to be built"

config MACH_ZEDBOARD
	bool "Avnet Zynq-7000 ZedBoard"
	select ARM_USE_COMPRESSED_DTB
	select ARCH_ZYNQ7000

endmenu

endif
```

## arch/arm/mach-zynqmp/Kconfig
```kconfig
# SPDX-License-Identifier: GPL-2.0-or-later

menu "ZynqMP Features"
	depends on ARCH_ZYNQMP

config MACH_XILINX_ZCU102
	bool "Xilinx Zynq UltraScale+ MPSoC ZCU102"
	help
	  Say Y here if you are using the Xilinx Zynq UltraScale+ MPSoC ZCU102
	  evaluation board.

config MACH_XILINX_ZCU104
	bool "Xilinx Zynq UltraScale+ MPSoC ZCU104"
	help
	  Say Y here if you are using the Xilinx Zynq UltraScale+ MPSoC ZCU104
	  evaluation board.

config MACH_XILINX_ZCU106
	bool "Xilinx Zynq UltraScale+ MPSoC ZCU106"
	help
	  Say Y here if you are using the Xilinx Zynq UltraScale+ MPSoC ZCU106
	  evaluation board.

endmenu
```

## arch/blackfin/Kconfig
```kconfig
config BLACKFIN
	bool
	select HAS_KALLSYMS
	select HAS_MODULES
	select HAVE_CONFIGURABLE_MEMORY_LAYOUT
	select HAVE_CONFIGURABLE_TEXT_BASE
	select GENERIC_FIND_NEXT_BIT
	default y

config BF561
	bool

config ARCH_TEXT_BASE
	hex
	default 0x00000000
	default 0x03f00000 if MACH_IPE337

choice
	prompt "Select your board"

config MACH_IPE337
	bool "PII ipe337"
	select BF561
	help
	  Say Y here if you are using the PII IPE337 board

endchoice

choice
	prompt "Select your board options"
	depends on MACH_IPE337
	default MACH_IPE337_V2

config MACH_IPE337_V1
	bool "revision 1 (25MHz)"
	help
	  Say Y here if you are using the first revision of the PII IPE337 board (Crystal running at 25Mhz)

config MACH_IPE337_V2
	bool "revision 2 (40MHz)"
	help
	  Say Y here if you are using the second revision of the PII IPE337 board (Crystal running at 40Mhz)

endchoice

choice
	prompt "Boot Mode"
	default BFIN_BOOT_FLASH16

config BFIN_BOOT_BYPASS
	bool "bypass"
	help
	  blackfin is strapped to boot from parallel flash on CS0

config BFIN_BOOT_FLASH8
	bool "flash 8 bit"
	help
	  blackfin is strapped to boot from 8bit wide flash via boot ROM

config BFIN_BOOT_FLASH16
	bool "flash 16 bit"
	help
	  blackfin is strapped to boot from 16bit wide flash via boot ROM

endchoice
```

## arch/blackfin/configs/ipe337_defconfig
```kconfig
CONFIG_TEXT_BASE=0x03f00000
CONFIG_CMDLINE_EDITING=y
CONFIG_BOOTM_SHOW_TYPE=y
CONFIG_PARTITION=y
CONFIG_DEFAULT_ENVIRONMENT_PATH="arch/blackfin/boards/ipe337/env"
CONFIG_LONGHELP=y
CONFIG_CMD_MEMINFO=y
CONFIG_CMD_GO=y
CONFIG_CMD_RESET=y
CONFIG_CMD_PARTITION=y
CONFIG_CMD_EXPORT=y
CONFIG_CMD_LOADENV=y
CONFIG_CMD_PRINTENV=y
CONFIG_CMD_SAVEENV=y
CONFIG_CMD_SLEEP=y
CONFIG_CMD_DHCP=y
CONFIG_CMD_PING=y
CONFIG_CMD_TFTP=y
CONFIG_CMD_EDIT=y
CONFIG_CMD_READLINE=y
CONFIG_CMD_TIMEOUT=y
CONFIG_CMD_CRC=y
CONFIG_CMD_FLASH=y
CONFIG_NET=y
CONFIG_DRIVER_NET_SMC911X=y
CONFIG_MTD=y
CONFIG_DRIVER_CFI=y
CONFIG_CFI_BUFFER_WRITE=y
CONFIG_FS_TFTP=y
```

## arch/efi/Kconfig
```kconfig
config ARCH_EFI
	bool
	default y
	select HAS_DEBUG_LL
	select HAS_KALLSYMS
	select EFI_GUID
	select EFI_DEVICEPATH
	select PRINTF_UUID
	select GENERIC_FIND_NEXT_BIT

config ARCH_TEXT_BASE
	hex
	default 0x0

menu "EFI specific settings"

config 64BIT
	def_bool y
	help
	  Say yes to build a 64-bit binary - formerly known as x86_64
	  Say no to build a 32-bit binary - formerly known as i386.

	  32-bit support currently does not compile and is not tested
	  due to the lack of hardware.

config X86_32
	def_bool y
	depends on !64BIT

config X86_64
	def_bool y
	depends on 64BIT

config ARCH_EFI_REGISTER_COM1
	bool "Register first serial port"
	help
	  Say yes here to register the first serial port on ioport 0x3f8.
	  This is useful to control barebox over a serial port if the board
	  has one. Enabling this option may not work on boards which do not
	  have a serial port. Also enable DRIVER_SERIAL_NS16550 to enable
	  the NS16550 driver.

endmenu

source common/Kconfig
source commands/Kconfig
source net/Kconfig
source drivers/Kconfig
source fs/Kconfig
source lib/Kconfig
source crypto/Kconfig
```

## arch/kvx/Kconfig
```kconfig
# SPDX-License-Identifier: GPL-2.0-only

config KVX
	bool
	select 64BIT
	select BOOTM
	select HAVE_ARCH_BOOTM_OFTREE
	select BOOTM_OFTREE
	select BOOTM_INITRD
	select COMMON_CLK
	select COMMON_CLK_OF_PROVIDER
	select ELF
	select FLEXIBLE_BOOTARGS
	select FITIMAGE
	select GENERIC_FIND_NEXT_BIT
	select ARCH_HAS_SJLJ
	select HAS_DMA
	select LIBFDT
	select MFD_SYSCON
	select OF_BAREBOX_DRIVERS
	select OFDEVICE
	select PARTITION
	select RESET_SOURCE
	default y

config 64BIT
	bool
	select ARCH_DMA_ADDR_T_64BIT
	select PHYS_ADDR_T_64BIT
	default y

config ARCH_TEXT_BASE
	hex
	default 0x110000000

choice
	prompt "KVX CPU variant"

config ARCH_COOLIDGE_V1
	bool "Coolidge V1 (KV3-1)"

config ARCH_COOLIDGE_V2
	bool "Coolidge V2 (KV3-2)"

endchoice

menu "Board configuration"

config BUILTIN_DTB
	bool "link a DTB into the barebox image"
	depends on OFTREE

config BUILTIN_DTB_NAME
	string "DTB to build into the barebox image"
	depends on BUILTIN_DTB

choice
	prompt "Select your board"

config BOARD_K200
	bool "K200 Network card"

endchoice

endmenu
```

## arch/kvx/configs/generic_defconfig
```kconfig
CONFIG_NAME="generic_defconfig"
CONFIG_AUTO_COMPLETE=y
CONFIG_CONSOLE_RATP=y
CONFIG_CMD_BOOT=y
CONFIG_CMD_RESET=y
CONFIG_CMD_CMP=y
CONFIG_CMD_POWEROFF=y
CONFIG_CMD_WD=y
CONFIG_CMD_OF_DUMP=y
CONFIG_DRIVER_SERIAL_NS16550=y
CONFIG_CLOCKSOURCE_KVX=y
CONFIG_WATCHDOG=y
CONFIG_WATCHDOG_KVX=y
CONFIG_PINCTRL_SINGLE=y
```

## arch/linux/Kconfig
```kconfig
config TEXT_BASE
	string
	default "0x08f00000" if MACH_MX1ADS

config LINUX
	bool
	default y

config ARCH_LINUX
	bool

source common/Kconfig
source net/Kconfig
source drivers/Kconfig
source fs/Kconfig
```

## arch/m68k/Kconfig
```kconfig
#
# Default location of link barebox Image on M68k/Coldfire
#
config ARCH_TEXT_BASE
	hex
	default 0x07f00000 if MACH_MCF54xx
	default 0x07f00000 if MACH_MCF5445x
	help
		Vector table for M68k and barebox Link Address

		On M68k/Coldfire cores all exceptions and interrupts are routed through
		a vector array. This vector is by default at address 0x0000_0000, but
		can be moved to any other 1MB aligned address.

		We take advantage of this to move barebox out of low memory. Some BDM
		debuggers won't like a moved vector base and might need tweaking to
		work.

		Note: Respect alignment restrictions for TEXT_BASE, which must be
		      1MB aligned (VBR register constrain).

#
# Internal configurations
#
config BOARDINFO
	default "konzeptpark UKD Prototype with Phycore MCF5485" if MACH_KPUKDR1
	default "konzeptpark UKD Prototype with Phycore MCF5475 NUM" if MACH_KPUKDR1_NUM
	default "konzeptpark UKD Revision 2 with Phycore MCF5485" if MACH_KPUKDR2
	default "konzeptpark UKD Revision 2 with Phycore MCF5475 NUM" if MACH_KPUKDR2_NUM
	default "Phytec Baseboard with Phycore MCF5485" if MACH_PCM982_5485
	default "Phytec Baseboard with Phycore MCF5475" if MACH_PCM982_5475
	default "Phytec Baseboard with Phycore MCF5475 NUM" if MACH_PCM982_5475_NUM
	default "Phytec Baseboard with Phycore MCF54455" if MACH_PCM982_54455
	default "!No boardinfo string set!"

config HAS_EARLY_INIT
	bool
	default n

config BOARD_LINKER_SCRIPT
	bool
	default n

config GENERIC_LINKER_SCRIPT
	bool
	default y
	depends on !BOARD_LINKER_SCRIPT

config M68K
	bool
	select HAS_KALLSYMS
	select HAS_MODULES
	default y

config MCFV4E
	bool

config MCFV4M
	bool

config ARCH_MCF54xx
	bool
	select MCFV4E

config ARCH_MCF5445x
	bool
	select MCFV4M

#
# Board selection
#
choice
	prompt "Select your board"

config MACH_KPUKDR1
	bool "konzeptpark UKD R1 + phyCore MCF5485"
	select HAS_CFI
	select ARCH_MCF54xx
	help
	  Say Y here if you are using the konzeptpark UKD R1 with a
	  Phytec Phycore PCM-024 equipped with a Freescale MC5485 Processor

config MACH_KPUKDR1_NUM
	bool "konzeptpark UKD R1 + phyCore MCF5475 NUM"
	select HAS_CFI
	select ARCH_MCF54xx
	select MACH_HAS_LOWLEVEL_INIT
	help
	  Say Y here if you are using the konzeptpark UKD R1 with a
	  Phytec Phycore PCM-024-NUM equipped with a Freescale MC5475 Processor

config MACH_KPUKDR2
	bool "konzeptpark UKD R2 + phyCore MCF5485"
	select HAS_CFI
	select ARCH_MCF54xx
	help
	  Say Y here if you are using the konzeptpark UKD R2 with a
	  Phytec Phycore PCM-024 equipped with a Freescale MC5485 Processor

config MACH_KPUKDR2_NUM
	bool "konzeptpark UKD R2 + phyCore MCF5475 NUM"
	select HAS_CFI
	select ARCH_MCF54xx
	help
	  Say Y here if you are using the konzeptpark UKD R2 with a
	  Phytec Phycore PCM-024-NUM equipped with a Freescale MC5475 Processor

config MACH_PCM982_5485
	bool "Phytec pcm982 + phyCore MCF5485"
	select HAS_CFI
	select ARCH_MCF54xx
	select MACH_HAS_LOWLEVEL_INIT
	help
	  Say Y here if you are using the Phytec Phycore PCM-024 equipped
	  with a Freescale MC5485 Processor

config MACH_PCM982_5475
	bool "Phytec pcm982 + phyCore MCF5475"
	select HAS_CFI
	select ARCH_MCF54xx
	select MACH_HAS_LOWLEVEL_INIT
	help
	  Say Y here if you are using the Phytec Phycore PCM-024 equipped
	  with a Freescale MC5475 Processor

config MACH_PCM982_5475_NUM
	bool "Phytec pcm982 + phyCore MCF5475 NUM"
	select HAS_CFI
	select ARCH_MCF54xx
	select MACH_HAS_LOWLEVEL_INIT
	help
	  Say Y here if you are using the Phytec Phycore PCM-024 equipped
	  with a Freescale MC5475 Processor (NUM Variant)

config MACH_PCM982_54455
	bool "Phytec pcm982 + phyCore MCF54455 (experimental)"
	select HAS_CFI
	select ARCH_MCF5445x
	help
	  Say Y here if you are using the Phytec Phycore PCM-mcf54455 equipped
	  with a Freescale MC54455 Processor (experimental)

endchoice

#
# M68k/Coldfire Subarch Configuration
#
source arch/m68k/mach-mcfv4e/Kconfig

menu "M68k/Coldfire specific Linux boot settings"

config CMDLINE_TAG
	bool "Send commandline to kernel"
	default y
	help
	  If you want to start a 2.6 kernel say y here.

config SETUP_MEMORY_TAGS
	bool "send memory definition to kernel"
	default y
	help
	  If you want to start a 2.6 kernel say y here.

config INITRD_TAG
	bool "send initrd params to kernel"
	default n
	help
	  If you want to start a 2.6 kernel and use an
	  initrd image say y here.

endmenu

#
# Common barebox options
#

source common/Kconfig
source commands/Kconfig
source net/Kconfig
source drivers/Kconfig
source fs/Kconfig
source lib/Kconfig
```

## arch/m68k/configs/phycore_kpukdr1_5475num_defconfig
```kconfig
CONFIG_MACH_KPUKDR1_NUM=y
CONFIG_INITRD_TAG=y
CONFIG_BROKEN=y
CONFIG_EXPERIMENTAL=y
CONFIG_LONGHELP=y
CONFIG_CMDLINE_EDITING=y
CONFIG_AUTO_COMPLETE=y
CONFIG_DEFAULT_ENVIRONMENT_PATH="arch/m68k/boards/kp_ukd_r1_num/env/"
CONFIG_DEBUG_INFO=y
CONFIG_ENABLE_DEVICE_NOISE=y
CONFIG_CMD_EDIT=y
CONFIG_CMD_SLEEP=y
CONFIG_CMD_SAVEENV=y
CONFIG_CMD_LOADENV=y
CONFIG_CMD_EXPORT=y
CONFIG_CMD_PRINTENV=y
CONFIG_CMD_READLINE=y
CONFIG_CMD_MEMINFO=y
CONFIG_CMD_CRC=y
CONFIG_CMD_MTEST=y
CONFIG_CMD_MTEST_ALTERNATIVE=y
CONFIG_CMD_FLASH=y
CONFIG_CMD_BOOTM_ZLIB=y
CONFIG_CMD_BOOTM_BZLIB=y
CONFIG_CMD_BOOTM_SHOW_TYPE=y
CONFIG_CMD_RESET=y
CONFIG_CMD_GO=y
CONFIG_CMD_TIMEOUT=y
CONFIG_CMD_PARTITION=y
CONFIG_NET=y
CONFIG_NET_DHCP=y
CONFIG_NET_PING=y
CONFIG_NET_TFTP=y
CONFIG_DRIVER_CFI=y
CONFIG_CFI_BUFFER_WRITE=y
CONFIG_FS_CRAMFS=y
```

## arch/m68k/configs/phycore_mcf54xx_defconfig
```kconfig
CONFIG_MACH_PCM982_5485=y
CONFIG_INITRD_TAG=y
CONFIG_BROKEN=y
CONFIG_EXPERIMENTAL=y
CONFIG_LONGHELP=y
CONFIG_CMDLINE_EDITING=y
CONFIG_AUTO_COMPLETE=y
CONFIG_DEFAULT_ENVIRONMENT_PATH="arch/m68k/boards/phycore_mcf54xx/env"
CONFIG_DEBUG_INFO=y
CONFIG_ENABLE_DEVICE_NOISE=y
CONFIG_CMD_EDIT=y
CONFIG_CMD_SLEEP=y
CONFIG_CMD_SAVEENV=y
CONFIG_CMD_LOADENV=y
CONFIG_CMD_EXPORT=y
CONFIG_CMD_PRINTENV=y
CONFIG_CMD_READLINE=y
CONFIG_CMD_MEMINFO=y
CONFIG_CMD_CRC=y
CONFIG_CMD_MTEST=y
CONFIG_CMD_MTEST_ALTERNATIVE=y
CONFIG_CMD_FLASH=y
CONFIG_CMD_BOOTM_ZLIB=y
CONFIG_CMD_BOOTM_BZLIB=y
CONFIG_CMD_BOOTM_SHOW_TYPE=y
CONFIG_CMD_RESET=y
CONFIG_CMD_GO=y
CONFIG_CMD_TIMEOUT=y
CONFIG_CMD_PARTITION=y
CONFIG_NET=y
CONFIG_NET_DHCP=y
CONFIG_NET_PING=y
CONFIG_NET_TFTP=y
CONFIG_DRIVER_CFI=y
CONFIG_CFI_BUFFER_WRITE=y
CONFIG_FS_CRAMFS=y
```

## arch/m68k/mach-mcfv4e/Kconfig
```kconfig
menu "M68k/Coldfire V4E specific settings"

config COPY_LOWMEM_VECTORS
	bool "Copy vectors to SDRAM address 0"
	default y
	help
	  This copies the vector table to SDRAM address 0 (default address)

config USE_LOWMEM_VECTORS
	bool "Use vectors at SDRAM address 0"
	default n
	depends on COPY_LOWMEM_VECTORS
	help
	  This copies the vector table to SDRAM address 0 (default address) and
	  also uses this vector location

endmenu
```

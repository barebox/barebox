## drivers/block/Kconfig
```kconfig
# SPDX-License-Identifier: GPL-2.0-only
config VIRTIO_BLK
        bool "Virtio block driver"
        depends on VIRTIO
        help
          This is the virtual block driver for virtio.  It can be used with
          QEMU based VMMs (like KVM or Xen).

config EFI_BLK
	bool "EFI block I/O driver"
	default y
	depends on EFI_PAYLOAD

config EFI_BLK_SEPARATE_USBDISK
	bool "rename USB devices to /dev/usbdiskX"
	default y
	depends on EFI_BLK
	help
	  EFI block devices will be normally called /dev/diskX. Setting this
	  option will cause block devices instantiated from handles with a
	  EFI_USB_IO protocol to be called /dev/usbdiskX instead. Note that
	  some buggy UEFI implementations have been observed to not do this
	  consistently for all USB mass storage. If you need to absolutely
	  be sure your boot device is a USB mass storage device and you can't
	  fix your UEFI, consider disabling this options and setting a GUID
	  for your disk and checking against it with

	    devlookup -v $bootguid /dev/disk$bootsource_instance guid
```

## drivers/bus/Kconfig
```kconfig
menu "Bus devices"

config BUS_OMAP_GPMC
	depends on ARCH_OMAP
	depends on OFDEVICE
	depends on OMAP_GPMC
	bool "TI OMAP/AM33xx GPMC support"

config TI_SYSC
	depends on ARCH_OMAP
	bool "TI sysc interconnect target module driver"
	default y
	help
	  Generic driver for Texas Instruments interconnect target module
	  found on many TI SoCs.

config IMX_WEIM
	depends on ARCH_IMX
	bool "i.MX WEIM driver"

config MVEBU_MBUS
	bool
	depends on ARCH_MVEBU
	help
	  Driver needed for the MBus configuration on Marvell EBU SoCs
	  (Kirkwood, Dove, Orion5x, MV78XX0 and Armada 370/XP).

endmenu
```

## drivers/clk/Kconfig
```kconfig
# SPDX-License-Identifier: GPL-2.0-only
config HAVE_CLK
	bool
	help
	  The <linux/clk.h> calls support software clock gating and
	  thus are a key power management tool on many systems.

config HAVE_LEGACY_CLK
	select HAVE_CLK
	bool
	help
	  Select this option when the clock API in <linux/clk.h> is implemented
	  by platform/architecture code. This method is deprecated. Modern
	  code should select COMMON_CLK instead and not define a custom
	  'struct clk'.

config CLKDEV_LOOKUP
	bool

config COMMON_CLK
	bool "Common Clock Framework"
	depends on !HAVE_LEGACY_CLK
	select HAVE_CLK
	select CLKDEV_LOOKUP
	help
	  The common clock framework is a single definition of struct
	  clk, useful across many platforms, as well as an
	  implementation of the clock API in include/linux/clk.h.
	  Architectures utilizing the common struct clk should select
	  this option.

config COMMON_CLK_OF_PROVIDER
	bool
	depends on OFTREE
	help
	  Clock driver provides OF-Tree based clock lookup.

config CLK_SOCFPGA
	bool
	select COMMON_CLK_OF_PROVIDER
	default y if ARCH_SOCFPGA && OFDEVICE

if COMMON_CLK

config COMMON_CLK_STM32F
	bool "STM32F4 and STM32F7 clock driver" if COMPILE_TEST
	depends on ARCH_STM32
	help
	  Support for stm32f4 and stm32f7 SoC families clocks

config COMMON_CLK_STM32MP135
	def_bool ARCH_STM32MP13
	help
	  Support for stm32mp135 SoC family clocks

config COMMON_CLK_STM32MP157
	def_bool ARCH_STM32MP157
	help
	  Support for stm32mp157 SoC family clocks

config COMMON_CLK_SCMI
	tristate "Clock driver controlled via SCMI interface"
	depends on ARM_SCMI_PROTOCOL || COMPILE_TEST
	help
	  This driver provides support for clocks that are controlled
	  by firmware that implements the SCMI interface.

	  This driver uses SCMI Message Protocol to interact with the
	  firmware providing all the clock controls.

config TI_SCI_CLK
	tristate "TI System Control Interface clock drivers"
	depends on TI_SCI_PROTOCOL
	default ARCH_K3
	help
	  This adds the clock driver support over TI System Control Interface.
	  If you wish to use clock resources from the PMMC firmware, say Y.
	  Otherwise, say N.

config COMMON_CLK_GPIO
	bool
	default y
	depends on COMMON_CLK_OF_PROVIDER

source "drivers/clk/sifive/Kconfig"

endif
```

## drivers/clocksource/Kconfig
```kconfig
# SPDX-License-Identifier: GPL-2.0-only
menu "Clocksource"

config ARCH_HAS_IMX_GPT
       bool

config AMBA_SP804
	bool
	depends on ARM_AMBA

config ARM_SMP_TWD
	bool
	depends on ARM && CPU_V7

config CLOCKSOURCE_BCM283X
	bool "BCM283x clock source" if COMPILE_TEST
	depends on ARCH_BCM283X || COMPILE_TEST

config CLOCKSOURCE_CLPS711X
	bool "CLPS711x clock source" if COMPILE_TEST
	depends on ARCH_CLPS711X || COMPILE_TEST

config CLOCKSOURCE_DIGIC
	bool "DIGIC clock source" if COMPILE_TEST
	depends on ARCH_DIGIC || COMPILE_TEST

config CLOCKSOURCE_DUMMY_RATE
	int
	prompt "dummy clocksource rate"
	default 1000
	help
	  When porting barebox to a new SoC there might be a case
	  of broken or absent clocksource. This causes barebox serial
	  console to be non functional.
	  To solve the problem barebox has built-in software-only clocksource.
	  The software-only clocksource is used only if no hardware clocksource
	  is registered. This can help if initialization order is wrong so that
	  the time functions are used before the real clocksource was initialized.
	      WARNING!!! Built-in software-only clocksource doesn't provide correct timing.
	  The option CONFIG_CLOCKSOURCE_DUMMY_RATE is used to adjust this clocksource.
	  The bigger rate valuest makes clocksource "faster".

config CLOCKSOURCE_EFI
	bool "Generic EFI Driver"
	depends on EFI_PAYLOAD

config CLOCKSOURCE_EFI_X86
	bool "EFI X86 HW driver"
	depends on EFI_PAYLOAD && X86

config CLOCKSOURCE_KVX
	bool "KVX core timer clocksource"
	depends on KVX

config CLOCKSOURCE_MVEBU
	bool "MVEBU clock source" if COMPILE_TEST
	depends on ARCH_MVEBU || COMPILE_TEST

config CLOCKSOURCE_NOMADIK
	bool "Nomadik clock source" if COMPILE_TEST
	depends on ARM || COMPILE_TEST

config CLOCKSOURCE_ORION
	bool "ORION clock source" if COMPILE_TEST
	depends on ARCH_MVEBU || COMPILE_TEST

config CLOCKSOURCE_UEMD
	bool "UEMD clock source" if COMPILE_TEST
	depends on ARCH_UEMD || COMPILE_TEST

config CLOCKSOURCE_ROCKCHIP
	bool
	depends on ARCH_ROCKCHIP

config CLOCKSOURCE_ATMEL_PIT
       bool

config CLOCKSOURCE_ARM_ARCHITECTED_TIMER
	bool "ARM architected timer clock source" if COMPILE_TEST
	default y
	depends on ARM && (CPU_64v8 || CPU_V7)

config CLOCKSOURCE_ARM_GLOBAL_TIMER
	bool "ARM global timer clock source" if COMPILE_TEST
	depends on (ARM && CPU_V7) || COMPILE_TEST

config CLOCKSOURCE_IMX_GPT
	bool "i.MX GPT clock source" if COMPILE_TEST
	default y if ARCH_HAS_IMX_GPT
	depends on ARCH_HAS_IMX_GPT || COMPILE_TEST

config CLOCKSOURCE_DW_APB_TIMER
	bool "DW APB timer driver"
	help
	  Enables the support for the dw_apb timer.

config CLOCKSOURCE_TI_DM
	bool

config CLOCKSOURCE_TI_32K
	bool

config RISCV_TIMER
	bool "Timer for the RISC-V platform" if COMPILE_TEST
	depends on RISCV
	help
	  This enables the per-hart timer built into all RISC-V systems, which
	  is accessed via both the SBI and the rdcycle instruction.  This is
	  required for all RISC-V systems.

config CLINT_TIMER
	bool "CLINT Timer for the RISC-V platform"
	depends on RISCV && OFDEVICE
	help
	  This option enables the CLINT timer for RISC-V systems.  The CLINT
	  driver is usually used for NoMMU RISC-V systems.

config ARMV7M_SYSTICK
	bool "Support for the ARMv7M system timer" if COMPILE_TEST
	help
	  This option enables support for the ARMv7M system timer unit.

config CLKSRC_STM32
	bool "Clocksource for STM32 SoCs"
	depends on OFDEVICE && (ARCH_STM32 || COMPILE_TEST)

endmenu
```

## drivers/crypto/Kconfig
```kconfig
# SPDX-License-Identifier: GPL-2.0-only

menu "Hardware crypto devices"

source "drivers/crypto/caam/Kconfig"
source "drivers/crypto/imx-scc/Kconfig"

endmenu
```

## drivers/crypto/caam/Kconfig
```kconfig
config CRYPTO_DEV_FSL_CAAM
	bool "Freescale CAAM-Multicore driver backend"
	depends on ARCH_IMX6
	help
	  Enables the driver module for Freescale's Cryptographic Accelerator
	  and Assurance Module (CAAM), also known as the SEC version 4 (SEC4).
	  This module creates job ring devices, and configures h/w
	  to operate as a DPAA component automatically, depending
	  on h/w feature availability.

config CRYPTO_DEV_FSL_CAAM_RINGSIZE
	int "Job Ring size"
	depends on CRYPTO_DEV_FSL_CAAM
	range 2 9
	default "9"
	help
	  Select size of Job Rings as a power of 2, within the
	  range 2-9 (ring size 4-512).
	  Examples:
		2 => 4
		3 => 8
		4 => 16
		5 => 32
		6 => 64
		7 => 128
		8 => 256
		9 => 512

config CRYPTO_DEV_FSL_CAAM_RNG
	bool "Register caam RNG device"
	depends on CRYPTO_DEV_FSL_CAAM
	depends on HWRNG
	default y
	help
	  Selecting this will register the SEC4 hardware rng.

if CRYPTO_DEV_FSL_CAAM_RNG

config CRYPTO_DEV_FSL_CAAM_RNG_SELF_TEST
	bool "Run RNG software self-test on impacted chips"
	depends on ARCH_IMX6
	depends on HABV4
	default y
	help
	  Some chips with HAB >= 4.2.3 have an incorrect implementation of the
	  RNG self-test in ROM code. In this case, a software self-test should
	  be run to ensure correctness of the RNG. By enabling this config
	  option, the software self-test is run automatically when this case
	  is detected.

	  Currently known impacted chips:
	  * i.MX6DQ+ silicon revision 1.1
	  * i.MX6DQ silicon revision 1.6
	  * i.MX6DLS silicon revision 1.4
	  * i.MX6SX silicon revision 1.4
	  * i.MX6UL silicon revision 1.2
	  * i.MX67SD silicon revision 1.3

endif
```

## drivers/crypto/imx-scc/Kconfig
```kconfig
# SPDX-License-Identifier: GPL-2.0-only
config CRYPTO_DEV_MXC_SCC
	tristate "Support for Freescale Security Controller (SCC)"
	depends on (ARCH_IMX25 || COMPILE_TEST) && OFTREE
	help
	  This option enables support for the Security Controller (SCC)
	  found in Freescale i.MX25 chips.

config CRYPTO_DEV_MXC_SCC_BLOB_GEN
	tristate "Support for SCC blob gen"
	depends on ARCH_IMX25 || COMPILE_TEST
	select BLOBGEN
	select CRYPTO_DEV_MXC_SCC
```

## drivers/ddr/Kconfig
```kconfig
# SPDX-License-Identifier: GPL-2.0-only
source "drivers/ddr/fsl/Kconfig"
source "drivers/ddr/imx/Kconfig"
source "drivers/ddr/k3/Kconfig"
```

## drivers/ddr/fsl/Kconfig
```kconfig
# SPDX-License-Identifier: GPL-2.0
config DDR_FSL
	bool "Freescale DDR support"
	depends on ARCH_LAYERSCAPE

if DDR_FSL

config DDR_FSL_DDR1
	bool "Enable DDR1 support"
config DDR_FSL_DDR2
	bool "Enable DDR2 support"
config DDR_FSL_DDR3
	bool "Enable DDR3 support"
config DDR_FSL_DDR4
	bool "Enable DDR4 support"

endif
```

## drivers/ddr/imx/Kconfig
```kconfig
# SPDX-License-Identifier: GPL-2.0-only
menu "i.MX DDR controllers"
	depends on ARCH_IMX8MQ || ARCH_IMX8MM || ARCH_IMX8MN || ARCH_IMX8MP || ARCH_IMX93

config IMX_DRAM
	bool

config IMX8M_DRAM
	select IMX_DRAM
	bool "imx8m dram controller support"

config IMX9_DRAM
	select IMX_DRAM
	bool "imx9 dram controller support"

endmenu
```

## drivers/ddr/imx8m/Kconfig
```kconfig
menu "i.MX8M DDR controllers"
	depends on ARCH_IMX8MQ || ARCH_IMX8MM || ARCH_IMX8MP

config IMX8M_DRAM
	bool "imx8m dram controller support"

endmenu
```

## drivers/dma/Kconfig
```kconfig
# SPDX-License-Identifier: GPL-2.0-only
menu "DMA support"

config MXS_APBH_DMA
	tristate "MXS APBH DMA ENGINE"
	depends on ARCH_IMX23 || ARCH_IMX28 || ARCH_IMX6 || ARCH_IMX7
	select STMP_DEVICE
	help
	  Experimental!

config OF_DMA_COHERENCY
	bool "Respect device tree DMA coherency settings" if COMPILE_TEST
	depends on HAS_DMA && OFDEVICE
	help
	  For most platforms supported, either all DMA is coherent or it isn't.
	  Platforms that have DMA masters of mixed coherency or that differ
	  from the architecture default will select this option to parse
	  DMA coherency out of the DT. This allows barebox to choose the
	  correct cache maintenance operation during runtime and will cause
	  barebox to fix up its own DMA coherency setting into the kernel
	  DT if it differs.

endmenu
```

## drivers/dma/ti/Kconfig
```kconfig
# SPDX-License-Identifier: GPL-2.0-only
#
# Texas Instruments DMA drivers
#

config TI_K3_UDMA
        tristate "Texas Instruments UDMA support"
        depends on ARCH_K3 || COMPILE_TEST
        select TI_K3_RINGACC
        help
          Enable support for the TI UDMA (Unified DMA) controller. This
          DMA engine is used in AM65x and j721e.
```

## drivers/input/Kconfig
```kconfig
# SPDX-License-Identifier: GPL-2.0-only
#
# Input device configuration
#

menu "Input device support"
	depends on !CONSOLE_NONE

config INPUT
	bool

config INPUT_MATRIXKMAP
	bool

config INPUT_EVBUG
        bool "Event debugging"
        help
          Say Y here if you have a problem with the input subsystem and
          want all events (keypresses), to be output to
          the barebox log. While this is useful for debugging, it's also
          a security threat - your keypresses include your passwords, of
          course and could be visible to userspace if pstore is configured.

          If unsure, say N.

config KEYBOARD_GPIO
	bool "GPIO Buttons"
	depends on GPIOLIB
	select POLLER
	select INPUT
	help
	  This driver implements support for buttons connected
	  to GPIO pins of various CPUs (and some other chips).

	  Say Y here if your device has buttons connected
	  directly to such GPIO pins. Your board-specific
	  setup logic must also provide a platform device,
	  with configuration data saying which GPIOs are used.

config KEYBOARD_IMX_KEYPAD
	bool "IMX Keypad"
	depends on ARCH_IMX || COMPILE_TEST
	select INPUT_MATRIXKMAP
	select POLLER
	select INPUT
	help
	  This driver implements support for buttons connected
	  to the IMX keypad matrix.

	  Say Y here if your device has buttons connected
	  to the IMX keypad matrix. Your board-specific
	  setup logic must also provide a 'matrix_keymap_data' structure,
	  defining the used keys.

config KEYBOARD_QT1070
	tristate "Atmel AT42QT1070 Touch Sensor Chip"
	depends on I2C && GENERIC_GPIO
	select POLLER
	help
	  Say Y here if you want to use Atmel AT42QT1070 QTouch
	  Sensor chip as input device.

config KEYBOARD_TWL6030
	tristate "TWL6030 power button"
	depends on MFD_TWL6030
	select POLLER
	help
	  Say Y here if you want to use TWL6030 power button as a key.

config KEYBOARD_USB
	bool "USB keyboard"
	depends on USB_HOST
	depends on CONSOLE_FULL
	select POLLER
	select INPUT
	help
	  This driver implements support for usb keyboard.

config INPUT_SPECIALKEYS
	bool "Special keys handler"
	select POLLER
	select INPUT
	help
	  Say Y here to handle key events like KEY_RESTART and KEY_POWER.

config VIRTIO_INPUT
	bool "Virtio input driver"
	depends on VIRTIO
	select POLLER
	select INPUT
	help
	 This driver supports virtio keyboard input devices.

endmenu
```

## drivers/led/Kconfig
```kconfig
menuconfig LED
	bool "LED support"
	select POLLER

if LED

config LED_GPIO
	bool "gpio LED support"
	depends on GENERIC_GPIO

config LED_PWM
	bool "PWM LED support"
	depends on PWM

config LED_GPIO_OF
	bool "support parsing gpio LEDs from device tree"
	depends on LED_GPIO && OFTREE

config LED_GPIO_RGB
	bool "gpio rgb LED support"
	depends on LED_GPIO

config LED_GPIO_BICOLOR
	bool "gpio bicolor LED support"
	depends on LED_GPIO

config LED_TRIGGERS
	select POLLER
	bool "LED triggers support"
	help
	  This allows to assign certain triggers like heartbeat or network
	  activity to LEDs.

config LED_PCA955X
	bool "LED Support for PCA955x I2C chips"
	depends on I2C
	help
	  This option enables support for LEDs connected to PCA955x
	  LED driver chips accessed via the I2C bus.  Supported
	  devices include PCA9550, PCA9551, PCA9552, and PCA9553.


endif
```

## drivers/mailbox/Kconfig
```kconfig
menuconfig MAILBOX
	bool "Mailbox Hardware Support"
	help
	  Mailbox is a framework to control hardware communication between
	  on-chip processors through queued messages and interrupt driven
	  signals. Say Y if your platform supports hardware mailboxes.

if MAILBOX

endif
```

## drivers/mci/Kconfig
```kconfig
# SPDX-License-Identifier: GPL-2.0-only
config MCI_SDHCI
	bool

menuconfig MCI
	bool "MCI drivers"
	select DISK
	help
	  Add support for MCI drivers, used to handle MMC and SD cards

if MCI

comment "--- Feature list ---"

config MCI_TUNING
	bool "EXPERIMENTAL - support MMC tuning for higher speeds"
	help
	  Say 'y' here if supporting drivers should do tuning to support
	  higher clock speeds than 52 MHz SDR. MMC only; SD-Card max
	  frequency is 50MHz SDR at present.

choice
	prompt "MMC detection on startup"

config MCI_STARTUP_NONE
	bool "do not detect cards during system start"
	help
	  Choose this if the MCI framework should never detect cards during system
	  start

config MCI_STARTUP_NONREMOVABLE
	bool "detect non removable cards on system start"
	help
	  Choose this if the MCI framework should detect non removable cards (i.e.
	  devices which have the non-removable device tree property).

config MCI_STARTUP
	bool "detect all cards on system start"
	help
	  Choose this if the MCI framework should always probe for all attached
	  MCI cards on system start up. This may required for some legacy boards.
	  When this is 'n', probing happens on demand either with "mci*.probe=1"
	  or with driver/board code calling device_detect.

endchoice

config MCI_INFO
	bool "MCI Info"
	depends on CMD_DEVINFO
	default y
	help
	  This entry adds more info about the attached MCI card, when the
	  'devinfo' command is used on the mci device.

config MCI_WRITE
	bool "Support writing to MCI cards"
	default y
	select DISK_WRITE

config MCI_ERASE
	bool "Support erasing MCI cards"
	depends on MCI_WRITE
	default y

config MCI_MMC_BOOT_PARTITIONS
	bool "support MMC boot partitions"
	help
	  Provide access to the 'boot partitions' of devices of type 'MMC'.
	  These so called 'hardware partitions' act like an independent memory
	  device and thus, need special handling.

	  Note: only 'MMC' have 'boot partitions'. So, if you don't use an
	  'MMC' device, you don't need this support.

config MCI_MMC_GPP_PARTITIONS
	bool "support MMC general purpose partitions (GPP)"
	help
	  Provide access to the 'general purpose partitions' of devices of type
	  'MMC'. These so called 'hardware partitions' act like an independent
	  memory device and thus, need special handling.

	  Note: only 'MMC' devices have 'general purpose partitions'. So, if
	  you don't use an 'MMC' device, you don't need this support.

	  Note: by default, 'MMC' devices have no 'general purpose partitions',
	  it requires a special one-time configuration step to enable them.

config MCI_MMC_RPMB
	bool "Support eMMC replay protected memory block (RPMB)"

comment "--- MCI host drivers ---"

config MCI_DWC_MSHC
	bool "Synopsys DesignWare Cores MSHC"
	depends on HAS_DMA
	select MCI_SDHCI
	help
	  This selects support for the Synopsys DesignWare Mobile Storage Host Controller
	  block (DWC_mshc), this provides host support for SD/eMMC interfaces, in SDMA mode.

config MCI_DW
	bool "Synopsys DesignWare Memory Card Interface"
	depends on HAS_DMA
	help
	  This selects support for the Synopsys DesignWare Mobile Storage IP
	  block, this provides host support for SD and MMC interfaces, in both
	  PIO and external DMA modes.

config MCI_DW_PIO
	bool "Use PIO mode on Synopsys DesignWare MCI"
	depends on MCI_DW
	help
	  Use PIO mode (instead of IDMAC) in DW MMC driver.

config MCI_SUNXI_SMHC
	bool "Allwinner SD-MMC Memory Card Host Controller"
	help
	  Enable support for the Allwinner SD-MMC Memory Card Host Controller,
	  this provides host support for SD and MMC interfaces, in PIO mode.

config MCI_MXS
	bool "i.MX23/i.MX28"
	depends on ARCH_MXS
	select STMP_DEVICE
	help
	  Enable this entry to add support to read and write SD cards on a
	  i.MX23/i.MX28 based system.

config MCI_ROCKCHIP_DWCMSHC
	bool "MCI sdhc support for Rockchip SoCs"
	select MCI_SDHCI
	help
	  Enable this entry to add support for a Rockchip derivation of the
	  DWCMSHC controller found on some Rockchip SoCs like the RK3568.

config MCI_BCM283X
	bool "MCI support for BCM283X"
	depends on ARCH_BCM283X || COMPILE_TEST
	select MCI_SDHCI

config MCI_BCM283X_SDHOST
	bool "BCM283X sdhost"
	depends on ARCH_BCM283X || COMPILE_TEST
	select MCI_SDHCI

config MCI_DOVE
	bool "Marvell Dove SDHCI"
	depends on ARCH_DOVE || COMPILE_TEST
	select MCI_SDHCI
	help
	  Enable this entry to add support to read and write SD cards on a
	  Marvell Dove SoC based system.

config MCI_IMX
	bool "i.MX"
	depends on ARCH_IMX27 || ARCH_IMX31 || COMPILE_TEST
	help
	  Enable this entry to add support to read and write SD cards on a
	  Freescale i.MX based system.

config MCI_IMX_ESDHC
	bool "i.MX esdhc"
	depends on ARCH_IMX || ARCH_LAYERSCAPE || COMPILE_TEST
	select MCI_SDHCI
	help
	  Enable this entry to add support to read and write SD cards on a
	  Freescale i.MX25/35/51 based system.

config MCI_IMX_ESDHC_PIO
	bool "use PIO mode"
	depends on MCI_IMX_ESDHC
	help
	  mostly useful for debugging. Normally you should use DMA.

config MCI_OMAP_HSMMC
	bool "OMAP HSMMC"
	depends on ARCH_OMAP4 || ARCH_OMAP3 || ARCH_AM33XX
	help
	  Enable this entry to add support to read and write SD cards on
	  both OMAP3 and OMAP4 based systems.

config MCI_PXA
	bool "PXA"
	depends on ARCH_PXA2XX
	help
	  Enable this entry to add support to read and write SD cards on a
	  XScale PXA25x / PXA27x based system.

config MCI_ATMEL
	bool "ATMEL (AT91)"
	depends on ARCH_AT91 || COMPILE_TEST
	help
	  Enable this entry to add support to read and write SD cards on a
	  Atmel AT91.

config MCI_ATMEL_SDHCI
	bool "ATMEL SDHCI (sama5d2)"
	select MCI_SDHCI
	depends on ARCH_AT91
	help
	  Enable this entry to add support to read and write SD cards on an
	  Atmel sama5d2

config MCI_MMCI
	bool "ARM PL180 MMCI"
	depends on ARM_AMBA
	help
	  Enable this entry to add support to read and write SD cards on a
	  ARM AMBA PL180.

config MCI_TEGRA
	bool "Tegra SD/MMC"
	depends on ARCH_TEGRA || COMPILE_TEST
	select MCI_SDHCI
	help
	  Enable this to support SD and MMC card read/write on a Tegra based
	  systems.

config MCI_ARASAN
	bool "Arasan SDHCI Controller"
	select MCI_SDHCI
	help
	  Enable this to support SD and MMC card read/write on systems with
	  the Arasan SD3.0 / SDIO3.0 / eMMC4.51 host controller.

config MCI_AM654
	bool "Support for the SDHCI Controller in TI's AM654 SOCs"
	select MCI_SDHCI
	help
	  This selects the Secure Digital Host Controller Interface (SDHCI)
	  support present in TI's AM654 SOCs. The controller supports
	  SD/MMC/SDIO devices.

config MCI_SPI
	bool "MMC/SD over SPI"
	select CRC7
	depends on SPI
	help
	  Some systems access MMC/SD/SDIO cards using a SPI controller
	  instead of using a "native" MMC/SD/SDIO controller. This has a
	  disadvantage of being relatively high overhead, but a compensating
	  advantage of working on many systems without dedicated MMC/SD/SDIO
	  controllers.

config MMC_SPI_CRC_ON
	bool "Enable CRC protection for transfers"
	select CRC_ITU_T
	depends on MCI_SPI
	help
	  Enable CRC protection for transfers

config MCI_STM32_SDMMC2
	bool "STMicroelectronics STM32H7 SD/MMC Host Controller support"
	depends on ARM_AMBA
	depends on RESET_CONTROLLER
	depends on ARCH_STM32 || COMPILE_TEST
	help
	  This selects support for the SD/MMC controller on STM32H7 SoCs.
	  If you have a board based on such a SoC and with a SD/MMC slot,
	  say Y or M here.

config MMC_CADENCE_SDHCI
	tristate "SDHCI support for the Cadence SD/SDIO/eMMC controller"
	select MCI_SDHCI
	help
	  This selects the Cadence SD/SDIO/eMMC driver.
	  If you have a controller with this interface, say Y or M here.

endif

config MCI_IMX_ESDHC_PBL
	bool
	select MCI_SDHCI

config MCI_ATMEL_PBL
	bool
	select MCI_ATMEL

config MCI_ATMEL_SDHCI_PBL
	bool
	select MCI_SDHCI

config MCI_OMAP_HSMMC_PBL
	bool
```

## drivers/memory/Kconfig
```kconfig
# SPDX-License-Identifier: GPL-2.0-only
menu "Memory controller drivers"

config ATMEL_EBI
	bool "Atmel EBI driver"
	default y if ARCH_AT91
	depends on ARCH_AT91 || COMPILE_TEST
	depends on OFDEVICE
	select MFD_SYSCON
	select MFD_ATMEL_SMC
	help
	  Driver for Atmel EBI controller.
	  Used to configure the EBI (external bus interface) when the device-
	  tree is used. This bus supports NANDs, external ethernet controller,
	  SRAMs, ATA devices, etc.


config MC_TEGRA124
	bool "Support for Tegra124 memory controller"
	depends on ARCH_TEGRA || COMPILE_TEST
	help
	  Say yes here to include the driver for the memory controller found on
	  the Tegra124 SoC. This driver performs the necessary initialization
	  to provide a function GPU when the OS is running.

config STM32_FMC2_EBI
	bool "Support for FMC2 External Bus Interface on STM32MP SoCs"
	depends on ARCH_STM32MP || COMPILE_TEST
	select RESET_CONTROLLER if ARCH_STM32MP
	select RESET_SIMPLE if ARCH_STM32MP
	help
	  Select this option to enable the STM32 FMC2 External Bus Interface
	  controller. This driver configures the transactions with external
	  devices (like SRAM, ethernet adapters, FPGAs, LCD displays, ...) on
	  SOCs containing the FMC2 External Bus Interface.

endmenu
```

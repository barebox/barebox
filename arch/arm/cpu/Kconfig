## arch/arm/mach-k3/Kconfig
```kconfig
# SPDX-License-Identifier: GPL-2.0-or-later

menu "K3 boards"
        depends on ARCH_K3

config MACH_AM62X
	bool

config MACH_AM62LX
	bool

config MACH_K3_CORTEX_R5
	bool
	select CPU_V7
	select CLOCKSOURCE_TI_DM
	select REMOTEPROC
	select REMOTEPROC_TI_K3_ARM64
	select REMOTEPROC_K3_SYSTEM_CONTROLLER
	select PM_GENERIC_DOMAINS
	select TI_K3_PM_DOMAINS
	select ARMV7R_MPU
	select ELF
	select K3_DDRSS
	select FIP
	select HAVE_FIRMWARE_VERIFY_NEXT_IMAGE
	depends on 32BIT
	select ARM_USE_COMPRESSED_DTB
	select HAS_INSECURE_DEFAULTS if (!FIRMWARE_VERIFY_NEXT_IMAGE && !ARCH_K3_AUTHENTICATE_IMAGE)
	default y

config MACH_K3_CORTEX_A
	bool
	select CPU_V8
	depends on 64BIT
	default y

config MACH_AM625_SK
	bool "TI AM625 SK"
	select MACH_AM62X
	help
	  Say Y here if you are using a TI AM625 SK board

config MACH_BEAGLEPLAY
	bool "BeagleBoard BeaglePlay"
	select MACH_AM62X
	help
	  Say Y here if you are using a TI AM62x based BeaglePlay board

config MACH_AM62LX_EVM
	bool "TI AM62Lx EVM"
	select MACH_AM62LX
	help
	  Say Y here if you are using a TI AM62Lx EVM board

config ARCH_K3_AUTHENTICATE_IMAGE
	bool "Force authentication of FIP image against ROM API"
	help
	  By enabling this option the FIP image loaded by the first stage
	  will be authenticated against the K3 ROM API. Images which fail
	  to authenticate will not be started.

config ARCH_K3_COMMAND_AUTHENTICATE
	bool "k3_authenticate_image command"
	depends on COMMAND_SUPPORT
	help
	  Add k3_authenticate_image command to test authenticating images
	  against the K3 ROM API.

endmenu
```

## arch/arm/mach-layerscape/Kconfig
```kconfig
# SPDX-License-Identifier: GPL-2.0-only

if ARCH_LAYERSCAPE

config ARCH_LAYERSCAPE_ICID
	bool

config ARCH_LS1028
	bool
	select CPU_V8
	select SYS_SUPPORTS_64BIT_KERNEL
	select ARM_ATF
	select FIRMWARE_LS1028A_ATF
	select ARCH_LAYERSCAPE_ICID

config ARCH_LS1046
	bool
	select CPU_V8
	select ARM_ATF
	select SYS_SUPPORTS_64BIT_KERNEL
	select ARCH_LAYERSCAPE_ICID

if 64BIT

config MACH_LS1028ARDB
	bool "QorIQ LS1028A Reference Design Board"
	select ARCH_LS1028

config MACH_LS1046ARDB
	bool "QorIQ LS1046A Reference Design Board"
	select ARCH_LS1046
	select DDR_SPD
	select MCI_IMX_ESDHC_PBL
	select I2C_IMX_EARLY
	select DDR_FSL
	select DDR_FSL_DDR4

config MACH_TQMLS1046A
	bool "TQ TQMLS1046A Board"
	select ARCH_LS1046
	select MCI_IMX_ESDHC_PBL
	select I2C_IMX_EARLY
	select DDR_FSL
	select DDR_FSL_DDR4
	select FIRMWARE_LS1046A_ATF

endif

config ARCH_LS1021
	select CPU_V7
	bool

if 32BIT

config MACH_LS1021AIOT
	bool "LS1021AIOT Board"
	select ARCH_LS1021
	select DDR_FSL
	select DDR_FSL_DDR3

endif

endif
```

## arch/arm/mach-mvebu/Kconfig
```kconfig
if ARCH_MVEBU

config ARCH_TEXT_BASE
	hex
	default 0x2000000 if ARCH_ARMADA_370
	default 0x2000000 if ARCH_ARMADA_XP
	default 0x2000000 if ARCH_DOVE
	default 0x2000000 if ARCH_KIRKWOOD

config ARCH_ARMADA_370
	bool
	select CPU_V7
	select CLOCKSOURCE_MVEBU

config ARCH_ARMADA_XP
	bool
	select CPU_V7
	select CLOCKSOURCE_MVEBU

config ARCH_ARMADA_38X
	bool
	select CPU_V7
	select CLOCKSOURCE_MVEBU

config ARCH_DOVE
	bool
	select CPU_V7
	select CLOCKSOURCE_ORION

config ARCH_KIRKWOOD
	bool
	select CPU_FEROCEON
	select CLOCKSOURCE_ORION

#
# Armada 370 SoC boards
#

comment "Armada 370 based boards"

config MACH_GLOBALSCALE_MIRABOX
	bool "Globalscale Mirabox"
	select ARCH_ARMADA_370

config MACH_NETGEAR_RN104
	bool "Netgear ReadyNAS 104"
	select ARCH_ARMADA_370

#
# Armada XP SoC boards
#

comment "Armada XP based boards"

config MACH_LENOVO_IX4_300D
	bool "Lenovo Iomega ix4-300d"
	select ARCH_ARMADA_XP

config MACH_MARVELL_ARMADA_XP_GP
	bool "Marvell Armada XP GP"
	select ARCH_ARMADA_XP

config MACH_NETGEAR_RN2120
	bool "Netgear ReadyNAS 2120"
	select ARCH_ARMADA_XP

config MACH_PLATHOME_OPENBLOCKS_AX3
	bool "PlatHome OpenBlocks AX3"
	select ARCH_ARMADA_XP

#
# Armada 38x SoC boards
#

comment "Armada 38x based boards"

config MACH_TURRIS_OMNIA
	bool "Turris Omnia"
	select ARCH_ARMADA_38X

#
# Dove 88AP510 SoC boards
#

comment "Dove based boards"

config MACH_SOLIDRUN_CUBOX
	bool "SolidRun CuBox"
	select ARCH_DOVE

#
# Kirkwood SoC boards
#

comment "Kirkwood based boards"

config MACH_GLOBALSCALE_GURUPLUG
	bool "Guruplug"
	select ARCH_KIRKWOOD

config MACH_PLATHOME_OPENBLOCKS_A6
	bool "PlatHome OpenBlocks A6"
	select ARCH_KIRKWOOD

config MACH_USI_TOPKICK
	bool "Topkick"
	select ARCH_KIRKWOOD

#
# Common options
#

config MVEBU_CONSOLE_UART
	int "UART number for console"
	default 0
	range 0 1 if ARCH_ARMADA_370
	range 0 1 if ARCH_ARMADA_XP
	range 0 3 if ARCH_DOVE
	range 0 1 if ARCH_KIRKWOOD
	help
	  Select the UART number the barebox console will sit on.

endif # ARCH_MVEBU
```

## arch/arm/mach-mxs/Kconfig
```kconfig
if ARCH_MXS

config ARCH_TEXT_BASE
	hex
	default 0x41000000 if MACH_MX23EVK
	default 0x42000000 if MACH_CHUMBY
	default 0x42000000 if MACH_IMX233_OLINUXINO
	default 0x47000000 if MACH_TX28
	default 0x47000000 if MACH_MX28EVK
	default 0x47000000 if MACH_CFA10036

comment "Freescale i.MX System-on-Chip"

choice
	prompt "Freescale i.MX Processor"

config ARCH_IMX23
	bool "i.MX23"
	select STMP_DEVICE
	select CPU_ARM926T

config ARCH_IMX28
	bool "i.MX28"
	select CPU_ARM926T
	select STMP_DEVICE
	select ARCH_HAS_FEC_IMX

endchoice

if ARCH_IMX23

config MACH_MX23EVK
	bool "mx23-evk"
	help
	  Say Y here if you are using the Freescale i.MX23-EVK board

config MACH_CHUMBY
	bool "Chumby Falconwing"
	help
	  Say Y here if you are using the "chumby one" aka falconwing from
	  Chumby Industries

config MACH_IMX233_OLINUXINO
	bool "Olimex.ltd imx223-olinuxino"
	help
	  Say Y here if you are using the imx233-olinuxino

endif

if ARCH_IMX28

config MACH_TX28
	bool "KARO tx28"
	help
	  Say Y here if you are using the KARO TX28 CPU module.

config MACH_MX28EVK
	bool "mx28-evk"
	select MXS_OCOTP
	help
	  Say Y here if you are using the Freescale i.MX28-EVK board

config MACH_DUCKBILL
	bool "Duckbill"
	select MXS_OCOTP
	help
	  Say Y here if you are using the I2SE Duckbill board

config MACH_CFA10036
	bool "cfa-10036"
	select MXS_OCOTP
	select I2C_GPIO
	select EEPROM_AT24
	help
	  Say Y here if you are using the Crystalfontz CFA-10036 module

endif

menu "i.MX specific settings"

config MXS_OCOTP
	tristate "OCOTP device"
	help
	  Device driver for the On-Chip One Time Programmable (OCOTP). Use the
	  regular md/mw commands to read and write (if write is supported).

	  Note that the OCOTP words are grouped consecutively (allocation
	  internal view). Don't use register offsets here, the SET, CLR and
	  TGL registers are not mapped!

config MXS_OCOTP_WRITABLE
	bool "OCOTP write support"
	depends on MXS_OCOTP
	help
	  Enable this option to add writing to OCOTP.
	  Warning: blown bits can not be unblown. Use with care.

	  Before being actually able to blow the bits, you need to explicitely
	  enable writing:
	    ocotp0.permanent_write_enable=1

config MXS_CMD_BCB
	depends on NAND_MXS
	tristate "Nand bcb command"
	help
	  To be able to boot from NAND the i.MX23/28 need a Boot Control Block
	  in flash. This option enabled the 'bcb' command which can be used to
	  generate this block during runtime.

endmenu

menu "Board specific settings"

if MACH_TX28

choice
	prompt "TX28 Base Board Type"

config MACH_TX28STK5
	bool "TX28-stk5"
	select MXS_OCOTP
	help
	  Select this entry if you are running the TX28 CPU module on the
	  KARO TX28 Starterkit5.

endchoice

endif

endmenu

endif
```

## arch/arm/mach-netx/Kconfig
```kconfig
if ARCH_NETX

config ARCH_TEXT_BASE
	hex
	default 0x81f00000 if MACH_NXDB500

config NETX_SDRAM_CTRL
	hex
	default 0x010D0121 if MACH_NXDB500

config NETX_SDRAM_TIMING_CTRL
	hex
	default 0x03C13261 if MACH_NXDB500

config NETX_MEM_CTRL
	hex
	default 0x0203030F if MACH_NXDB500

config NETX_COOKIE
	hex
	default 32 if MACH_NXDB500

choice
	prompt "Netx Board Type"

config MACH_NXDB500
	bool "Hilscher Netx nxdb500"
	select HAS_NETX_ETHER
	help
	  Say Y here if you are using the Hilscher Netx nxdb500 board

endchoice

endif
```

## arch/arm/mach-nomadik/Kconfig
```kconfig
if ARCH_NOMADIK

config ARCH_TEXT_BASE
	hex
	default 0x03c00000 if MACH_NOMADIK_8815NHK

choice
	prompt "Nomadik boards"

config MACH_NOMADIK_8815NHK
	bool "ST 8815 Nomadik Hardware Kit (evaluation board)"
	select NOMADIK_8815
	select CLKDEV_LOOKUP

endchoice

config NOMADIK_8815
	bool
	select ARM_AMBA

endif
```

## arch/arm/mach-omap/Kconfig
```kconfig
#
# OMAP Architecture specific features
#
# (C) Copyright 2008
# Texas Instruments, <www.ti.com>
# Nishanth Menon <x0nishan@ti.com>
#
# This program is free software; you can redistribute it and/or
# modify it under the terms of the GNU General Public License as
# published by the Free Software Foundation; either version 2 of
# the License, or (at your option) any later version.
#
# This program is distributed in the hope that it will be useful,
# but WITHOUT ANY WARRANTY; without even the implied warranty of
# MERCHANTABILITY or FITNESS FOR A PARTICULAR PURPOSE. See the
# GNU General Public License for more details.
#

menu "OMAP Features"
	depends on ARCH_OMAP

config ARCH_OMAP3
	bool
	select CPU_V7
	select GENERIC_GPIO
	select CLOCKSOURCE_TI_32K
	help
	  Say Y here if you are using Texas Instrument's OMAP343x based platform

config ARCH_OMAP4
	bool
	select CPU_V7
	select GENERIC_GPIO
	select CLOCKSOURCE_TI_32K
	help
	  Say Y here if you are using Texas Instrument's OMAP4 based platform

config ARCH_AM33XX
	bool
	select CPU_V7
	select GENERIC_GPIO
	select CLOCKSOURCE_TI_DM
	select ARM_USE_COMPRESSED_DTB
	help
	  Say Y here if you are using Texas Instrument's AM33xx based platform

config ARCH_AM35XX
	bool
	select ARCH_OMAP3
	help
	  Say Y here if you are using Texas Instrument's AM35XX based platform

config OMAP_GPMC
	prompt "Support for GPMC configuration"
	bool
	default y
	help
	  Enable this if you use Texas Instrument's General purpose Memory
	  Controller(GPMC). GPMC allows you to configure devices such as NOR,
	  NAND, OneNAND etc.

config OMAP_BUILD_IFT
	prompt "build ift binary (MLO)"
	bool
	help
	  Say Y here if you want to build an MLO binary. On TI SoCs, this
	  binary is loaded to SRAM. It is responsible for initializing
	  the SDRAM and possibly chainloading a full-featured barebox.

config OMAP_BUILD_SPI
	prompt "build SPI binary"
	bool
	help
	  Say Y here if you want to build an barebox.spi image as used
	  on the AM35xx chips when booting from SPI NOR flash.

config BAREBOX_UPDATE_AM33XX_SPI_NOR_MLO
	prompt "barebox update SPI NOR MLO handler"
	bool
	depends on BAREBOX_UPDATE
	help
	  Say Y for barebox update SPI NOR MLO handler.
	  AM35xx, AM33xx chips use big endian MLO for SPI NOR flash.

config BAREBOX_UPDATE_AM33XX_NAND
	prompt "barebox update NAND handler"
	bool
	depends on BAREBOX_UPDATE
	help
	  Say Y for barebox update NAND handler. This update handler updates
	  4 default NAND xload slots with a single command.
	  The Handler also checks if the given image has a valid CH header.
	  This also includes a handler for updating the regular barebox binary
	  in NAND.

config BAREBOX_UPDATE_AM33XX_EMMC
	prompt "barebox update eMMC handler"
	bool
	depends on BAREBOX_UPDATE
	help
	  Say Y for barebox update eMMC handler.

config AM33XX_NET_BOOT
	bool "enable AM335x network boot"
	select ENVIRONMENT_VARIABLES
	select NET_DHCP
	select FS_RAMFS
	select FS_TFTP
	select DRIVER_NET_CPSW
	default n
	depends on ARCH_AM33XX && NET

config OMAP4_USBBOOT
	bool "enable booting from USB"
	default n
	depends on ARCH_OMAP4 && !MMU
	help
	  Say Y here if you want to be able to boot an OMAP4 cpu from USB.
	  You need the utility program omap4_usbboot to boot from USB.
	  Please read omap4_usb_booting.txt for more information.

config OMAP3_USBBOOT
	bool "enable booting from USB"
	depends on ARCH_OMAP3
	help
	  Say Y here if you want to be able to boot the 2nd stage via USB. This
	  works by transferring the 2nd stage image using the MUSB controller
	  which is already initialized by the ROM code. Use the omap3-usb-loader
	  tool selectable below to upload images.

config OMAP_SERIALBOOT
	bool "enable booting from serial"
	select XYMODEM
	select FS_RAMFS
	depends on ARCH_AM33XX && SHELL_NONE
	depends on !CONSOLE_NONE
	help
	  Say Y here if you want to load the 2nd stage barebox.bin with
	  xmodem after booting from serial line.

config MACH_AFI_GF
	bool "af inventions GF"
	select ARCH_AM33XX
	  help
	  Say Y here if you are using afis GF

config MACH_BEAGLE
	bool "Texas Instrument's Beagle Board"
	select ARCH_OMAP3
	help
	  Say Y here if you are using Beagle Board

config MACH_BEAGLEBONE
	bool "Texas Instrument's Beagle Bone"
	select ARCH_AM33XX
	help
	  Say Y here if you are using Beagle Bone

config MACH_MYIRTECH_X335X
	bool "MYIR Tech Limited SOMs"
	select ARCH_AM33XX
	help
	  Say Y here if you are using a TI AM335X based MYIR SOM

config MACH_PHYTEC_SOM_AM335X
	bool "Phytec AM335X SOMs"
	select ARCH_AM33XX
	help
	  Say Y here if you are using a am335x based Phytecs SOM

config MACH_VSCOM_BALTOS
	bool "VScom Baltos Devices"
	select ARCH_AM33XX
	help
	  Say Y here if you are using a am335x based VScom Baltos devices

config MACH_WAGO_PFC_AM35XX
        bool "Wago PFC200 Fieldbus Controller"
        select ARCH_AM35XX
        help
          Say Y here if you are using a the AM3505 based PFC200 controller

source "arch/arm/boards/phytec-som-am335x/Kconfig"

endmenu
```

## arch/arm/mach-qemu/Kconfig
```kconfig
if ARCH_QEMU

config ARCH_TEXT_BASE
	hex
	default 0x40000000

choice
	prompt "ARM Board type"

config MACH_QEMU_VIRT64
	bool "QEMU arm64 virt machine"
	select CPU_V8
	select SYS_SUPPORTS_64BIT_KERNEL
	select ARM_AMBA
	select HAVE_CONFIGURABLE_MEMORY_LAYOUT

endchoice
endif
```

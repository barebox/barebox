## arch/riscv/configs/rv64i_defconfig
```kconfig
CONFIG_ARCH_RV64I=y
CONFIG_SOC_ALLWINNER_SUN20I=y
CONFIG_SOC_SIFIVE=y
CONFIG_SOC_STARFIVE=y
CONFIG_SOC_VIRT=y
CONFIG_BOARD_ALLWINNER_D1=y
CONFIG_BOARD_BEAGLEV=y
CONFIG_BOARD_BEAGLEV_BETA=y
CONFIG_BOARD_HIFIVE=y
CONFIG_BOARD_GENERIC_DT=y
CONFIG_RISCV_OPTIMZED_STRING_FUNCTIONS=y
CONFIG_STACK_SIZE=0x20000
CONFIG_MALLOC_SIZE=0x0
CONFIG_MALLOC_TLSF=y
CONFIG_KALLSYMS=y
CONFIG_RELOCATABLE=y
CONFIG_PANIC_HANG=y
CONFIG_HUSH_FANCY_PROMPT=y
CONFIG_CMDLINE_EDITING=y
CONFIG_AUTO_COMPLETE=y
CONFIG_MENU=y
CONFIG_BOOTM_VERBOSE=y
CONFIG_BOOTM_INITRD=y
CONFIG_SYSTEM_PARTITIONS=y
CONFIG_BLSPEC=y
CONFIG_CONSOLE_ACTIVATE_ALL=y
CONFIG_CONSOLE_ALLOW_COLOR=y
CONFIG_PBL_CONSOLE=y
CONFIG_PARTITION_DISK_EFI=y
CONFIG_DEFAULT_ENVIRONMENT_GENERIC_NEW=y
CONFIG_DEFAULT_ENVIRONMENT_GENERIC_NEW_IKCONFIG=y
CONFIG_STATE=y
CONFIG_STATE_CRYPTO=y
CONFIG_BOOTCHOOSER=y
CONFIG_RESET_SOURCE=y
CONFIG_MACHINE_ID=y
CONFIG_CMD_DMESG=y
CONFIG_LONGHELP=y
CONFIG_CMD_IOMEM=y
CONFIG_CMD_IMD=y
CONFIG_CMD_MEMINFO=y
CONFIG_CMD_POLLER=y
CONFIG_CMD_SLICE=y
CONFIG_CMD_GO=y
CONFIG_CMD_LOADY=y
CONFIG_CMD_RESET=y
CONFIG_CMD_BOOTCHOOSER=y
CONFIG_CMD_EXPORT=y
CONFIG_CMD_PRINTENV=y
CONFIG_CMD_MAGICVAR=y
CONFIG_CMD_MAGICVAR_HELP=y
CONFIG_CMD_SAVEENV=y
CONFIG_CMD_CMP=y
CONFIG_CMD_FILETYPE=y
CONFIG_CMD_LN=y
CONFIG_CMD_MD5SUM=y
CONFIG_CMD_SHA1SUM=y
CONFIG_CMD_SHA256SUM=y
CONFIG_CMD_UNCOMPRESS=y
CONFIG_CMD_MSLEEP=y
CONFIG_CMD_SLEEP=y
CONFIG_CMD_DHCP=y
CONFIG_CMD_MIITOOL=y
CONFIG_CMD_PING=y
CONFIG_CMD_ECHO_E=y
CONFIG_CMD_EDIT=y
CONFIG_CMD_SPLASH=y
CONFIG_CMD_FBTEST=y
CONFIG_CMD_READLINE=y
CONFIG_CMD_TIMEOUT=y
CONFIG_CMD_MEMTEST=y
CONFIG_CMD_MM=y
CONFIG_CMD_CLK=y
CONFIG_CMD_DETECT=y
CONFIG_CMD_FLASH=y
CONFIG_CMD_GPIO=y
CONFIG_CMD_I2C=y
CONFIG_CMD_POWEROFF=y
CONFIG_CMD_SPI=y
CONFIG_CMD_WD=y
CONFIG_CMD_2048=y
CONFIG_CMD_BAREBOX_UPDATE=y
CONFIG_CMD_OF_DIFF=y
CONFIG_CMD_OF_NODE=y
CONFIG_CMD_OF_PROPERTY=y
CONFIG_CMD_OF_DISPLAY_TIMINGS=y
CONFIG_CMD_OF_FIXUP_STATUS=y
CONFIG_CMD_OF_OVERLAY=y
CONFIG_CMD_OFTREE=y
CONFIG_CMD_TIME=y
CONFIG_CMD_STATE=y
CONFIG_CMD_DHRYSTONE=y
CONFIG_NET=y
CONFIG_NET_NETCONSOLE=y
CONFIG_NET_FASTBOOT=y
CONFIG_NET_9P=y
CONFIG_NET_9P_VIRTIO=y
CONFIG_OF_BAREBOX_DRIVERS=y
CONFIG_OF_BAREBOX_ENV_IN_FS=y
CONFIG_DRIVER_SERIAL_NS16550=y
CONFIG_VIRTIO_CONSOLE=y
CONFIG_SERIAL_SIFIVE=y
CONFIG_DRIVER_NET_MACB=y
CONFIG_DRIVER_NET_DESIGNWARE=y
CONFIG_DRIVER_NET_DESIGNWARE_GENERIC=y
CONFIG_DRIVER_NET_DESIGNWARE_STARFIVE=y
CONFIG_DRIVER_NET_VIRTIO=y
CONFIG_MICREL_PHY=y
CONFIG_SPI_MEM=y
CONFIG_DRIVER_SPI_GPIO=y
CONFIG_SPI_SIFIVE=y
CONFIG_I2C=y
CONFIG_I2C_GPIO=y
CONFIG_MTD=y
# CONFIG_MTD_OOB_DEVICE is not set
CONFIG_MTD_RAW_DEVICE=y
CONFIG_MTD_CONCAT=y
CONFIG_MTD_M25P80=y
CONFIG_MTD_MTDRAM=y
CONFIG_DRIVER_CFI=y
CONFIG_DRIVER_CFI_BANK_WIDTH_8=y
CONFIG_DISK=y
CONFIG_DISK_WRITE=y
CONFIG_VIRTIO_BLK=y
CONFIG_VIDEO=y
CONFIG_FRAMEBUFFER_CONSOLE=y
CONFIG_DRIVER_VIDEO_BOCHS_PCI=y
CONFIG_DRIVER_VIDEO_SIMPLEFB_CLIENT=y
CONFIG_MCI=y
CONFIG_MCI_SPI=y
CONFIG_MCI_DW=y
CONFIG_CLOCKSOURCE_DUMMY_RATE=60000
CONFIG_STATE_DRV=y
CONFIG_EEPROM_AT24=y
CONFIG_VIRTIO_INPUT=y
CONFIG_SRAM=y
CONFIG_STARFIVE_PWRSEQ=y
CONFIG_LED=y
CONFIG_LED_GPIO=y
CONFIG_LED_GPIO_OF=y
CONFIG_LED_TRIGGERS=y
CONFIG_WATCHDOG=y
CONFIG_STARFIVE_WDT=y
CONFIG_HWRNG=y
CONFIG_HW_RANDOM_VIRTIO=y
CONFIG_GPIO_SIFIVE=y
CONFIG_HW_RANDOM_STARFIVE=y
CONFIG_GPIO_GENERIC_PLATFORM=y
CONFIG_GPIO_STARFIVE=y
CONFIG_PINCTRL_SINGLE=y
CONFIG_NVMEM=y
CONFIG_NVMEM_RMEM=y
CONFIG_STARFIVE_OTP=y
CONFIG_PCI_ECAM_GENERIC=y
CONFIG_BLK_DEV_NVME=y
CONFIG_SYSCON_REBOOT_MODE=y
CONFIG_NVMEM_REBOOT_MODE=y
CONFIG_POWER_RESET_SYSCON=y
CONFIG_POWER_RESET_SYSCON_POWEROFF=y
CONFIG_POWER_RESET_HTIF_POWEROFF=y
CONFIG_POWER_RESET_GPIO=y
CONFIG_POWER_RESET_GPIO_RESTART=y
CONFIG_VIRTIO_MMIO=y
# CONFIG_VIRTIO_MENU is not set
CONFIG_FS_EXT4=y
CONFIG_FS_TFTP=y
CONFIG_FS_NFS=y
CONFIG_9P_FS=y
CONFIG_9P_FS_WRITE=y
CONFIG_FS_FAT=y
CONFIG_FS_FAT_WRITE=y
CONFIG_FS_FAT_LFN=y
CONFIG_FS_UIMAGEFS=y
CONFIG_FS_PSTORE=y
CONFIG_FS_SQUASHFS=y
CONFIG_ZLIB=y
CONFIG_BZLIB=y
CONFIG_LZ4_DECOMPRESS=y
CONFIG_ZSTD_DECOMPRESS=y
CONFIG_XZ_DECOMPRESS=y
CONFIG_BASE64=y
CONFIG_LZO_DECOMPRESS=y
CONFIG_DIGEST_CRC32_GENERIC=y
CONFIG_IMD_TARGET=y
CONFIG_BAREBOXENV_TARGET=y
CONFIG_BAREBOXCRC32_TARGET=y
```

## arch/riscv/mach-erizo/Kconfig
```kconfig
if MACH_ERIZO

choice
	prompt "Board type"

config BOARD_ERIZO_GENERIC
	bool "erizo generic board"

endchoice

endif
```

## arch/sandbox/Kconfig
```kconfig
# SPDX-License-Identifier: GPL-2.0-only

source "scripts/Kconfig.include"

config SANDBOX
	bool
	select OFTREE
	select GPIOLIB
	select ARCH_HAS_UBSAN_SANITIZE_ALL
	select HAS_DMA
	select BLOCK
	select BLOCK_WRITE
	select PARTITION
	select PARTITION_DISK
	select ARCH_HAS_STACK_DUMP if ASAN
	select GENERIC_FIND_NEXT_BIT
	select ARCH_HAS_SJLJ
	select ARCH_HAS_CTRLC
	select HAS_DEBUG_LL
	select ARCH_DMA_DEFAULT_COHERENT
	select ARCH_WANT_FRAME_POINTERS
	select BAREBOX_CMDLINE
	select HAVE_ARCH_BOOTM_OFTREE
	default y

config ARCH_LINUX_NAME
	string
	default "um"

config ARCH_TEXT_BASE
	hex
	default 0x00000000

menu "Sandbox specific settings"

config CC_IS_64BIT
	def_bool $(success,$(srctree)/scripts/gcc-64bitptr.sh $(CC))

config CC_HAS_LINUX_I386_SUPPORT
	def_bool $(cc-option,-m32) && $(ld-option,-m elf_i386)
	depends on CC_IS_GCC

config 64BIT
	bool
	prompt "64-bit barebox" if CC_HAS_LINUX_I386_SUPPORT
	default CC_IS_64BIT
	select ARCH_DMA_ADDR_T_64BIT
	select PHYS_ADDR_T_64BIT
	select ARCH_HAS_ASAN_FIBER_API if ASAN
	help
	  Say n here if you want to build a 32-bit barebox, either
	  to be more similar to a target platform or to reduce
	  memory usage when fuzzing for example.

	  If unsure, say y.

config 32BIT
	def_bool !64BIT

config SANDBOX_LINUX_I386
	def_bool 32BIT && CC_HAS_LINUX_I386_SUPPORT

config SANDBOX_REEXEC
	prompt "exec(2) reset handler"
	def_bool y
	help
	  The normal reset handler hangs barebox. On Linux, barebox
	  instead can exec itself to simulate a reset.

config SANDBOX_SJLJ_ASM
	bool "use setjmp/longjmp/initjmp implemented in assembly" if COMPILE_TEST
	default y
	help
	  sandbox has a C implementation of initjmp, which can run afoul of code
	  hardening measures like ASAN. The assembly version isn't immune to these
	  issues, but it's easier to reason about than the sigaltstack hack.

config CMD_SANDBOX_CPUINFO
	bool "cpuinfo command"
	depends on COMMAND_SUPPORT
	default y
	help
	  Say yes here to get a dummy cpuinfo command.

config HAVE_LIBSDL2
	def_bool $(success,$(CROSS_PKG_CONFIG) --exists sdl2)

config HAVE_LIBFTDI
	def_bool $(success,$(CROSS_PKG_CONFIG) --exists libftdi1)

config SDL
	bool

endmenu
```

## arch/sandbox/Kconfig.debug
```kconfig
# SPDX-License-Identifier: GPL-2.0-only

config ASAN
	bool "ASAN: runtime memory debugger"
	help
	  Enables ASAN (AddressSANitizer) - runtime memory debugger,
	  designed to find out-of-bounds accesses and use-after-free bugs.

	  This is the hosted implementation for sandbox as opposed to
	  KASAN, which is the bare-metal implementation.
```

## arch/sandbox/configs/hosttools_defconfig
```kconfig
CONFIG_NAME="hosttools_defconfig"
CONFIG_IMD=y
CONFIG_COMPILE_HOST_TOOLS=y
CONFIG_ARCH_IMX_USBLOADER=y
CONFIG_MVEBU_HOSTTOOLS=y
CONFIG_OMAP3_USB_LOADER=y
CONFIG_OMAP4_HOSTTOOL_USBBOOT=y
CONFIG_RK_USB_LOADER=y
```

## arch/sandbox/configs/sandbox_defconfig
```kconfig
CONFIG_HUSH_FANCY_PROMPT=y
CONFIG_CMDLINE_EDITING=y
CONFIG_AUTO_COMPLETE=y
CONFIG_MENU=y
CONFIG_PARTITION=y
CONFIG_DEFAULT_COMPRESSION_GZIP=y
CONFIG_DEFAULT_ENVIRONMENT_GENERIC_NEW=y
CONFIG_DEFAULT_ENVIRONMENT_PATH="arch/sandbox/board/env"
CONFIG_DEBUG_INFO=y
CONFIG_CMD_DMESG=y
CONFIG_LONGHELP=y
CONFIG_CMD_IMD=y
CONFIG_CMD_MEMINFO=y
# CONFIG_CMD_BOOTM is not set
CONFIG_CMD_GO=y
CONFIG_CMD_UIMAGE=y
CONFIG_CMD_PARTITION=y
CONFIG_CMD_EXPORT=y
CONFIG_CMD_DEFAULTENV=y
CONFIG_CMD_PRINTENV=y
CONFIG_CMD_MAGICVAR=y
CONFIG_CMD_MAGICVAR_HELP=y
CONFIG_CMD_SAVEENV=y
CONFIG_CMD_CMP=y
CONFIG_CMD_FILETYPE=y
CONFIG_CMD_LN=y
CONFIG_CMD_MD5SUM=y
CONFIG_CMD_SHA1SUM=y
CONFIG_CMD_SHA224SUM=y
CONFIG_CMD_SHA256SUM=y
CONFIG_CMD_SHA384SUM=y
CONFIG_CMD_SHA512SUM=y
CONFIG_CMD_UNCOMPRESS=y
CONFIG_CMD_LET=y
CONFIG_CMD_MSLEEP=y
CONFIG_CMD_READF=y
CONFIG_CMD_SLEEP=y
CONFIG_CMD_DHCP=y
CONFIG_CMD_HOST=y
CONFIG_CMD_PING=y
CONFIG_CMD_TFTP=y
CONFIG_CMD_ECHO_E=y
CONFIG_CMD_EDIT=y
CONFIG_CMD_MENU=y
CONFIG_CMD_MENU_MANAGEMENT=y
CONFIG_CMD_MENUTREE=y
CONFIG_CMD_SPLASH=y
CONFIG_CMD_READLINE=y
CONFIG_CMD_TIMEOUT=y
CONFIG_CMD_CRC=y
CONFIG_CMD_CRC_CMP=y
CONFIG_CMD_MM=y
CONFIG_CMD_DETECT=y
CONFIG_CMD_FLASH=y
CONFIG_CMD_POWEROFF=y
CONFIG_CMD_GPIO=y
CONFIG_CMD_I2C=y
CONFIG_CMD_LED=y
CONFIG_CMD_SPI=y
CONFIG_CMD_LED_TRIGGER=y
CONFIG_CMD_2048=y
CONFIG_CMD_OF_NODE=y
CONFIG_CMD_OF_PROPERTY=y
CONFIG_CMD_OF_DISPLAY_TIMINGS=y
CONFIG_CMD_OFTREE=y
CONFIG_CMD_TIME=y
CONFIG_CMD_SPD_DECODE=y
CONFIG_NET=y
CONFIG_NET_NFS=y
CONFIG_NET_NETCONSOLE=y
CONFIG_OFDEVICE=y
CONFIG_OF_BAREBOX_DRIVERS=y
CONFIG_DRIVER_NET_TAP=y
CONFIG_DRIVER_SPI_GPIO=y
CONFIG_I2C=y
CONFIG_I2C_GPIO=y
CONFIG_MTD=y
CONFIG_MTD_M25P80=y
CONFIG_VIDEO=y
CONFIG_FRAMEBUFFER_CONSOLE=y
CONFIG_LED=y
CONFIG_LED_GPIO=y
CONFIG_LED_GPIO_OF=y
CONFIG_LED_GPIO_RGB=y
CONFIG_LED_GPIO_BICOLOR=y
CONFIG_LED_TRIGGERS=y
CONFIG_EEPROM_AT25=y
CONFIG_EEPROM_AT24=y
# CONFIG_PINCTRL is not set
CONFIG_RTC_CLASS=y
CONFIG_RTC_DRV_DS1307=y
CONFIG_FS_CRAMFS=y
CONFIG_FS_EXT4=y
CONFIG_FS_TFTP=y
CONFIG_FS_NFS=y
CONFIG_FS_FAT=y
CONFIG_FS_FAT_WRITE=y
CONFIG_FS_FAT_LFN=y
CONFIG_FS_BPKFS=y
CONFIG_FS_UIMAGEFS=y
CONFIG_FS_SQUASHFS=y
CONFIG_BZLIB=y
CONFIG_LZ4_DECOMPRESS=y
CONFIG_XZ_DECOMPRESS=y
CONFIG_LZO_DECOMPRESS=y
CONFIG_BMP=y
CONFIG_PNG=y
CONFIG_FONT_8x16=y
CONFIG_FONT_7x14=y
CONFIG_FONT_MINI_4x6=y
CONFIG_BAREBOX_LOGO=y
CONFIG_BAREBOX_LOGO_64=y
CONFIG_BAREBOX_LOGO_240=y
CONFIG_BAREBOX_LOGO_320=y
CONFIG_BAREBOX_LOGO_400=y
CONFIG_BAREBOX_LOGO_640=y
CONFIG_DIGEST_HMAC_GENERIC=y
```

## arch/sandbox/configs/targettools_defconfig
```kconfig
CONFIG_NAME="targettools_defconfig"
CONFIG_IMD=y
CONFIG_IMD_TARGET=y
CONFIG_KERNEL_INSTALL_TARGET=y
CONFIG_BAREBOXENV_TARGET=y
CONFIG_BAREBOXCRC32_TARGET=y
CONFIG_MVEBU_KWBOOT_TARGET=y
CONFIG_ARCH_IMX_USBLOADER_TARGET=y
CONFIG_OMAP3_USB_LOADER_TARGET=y
CONFIG_OMAP4_USBBOOT_TARGET=y
CONFIG_RK_USB_LOADER_TARGET=y
```

## arch/x86/Kconfig
```kconfig
# SPDX-License-Identifier: GPL-2.0-only

config X86
	bool
	select HAS_KALLSYMS
	select HAS_DMA
	select GENERIC_FIND_NEXT_BIT
	select ARCH_DMA_DEFAULT_COHERENT
	select HAVE_EFI_PAYLOAD
	default y

config ARCH_TEXT_BASE
	hex
	default 0x0

menu "ARCH specific settings"

config 64BIT
	def_bool y if X86_EFI
	select ARCH_DMA_ADDR_T_64BIT
	help
	  Say yes to build a 64-bit binary - formerly known as x86_64
	  Say no to build a 32-bit binary - formerly known as i386.

	  32-bit support currently does not compile and is not tested
	  due to the lack of hardware.

config X86_32
	def_bool y
	depends on !64BIT
	select ARCH_HAS_SJLJ

config X86_64
	def_bool y
	depends on 64BIT
	select ARCH_HAS_SJLJ

endmenu

config MACH_EFI_GENERIC
	def_bool y
	depends on X86_EFI
	select HAS_DEBUG_LL
	help
	  Say Y here if you want barebox to be your EFI based bootloader


config X86_EFI
	def_bool y
	select EFI_PAYLOAD
	select CLOCKSOURCE_EFI_X86
```

## arch/x86/boot/Kconfig
```kconfig
if X86_BIOS_BRINGUP

menu "BIOS boot source"

config X86_HDBOOT
	bool "HD boot"
	help
	  Add code to boot from harddisk

config X86_VESA
	bool
	default y if X86_GENERIC_HAS_VIDEO

config X86_VGA
	bool
	default y if X86_GENERIC_HAS_VIDEO

endmenu

endif
```

## arch/x86/configs/efi_defconfig
```kconfig
CONFIG_MMU=y
CONFIG_MALLOC_SIZE=0x0
CONFIG_MALLOC_TLSF=y
CONFIG_HUSH_FANCY_PROMPT=y
CONFIG_CMDLINE_EDITING=y
CONFIG_AUTO_COMPLETE=y
CONFIG_MENU=y
# CONFIG_TIMESTAMP is not set
CONFIG_BOOTM_SHOW_TYPE=y
CONFIG_BOOTM_VERBOSE=y
CONFIG_BOOTM_INITRD=y
CONFIG_BOOTM_OFTREE=y
CONFIG_BLSPEC=y
CONFIG_CONSOLE_ACTIVATE_ALL=y
CONFIG_PARTITION_DISK_EFI=y
CONFIG_DEFAULT_ENVIRONMENT_GENERIC_NEW=y
CONFIG_POLLER=y
CONFIG_DEBUG_INFO=y
CONFIG_DEBUG_LL=y
CONFIG_LONGHELP=y
CONFIG_CMD_IOMEM=y
CONFIG_CMD_MEMINFO=y
# CONFIG_CMD_LINUX16 is not set
CONFIG_CMD_GO=y
CONFIG_CMD_LOADB=y
CONFIG_CMD_RESET=y
CONFIG_CMD_UIMAGE=y
CONFIG_CMD_PARTITION=y
CONFIG_CMD_EXPORT=y
CONFIG_CMD_LOADENV=y
CONFIG_CMD_PRINTENV=y
CONFIG_CMD_MAGICVAR=y
CONFIG_CMD_MAGICVAR_HELP=y
CONFIG_CMD_SAVEENV=y
CONFIG_CMD_FILETYPE=y
CONFIG_CMD_LN=y
CONFIG_CMD_MD5SUM=y
CONFIG_CMD_UNCOMPRESS=y
CONFIG_CMD_LET=y
CONFIG_CMD_MSLEEP=y
CONFIG_CMD_READF=y
CONFIG_CMD_SLEEP=y
CONFIG_CMD_DHCP=y
CONFIG_CMD_HOST=y
CONFIG_CMD_PING=y
CONFIG_CMD_TFTP=y
CONFIG_CMD_ECHO_E=y
CONFIG_CMD_EDIT=y
CONFIG_CMD_MENU=y
CONFIG_CMD_MENUTREE=y
CONFIG_CMD_READLINE=y
CONFIG_CMD_TIMEOUT=y
CONFIG_CMD_CRC=y
CONFIG_CMD_CRC_CMP=y
CONFIG_CMD_MM=y
CONFIG_CMD_DETECT=y
CONFIG_CMD_FLASH=y
CONFIG_CMD_2048=y
CONFIG_CMD_BAREBOX_UPDATE=y
CONFIG_CMD_OF_NODE=y
CONFIG_CMD_OF_PROPERTY=y
CONFIG_CMD_OFTREE=y
CONFIG_CMD_TIME=y
CONFIG_NET=y
CONFIG_NET_NFS=y
CONFIG_NET_NETCONSOLE=y
CONFIG_DRIVER_SERIAL_EFI_STDIO=y
CONFIG_DRIVER_SERIAL_NS16550=y
CONFIG_DRIVER_NET_EFI_SNP=y
# CONFIG_SPI is not set
CONFIG_DISK=y
CONFIG_FS_EXT4=y
CONFIG_FS_TFTP=y
CONFIG_FS_NFS=y
CONFIG_FS_EFI=y
CONFIG_FS_EFIVARFS=y
CONFIG_FS_FAT=y
CONFIG_FS_FAT_WRITE=y
CONFIG_FS_FAT_LFN=y
```

## arch/x86/configs/generic_defconfig
```kconfig
CONFIG_X86_HDBOOT=y
CONFIG_STACK_SIZE=0x7000
CONFIG_EXPERIMENTAL=y
CONFIG_GLOB=y
CONFIG_CMDLINE_EDITING=y
CONFIG_AUTO_COMPLETE=y
CONFIG_PARTITION=y
CONFIG_DEFAULT_ENVIRONMENT_PATH="arch/x86/boards/x86_generic/env"
CONFIG_DEBUG_INFO=y
CONFIG_LONGHELP=y
CONFIG_CMD_MEMINFO=y
# CONFIG_CMD_BOOTM is not set
CONFIG_CMD_GO=y
CONFIG_CMD_RESET=y
CONFIG_CMD_EXPORT=y
CONFIG_CMD_LOADENV=y
CONFIG_CMD_PRINTENV=y
CONFIG_CMD_SAVEENV=y
# CONFIG_CMD_FALSE is not set
CONFIG_CMD_SLEEP=y
# CONFIG_CMD_TRUE is not set
CONFIG_CMD_EDIT=y
CONFIG_CMD_READLINE=y
CONFIG_CMD_TIMEOUT=y
CONFIG_DRIVER_SERIAL_NS16550=y
# CONFIG_SPI is not set
```

## arch/x86/mach-i386/Kconfig
```kconfig
menu "Board specific settings"

if X86_BOOTLOADER

config X86_GENERIC_HAS_VIDEO
	bool "video support"
	help
	  Say Y here if the target supports a video output

endif

endmenu
```

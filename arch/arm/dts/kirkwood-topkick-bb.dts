/*
 * Barebox specific DT overlay for USI Topkick
 *   Sebastian Hesselbarth <sebastian.hesselbarth@gmail.com>
 */

#include "arm/marvell/kirkwood-topkick.dts"

/ {
	barebox,disable-deep-probe;
};

&{/gpio-leds/system} {
	barebox,default-trigger = "heartbeat";
};

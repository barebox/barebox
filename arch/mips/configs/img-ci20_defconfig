## arch/mips/configs/img-ci20_defconfig
```kconfig
CONFIG_BUILTIN_DTB=y
CONFIG_BUILTIN_DTB_NAME="img-ci20"
CONFIG_MACH_MIPS_XBURST=y
CONFIG_BOARD_CI20=y
CONFIG_PBL_IMAGE=y
CONFIG_GLOB=y
CONFIG_HUSH_FANCY_PROMPT=y
CONFIG_CMDLINE_EDITING=y
CONFIG_AUTO_COMPLETE=y
CONFIG_BOOTM_SHOW_TYPE=y
CONFIG_BOOTM_VERBOSE=y
CONFIG_BOOTM_INITRD=y
CONFIG_BOOTM_OFTREE=y
CONFIG_BOOTM_OFTREE_UIMAGE=y
# CONFIG_DEFAULT_ENVIRONMENT is not set
CONFIG_POLLER=y
CONFIG_DEBUG_LL=y
CONFIG_LONGHELP=y
CONFIG_CMD_IOMEM=y
CONFIG_CMD_MEMINFO=y
CONFIG_CMD_GO=y
CONFIG_CMD_LOADB=y
CONFIG_CMD_LOADS=y
CONFIG_CMD_LOADY=y
CONFIG_CMD_RESET=y
CONFIG_CMD_SAVES=y
CONFIG_CMD_UIMAGE=y
CONFIG_CMD_MD5SUM=y
CONFIG_CMD_GETOPT=y
CONFIG_CMD_SLEEP=y
CONFIG_CMD_DHCP=y
CONFIG_CMD_MIITOOL=y
CONFIG_CMD_PING=y
CONFIG_CMD_TFTP=y
CONFIG_CMD_EDIT=y
CONFIG_CMD_GPIO=y
CONFIG_CMD_OF_NODE=y
CONFIG_CMD_OF_PROPERTY=y
CONFIG_CMD_OFTREE=y
CONFIG_NET=y
CONFIG_OFDEVICE=y
CONFIG_DRIVER_NET_DM9K=y
# CONFIG_SPI is not set
CONFIG_CLOCKSOURCE_DUMMY_RATE=3500
CONFIG_FS_TFTP=y
```

## arch/mips/configs/loongson-ls1b_defconfig
```kconfig
CONFIG_BUILTIN_DTB=y
CONFIG_BUILTIN_DTB_NAME="loongson-ls1b"
CONFIG_MACH_MIPS_LOONGSON=y
CONFIG_PBL_IMAGE=y
CONFIG_STACK_SIZE=0x7000
CONFIG_EXPERIMENTAL=y
CONFIG_MALLOC_TLSF=y
CONFIG_HUSH_FANCY_PROMPT=y
CONFIG_CMDLINE_EDITING=y
CONFIG_AUTO_COMPLETE=y
CONFIG_MENU=y
CONFIG_FLEXIBLE_BOOTARGS=y
CONFIG_PARTITION=y
# CONFIG_DEFAULT_ENVIRONMENT is not set
CONFIG_POLLER=y
CONFIG_RESET_SOURCE=y
CONFIG_DEBUG_INFO=y
CONFIG_LONGHELP=y
CONFIG_CMD_IOMEM=y
CONFIG_CMD_MEMINFO=y
# CONFIG_CMD_BOOTM is not set
CONFIG_CMD_GO=y
CONFIG_CMD_LOADB=y
CONFIG_CMD_LOADS=y
CONFIG_CMD_LOADY=y
CONFIG_CMD_RESET=y
CONFIG_CMD_SAVES=y
# CONFIG_CMD_MOUNT is not set
# CONFIG_CMD_UMOUNT is not set
CONFIG_CMD_EXPORT=y
CONFIG_CMD_GLOBAL=y
CONFIG_CMD_PRINTENV=y
CONFIG_CMD_GETOPT=y
CONFIG_CMD_LET=y
CONFIG_CMD_SLEEP=y
CONFIG_CMD_ECHO_E=y
CONFIG_CMD_EDIT=y
CONFIG_CMD_READLINE=y
CONFIG_CMD_TIMEOUT=y
CONFIG_CMD_OF_NODE=y
CONFIG_CMD_OF_PROPERTY=y
CONFIG_CMD_OFTREE=y
CONFIG_CMD_TIME=y
CONFIG_OFDEVICE=y
# CONFIG_SPI is not set
CONFIG_ZLIB=y
CONFIG_BZLIB=y
```

## arch/mips/configs/qemu-malta_defconfig
```kconfig
CONFIG_BUILTIN_DTB=y
CONFIG_BUILTIN_DTB_NAME="qemu-malta"
CONFIG_PBL_IMAGE=y
CONFIG_BAREBOX_MAX_IMAGE_SIZE=0x400000
CONFIG_STACK_SIZE=0x7000
CONFIG_EXPERIMENTAL=y
CONFIG_BAUDRATE=38400
CONFIG_HUSH_FANCY_PROMPT=y
CONFIG_CMDLINE_EDITING=y
CONFIG_AUTO_COMPLETE=y
CONFIG_MENU=y
CONFIG_BOOTM_SHOW_TYPE=y
CONFIG_PARTITION=y
# CONFIG_DEFAULT_ENVIRONMENT is not set
CONFIG_POLLER=y
CONFIG_DEBUG_INFO=y
CONFIG_LONGHELP=y
CONFIG_CMD_IOMEM=y
CONFIG_CMD_IMD=y
CONFIG_CMD_MEMINFO=y
CONFIG_CMD_GO=y
CONFIG_CMD_LOADB=y
CONFIG_CMD_LOADY=y
CONFIG_CMD_RESET=y
CONFIG_CMD_PARTITION=y
CONFIG_CMD_EXPORT=y
CONFIG_CMD_LOADENV=y
CONFIG_CMD_PRINTENV=y
CONFIG_CMD_SAVEENV=y
CONFIG_CMD_MD5SUM=y
CONFIG_CMD_SHA1SUM=y
CONFIG_CMD_SHA256SUM=y
CONFIG_CMD_UNCOMPRESS=y
CONFIG_CMD_GETOPT=y
CONFIG_CMD_SLEEP=y
CONFIG_CMD_DHCP=y
CONFIG_CMD_MIITOOL=y
CONFIG_CMD_PING=y
CONFIG_CMD_TFTP=y
CONFIG_CMD_ECHO_E=y
CONFIG_CMD_EDIT=y
CONFIG_CMD_LOGIN=y
CONFIG_CMD_MENU=y
CONFIG_CMD_MENU_MANAGEMENT=y
CONFIG_CMD_PASSWD=y
CONFIG_CMD_READLINE=y
CONFIG_CMD_TIMEOUT=y
CONFIG_CMD_CRC=y
CONFIG_CMD_CRC_CMP=y
CONFIG_CMD_FLASH=y
CONFIG_CMD_GPIO=y
CONFIG_CMD_I2C=y
CONFIG_CMD_OF_NODE=y
CONFIG_CMD_OF_PROPERTY=y
CONFIG_CMD_OFTREE=y
CONFIG_CMD_TIME=y
CONFIG_NET=y
CONFIG_NET_NFS=y
CONFIG_NET_NETCONSOLE=y
CONFIG_NET_RESOLV=y
CONFIG_OFDEVICE=y
CONFIG_OF_BAREBOX_DRIVERS=y
CONFIG_DRIVER_NET_RTL8139=y
# CONFIG_SPI is not set
CONFIG_I2C=y
CONFIG_I2C_GPIO=y
CONFIG_MTD=y
CONFIG_DRIVER_CFI=y
# CONFIG_DRIVER_CFI_AMD is not set
# CONFIG_DRIVER_CFI_BANK_WIDTH_1 is not set
# CONFIG_DRIVER_CFI_BANK_WIDTH_2 is not set
CONFIG_CFI_BUFFER_WRITE=y
CONFIG_GPIO_MALTA_FPGA_I2C=y
CONFIG_PCI=y
CONFIG_PCI_DEBUG=y
CONFIG_FS_CRAMFS=y
CONFIG_FS_TFTP=y
CONFIG_FS_FAT=y
CONFIG_FS_FAT_WRITE=y
CONFIG_FS_FAT_LFN=y
```

## arch/mips/configs/ritmix-rzx50_defconfig
```kconfig
CONFIG_BUILTIN_DTB=y
CONFIG_BUILTIN_DTB_NAME="rzx50"
CONFIG_MACH_MIPS_XBURST=y
CONFIG_JZ47XX_DEBUG_LL_UART1=y
CONFIG_PBL_IMAGE=y
CONFIG_BAUDRATE=57600
CONFIG_GLOB=y
CONFIG_HUSH_FANCY_PROMPT=y
CONFIG_CMDLINE_EDITING=y
CONFIG_AUTO_COMPLETE=y
CONFIG_BOOTM_SHOW_TYPE=y
CONFIG_BOOTM_VERBOSE=y
CONFIG_BOOTM_INITRD=y
CONFIG_BOOTM_OFTREE=y
CONFIG_BOOTM_OFTREE_UIMAGE=y
# CONFIG_DEFAULT_ENVIRONMENT is not set
CONFIG_DEBUG_LL=y
CONFIG_LONGHELP=y
CONFIG_CMD_IOMEM=y
CONFIG_CMD_IMD=y
CONFIG_CMD_MEMINFO=y
CONFIG_CMD_GO=y
CONFIG_CMD_LOADB=y
CONFIG_CMD_LOADS=y
CONFIG_CMD_LOADY=y
CONFIG_CMD_RESET=y
CONFIG_CMD_SAVES=y
CONFIG_CMD_UIMAGE=y
CONFIG_CMD_MD5SUM=y
CONFIG_CMD_GETOPT=y
CONFIG_CMD_SLEEP=y
CONFIG_CMD_EDIT=y
CONFIG_CMD_GPIO=y
CONFIG_CMD_LED=y
CONFIG_CMD_POWEROFF=y
CONFIG_CMD_LED_TRIGGER=y
CONFIG_CMD_OF_NODE=y
CONFIG_CMD_OF_PROPERTY=y
CONFIG_CMD_OFTREE=y
CONFIG_OFDEVICE=y
# CONFIG_SPI is not set
CONFIG_LED=y
CONFIG_LED_GPIO=y
CONFIG_LED_GPIO_OF=y
CONFIG_LED_TRIGGERS=y
CONFIG_GPIO_JZ4740=y
CONFIG_RTC_CLASS=y
CONFIG_RTC_DRV_JZ4740=y
CONFIG_DIGEST_SHA1_GENERIC=y
CONFIG_DIGEST_SHA224_GENERIC=y
CONFIG_DIGEST_SHA256_GENERIC=y
```

## arch/mips/configs/rzx50_defconfig
```kconfig
CONFIG_BUILTIN_DTB=y
CONFIG_BUILTIN_DTB_NAME="rzx50"
CONFIG_MACH_MIPS_XBURST=y
CONFIG_JZ4750D_DEBUG_LL_UART1=y
CONFIG_PBL_IMAGE=y
CONFIG_BAUDRATE=57600
CONFIG_GLOB=y
CONFIG_HUSH_FANCY_PROMPT=y
CONFIG_HUSH_GETOPT=y
CONFIG_CMDLINE_EDITING=y
CONFIG_AUTO_COMPLETE=y
# CONFIG_DEFAULT_ENVIRONMENT is not set
CONFIG_DEBUG_LL=y
CONFIG_CMD_EDIT=y
CONFIG_CMD_SLEEP=y
CONFIG_CMD_LOADB=y
CONFIG_CMD_LOADY=y
CONFIG_CMD_LOADS=y
CONFIG_CMD_SAVES=y
CONFIG_CMD_MEMINFO=y
CONFIG_CMD_IOMEM=y
CONFIG_CMD_MD5SUM=y
CONFIG_CMD_BOOTM_SHOW_TYPE=y
CONFIG_CMD_BOOTM_VERBOSE=y
CONFIG_CMD_BOOTM_INITRD=y
CONFIG_CMD_BOOTM_OFTREE=y
CONFIG_CMD_BOOTM_OFTREE_UIMAGE=y
CONFIG_CMD_UIMAGE=y
CONFIG_CMD_RESET=y
CONFIG_CMD_POWEROFF=y
CONFIG_CMD_GO=y
CONFIG_CMD_OFTREE=y
CONFIG_CMD_OF_PROPERTY=y
CONFIG_CMD_OF_NODE=y
CONFIG_OFDEVICE=y
# CONFIG_SPI is not set
CONFIG_SHA1=y
CONFIG_SHA224=y
CONFIG_SHA256=y
```

## arch/mips/configs/tplink-mr3020_defconfig
```kconfig
CONFIG_BUILTIN_DTB=y
CONFIG_BUILTIN_DTB_NAME="tplink-mr3020"
CONFIG_MACH_MIPS_ATH79=y
CONFIG_LONGHELP=y
CONFIG_CMDLINE_EDITING=y
CONFIG_AUTO_COMPLETE=y
CONFIG_CMD_EDIT=y
CONFIG_CMD_SLEEP=y
CONFIG_CMD_LET=y
CONFIG_CMD_GLOBAL=y
CONFIG_CMD_LOADB=y
CONFIG_CMD_LOADY=y
CONFIG_CMD_MEMINFO=y
CONFIG_CMD_IOMEM=y
CONFIG_CMD_MM=y
CONFIG_CMD_SHA1SUM=y
CONFIG_CMD_FLASH=y
# CONFIG_CMD_BOOTM is not set
CONFIG_CMD_RESET=y
CONFIG_CMD_GO=y
CONFIG_CMD_OFTREE=y
CONFIG_CMD_OF_PROPERTY=y
CONFIG_CMD_OF_NODE=y
CONFIG_CMD_SPI=y
CONFIG_CMD_CLK=y
CONFIG_OFDEVICE=y
CONFIG_DRIVER_SERIAL_AR933X=y
CONFIG_DRIVER_SPI_ATH79=y
CONFIG_MTD=y
# CONFIG_MTD_OOB_DEVICE is not set
CONFIG_MTD_M25P80=y
CONFIG_MD5=y
CONFIG_SHA224=y
CONFIG_SHA256=y
```

## arch/mips/mach-ar231x/Kconfig
```kconfig
# SPDX-License-Identifier: GPL-2.0-only

if MACH_MIPS_AR231X

choice
	prompt "Board type"

config BOARD_NETGEAR_WG102
	bool "Netgear WG102"
	select HAVE_PBL_IMAGE
	select HAVE_IMAGE_COMPRESSION

endchoice

endif
```

## arch/mips/mach-ath79/Kconfig
```kconfig
if MACH_MIPS_ATH79

config ARCH_TEXT_BASE
	hex
	default 0xa0800000

config SOC_QCA_AR9331
	bool

config SOC_QCA_AR9344
	bool

if DEBUG_LL
choice
	prompt "DEBUG_LL driver"

config DEBUG_AR9331_UART
	bool "AR9331 Debug UART"

config DEBUG_AR9344_UART
	bool "AR9344 Debug UART"

endchoice
endif # DEBUG_LL

config BOARD_8DEVICES_LIMA
	bool "8devices LIMA"
	select SOC_QCA_QCA4531
	select HAVE_PBL_IMAGE
	select HAVE_IMAGE_COMPRESSION
	select HAS_NMON

config BOARD_DPTECHNICS_DPT_MODULE
	bool "DPTechnics DPT-Module"
	select SOC_QCA_AR9331
	select HAVE_PBL_IMAGE
	select HAVE_IMAGE_COMPRESSION
	select HAS_NMON

config BOARD_TPLINK_MR3020
	bool "TP-LINK MR3020"
	select SOC_QCA_AR9331
	select HAVE_PBL_IMAGE
	select HAVE_IMAGE_COMPRESSION
	select HAS_NMON

config BOARD_TPLINK_WDR4300
	bool "TP-LINK WDR4300"
	select SOC_QCA_AR9344
	select HAVE_PBL_IMAGE
	select HAVE_IMAGE_COMPRESSION
	select HAS_NMON

config BOARD_BLACK_SWIFT
	bool "Black Swift"
	select SOC_QCA_AR9331
	select HAVE_PBL_IMAGE
	select HAVE_IMAGE_COMPRESSION
	select HAS_NMON

endif
```

## arch/mips/mach-bcm47xx/Kconfig
```kconfig
# SPDX-License-Identifier: GPL-2.0-only

if MACH_MIPS_BCM47XX

choice
	prompt "Board type"

config BOARD_DLINK_DIR320
	bool "D-Link DIR-320"

endchoice

endif
```

## arch/mips/mach-loongson/Kconfig
```kconfig
if MACH_MIPS_LOONGSON

config ARCH_TEXT_BASE
	hex
	default 0xa0800000

choice
	prompt "Board type"

config BOARD_LOONGSON_TECH_LS1B
	bool "Loongson Tech. LS1B demo board"
	select SYS_HAS_CPU_LOONGSON1B
	select SYS_SUPPORTS_32BIT_KERNEL
	select SYS_SUPPORTS_LITTLE_ENDIAN
	select CSRC_R4K_LIB
	select HAS_DEBUG_LL
	select DRIVER_SERIAL_NS16550
	select HAVE_PBL_IMAGE
	select HAVE_IMAGE_COMPRESSION
	select HAS_NMON

endchoice

endif
```

## arch/mips/mach-malta/Kconfig
```kconfig
if MACH_MIPS_MALTA

config BOARD_QEMU_MALTA
	bool "qemu malta"
	select HAVE_PBL_IMAGE
	select HAVE_IMAGE_COMPRESSION
	select HAS_NMON

endif
```

## arch/mips/mach-xburst/Kconfig
```kconfig
if MACH_MIPS_XBURST

config ARCH_TEXT_BASE
	hex
	default 0xa0800000

config CPU_JZ4755
	bool
	select SYS_HAS_CPU_MIPS32_R1
	select WATCHDOG
	select WATCHDOG_JZ4740

config CPU_JZ4780
	bool
	select SYS_HAS_CPU_MIPS32_R2
	select WATCHDOG
	select WATCHDOG_JZ4740

config BOARD_RZX50
	bool "Ritmix RZX-50"
	select CPU_JZ4755

config BOARD_CI20
	bool "Imagination Creator CI20"
	select CPU_JZ4780
	select HAS_DM9000

if DEBUG_LL
choice
	prompt "DEBUG_LL driver"

config DEBUG_JZ4750D_UART
	bool "JZ4750D Debug UART"

config DEBUG_JZ4780_UART
	bool "JZ4780 Debug UART"

endchoice

choice
	prompt "DEBUG_LL port"

config JZ47XX_DEBUG_LL_UART0
	depends on CPU_JZ4755 || CPU_JZ4780
	bool "UART0"

config JZ47XX_DEBUG_LL_UART1
	depends on CPU_JZ4755 || CPU_JZ4780
	bool "UART1"

config JZ47XX_DEBUG_LL_UART2
	depends on CPU_JZ4755 || CPU_JZ4780
	bool "UART2"

config JZ47XX_DEBUG_LL_UART3
	depends on CPU_JZ4780
	bool "UART3"

config JZ47XX_DEBUG_LL_UART4
	depends on CPU_JZ4780
	bool "UART4"

endchoice
endif # DEBUG_LL

endif # MACH_MIPS_XBURST
```

## arch/nios2/Kconfig
```kconfig
config NIOS2
	bool
	select HAS_KALLSYMS
	select HAS_MODULES
	select HAS_CACHE
	select HAVE_CONFIGURABLE_MEMORY_LAYOUT
	select GENERIC_FIND_NEXT_BIT
	default y

config ARCH_TEXT_BASE
	hex
	default 0x00000000

choice
	prompt "Select your board"

config GENERIC
	bool "Generic"
	select NIOS2

endchoice

menu "Board configuration"

config EARLY_PRINTF
	default n
	bool "Enable early printf functions"

endmenu
```

## arch/nios2/configs/generic_defconfig
```kconfig
CONFIG_EARLY_PRINTF=y
CONFIG_BAUDRATE=9600
CONFIG_LONGHELP=y
CONFIG_HUSH_FANCY_PROMPT=y
CONFIG_CMDLINE_EDITING=y
CONFIG_AUTO_COMPLETE=y
CONFIG_PARTITION=y
CONFIG_DEFAULT_ENVIRONMENT_GENERIC=y
CONFIG_CMD_EDIT=y
CONFIG_CMD_SLEEP=y
CONFIG_CMD_SAVEENV=y
CONFIG_CMD_LOADENV=y
CONFIG_CMD_EXPORT=y
CONFIG_CMD_PRINTENV=y
CONFIG_CMD_READLINE=y
CONFIG_CMD_TFTP=y
CONFIG_CMD_ECHO_E=y
CONFIG_CMD_FLASH=y
CONFIG_BOOTM_SHOW_TYPE=y
CONFIG_BOOTM_VERBOSE=y
CONFIG_CMD_UIMAGE=y
CONFIG_CMD_RESET=y
CONFIG_CMD_GO=y
CONFIG_CMD_TIMEOUT=y
CONFIG_CMD_PARTITION=y
CONFIG_NET=y
CONFIG_CMD_PING=y
CONFIG_DRIVER_NET_TSE=y
CONFIG_MTD=y
CONFIG_DRIVER_CFI=y
CONFIG_FS_TFTP=y
CONFIG_ZLIB=y
```

## arch/openrisc/Kconfig
```kconfig
config OPENRISC
	bool
	select OFTREE
	select HAS_CACHE
	select HAVE_CONFIGURABLE_MEMORY_LAYOUT
	select GENERIC_FIND_NEXT_BIT
	default y

# not used
config ARCH_TEXT_BASE
	hex
	default 0x00000000

config BUILTIN_DTB
	bool "link a DTB into the barebox image"
	depends on OFTREE

config BUILTIN_DTB_NAME
	string "DTB to build into the barebox image"
	depends on BUILTIN_DTB

choice
	prompt "Select your board"

config GENERIC
	bool "Generic"
	select OPENRISC

endchoice
```

## arch/openrisc/configs/generic_defconfig
```kconfig
CONFIG_LONGHELP=y
CONFIG_HUSH_FANCY_PROMPT=y
CONFIG_CMDLINE_EDITING=y
CONFIG_AUTO_COMPLETE=y
CONFIG_PARTITION=y
CONFIG_DEFAULT_ENVIRONMENT_GENERIC_NEW=y
CONFIG_CMD_EDIT=y
CONFIG_CMD_SAVEENV=y
CONFIG_CMD_EXPORT=y
CONFIG_CMD_PRINTENV=y
CONFIG_CMD_TIME=y
CONFIG_CMD_ECHO_E=y
CONFIG_CMD_MEMINFO=y
CONFIG_CMD_FLASH=y
# CONFIG_CMD_BOOTM is not set
CONFIG_CMD_RESET=y
CONFIG_CMD_GO=y
CONFIG_CMD_TIMEOUT=y
CONFIG_CMD_PARTITION=y
CONFIG_DRIVER_SERIAL_NS16550=y
```

## arch/powerpc/Kconfig
```kconfig
# SPDX-License-Identifier: GPL-2.0-only

config PPC
	bool
	select HAVE_CONFIGURABLE_TEXT_BASE
	select HAS_KALLSYMS
	select LD_DEAD_CODE_DATA_ELIMINATION if !MODULES
	select HAS_MODULES
	select GENERIC_FIND_NEXT_BIT
	select OFTREE
	select HAVE_ARCH_BOOTM_OFTREE
	select ARCH_HAS_SJLJ
	select ARCH_HAS_MALLOC_SIZE
	default y

config ARCH_LINUX_NAME
	string
	default "ppc"

config ARCH_MKIMAGE_NAME
	string
	default "powerpc"

choice
	prompt "Processor type"

config ARCH_MPC5XXX
	bool "Freescale MPC5xxx"

config ARCH_MPC85XX
	bool "Freescale MPC85xx"
endchoice

source "arch/powerpc/mach-mpc5xxx/Kconfig"
source "arch/powerpc/mach-mpc85xx/Kconfig"
```

## arch/powerpc/configs/qemu-ppce500_defconfig
```kconfig
CONFIG_ARCH_MPC85XX=y
CONFIG_QEMU_PPCE500=y
CONFIG_NAME="qemu-ppce500_defconfig"
CONFIG_RELOCATABLE=y
CONFIG_CMDLINE_EDITING=y
CONFIG_AUTO_COMPLETE=y
CONFIG_BOOTM_VERBOSE=y
CONFIG_DEBUG_LL=y
CONFIG_CMD_DMESG=y
CONFIG_LONGHELP=y
CONFIG_CMD_IOMEM=y
CONFIG_CMD_MEMINFO=y
CONFIG_CMD_NVMEM=y
CONFIG_CMD_GO=y
CONFIG_CMD_LOADY=y
CONFIG_CMD_RESET=y
CONFIG_CMD_PARTITION=y
CONFIG_CMD_FINDMNT=y
CONFIG_CMD_EXPORT=y
CONFIG_CMD_DEFAULTENV=y
CONFIG_CMD_LOADENV=y
CONFIG_CMD_PRINTENV=y
CONFIG_CMD_MAGICVAR=y
CONFIG_CMD_MAGICVAR_HELP=y
CONFIG_CMD_SAVEENV=y
CONFIG_CMD_FILETYPE=y
CONFIG_CMD_LN=y
CONFIG_CMD_MD5SUM=y
CONFIG_CMD_SHA1SUM=y
CONFIG_CMD_SHA256SUM=y
CONFIG_CMD_LET=y
CONFIG_CMD_MSLEEP=y
CONFIG_CMD_READF=y
CONFIG_CMD_SLEEP=y
CONFIG_CMD_ECHO_E=y
CONFIG_CMD_EDIT=y
CONFIG_CMD_READLINE=y
CONFIG_CMD_TIMEOUT=y
CONFIG_CMD_CRC=y
CONFIG_CMD_CRC_CMP=y
CONFIG_CMD_MEMTEST=y
CONFIG_CMD_DETECT=y
CONFIG_CMD_FLASH=y
CONFIG_CMD_POWEROFF=y
CONFIG_CMD_OF_DIFF=y
CONFIG_CMD_OF_NODE=y
CONFIG_CMD_OF_PROPERTY=y
CONFIG_CMD_OF_FIXUP_STATUS=y
CONFIG_CMD_OFTREE=y
CONFIG_CMD_TIME=y
CONFIG_OFDEVICE=y
CONFIG_OF_BAREBOX_DRIVERS=y
CONFIG_DRIVER_SERIAL_NS16550=y
CONFIG_GPIO_MPC8XXX=y
CONFIG_NVMEM=y
CONFIG_NVMEM_RMEM=y
CONFIG_POWER_RESET_GPIO=y
CONFIG_TEST=y
CONFIG_SELFTEST=y
CONFIG_SELFTEST_BASE64=y
CONFIG_SELFTEST_RANGE=y
CONFIG_SELFTEST_MALLOC=y
CONFIG_SELFTEST_PRINTF=y
CONFIG_SELFTEST_OF_MANIPULATION=y
CONFIG_SELFTEST_PROGRESS_NOTIFIER=y
CONFIG_SELFTEST_STRING=y
CONFIG_SELFTEST_RESOURCE=y
CONFIG_SELFTEST_IDR=y
```

## arch/powerpc/mach-mpc5xxx/Kconfig
```kconfig
# SPDX-License-Identifier: GPL-2.0-only

if ARCH_MPC5XXX

config ARCH_TEXT_BASE
	hex
	default 0x00000000 if RELOCATABLE
	default 0x01000000 if MACH_PHYCORE_MPC5200B_TINY

choice
	prompt "Select your board"

config MACH_PHYCORE_MPC5200B_TINY
	bool "Phycore mpc5200b tiny"
	help
	  Say Y here if you are using the Phytec Phycore MPC5200B Tiny
	  board aka pcm030.
endchoice

config MPC5200
	bool
	depends on MACH_PHYCORE_MPC5200B_TINY
	default y

config ARCH_MPC5200
	bool
	depends on MACH_PHYCORE_MPC5200B_TINY
	default y

config MPC5xxx
	bool
	depends on MACH_PHYCORE_MPC5200B_TINY
	default y

endif
```

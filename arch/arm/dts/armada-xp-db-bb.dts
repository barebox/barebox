/*
 * Barebox specific DT overlay for Marvell Armada XP DB-MV784MP-GP
 *   Sebastian Hesselbarth <sebastian.hesselbarth@gmail.com>
 */

#include "arm/marvell/armada-xp-db.dts"

/ {
	barebox,disable-deep-probe;

	chosen {
		stdout-path = &uart0;
	};
};

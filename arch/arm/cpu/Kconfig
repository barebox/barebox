## arch/arm/mach-rockchip/Kconfig
```kconfig
# SPDX-License-Identifier: GPL-2.0-only

menu "Rockchip Features"
	depends on ARCH_ROCKCHIP

config RK_TIMER
	hex
	default 1

config ARCH_ROCKCHIP_V7
	bool
	select CPU_V7
	select ARM_SMP_TWD
	select ARCH_HAS_L2X0

config ARCH_RK3188
	bool
	select ARCH_ROCKCHIP_V7

config ARCH_RK3288
	bool
	select ARCH_ROCKCHIP_V7
	select CLOCKSOURCE_ROCKCHIP

config ARCH_ROCKCHIP_V8
	bool
	select CPU_V8
	select ARM_ATF

config ARCH_RK3568
	bool
	select ARCH_ROCKCHIP_V8

config ARCH_RK3588
	bool
	select ARCH_ROCKCHIP_V8

comment "select Rockchip boards:"

if 32BIT

config MACH_RADXA_ROCK
	select ARCH_RK3188
	select I2C
	select MFD_ACT8846
	bool "Radxa rock board"

config MACH_PHYTEC_SOM_RK3288
	select ARCH_RK3288
	select I2C
	bool "RK3288 phyCORE SOM"
	help
	  Say Y here if you are using a RK3288 based Phytecs SOM

endif

if 64BIT

config MACH_RK3568_EVB
	select ARCH_RK3568
	bool "RK3568 EVB"
	help
	  Say Y here if you are using a RK3568 EVB

config MACH_RK3568_BPI_R2PRO
	select ARCH_RK3568
	bool "RK3568 BPI R2PRO"
	help
	  Say Y here if you are using a RK3568 Bananpi R2 Pro

config MACH_PINE64_PINETAB2
	select ARCH_RK3568
	bool "Pine64 PineTab 2"
	help
	  Say Y here if you are using a Pine64 PineTab 2

	  This will build Barebox for two revisions of PineTab 2:

	  - v0.1: distributed to several OS developers for early OS bring
	          up. Not many of them are available and was superseded
	          by rev 2.0.

	  - v2.0: distributed to consumers. Use this if you intend to ship
	          Barebox to the general public.

config MACH_PINE64_QUARTZ64
	select ARCH_RK3568
	bool "Pine64 Quartz64"
	help
	  Say Y here if you are using a Pine64 Quartz64

config MACH_PROTONIC_MECSBC
	select ARCH_RK3568
	bool "Protonic MECSBC"
	help
	  Say Y here if you are using a Protonic MECSBC

config MACH_RADXA_ROCK3
	select ARCH_RK3568
	bool "Radxa ROCK3"
	help
	  Say Y here if you are using a Radxa ROCK3

config MACH_RADXA_ROCK5
	select ARCH_RK3588
	bool "Radxa ROCK5"
	help
	  Say Y here if you are using a Radxa ROCK5

config MACH_RADXA_CM3
	select ARCH_RK3568
	bool "Radxa CM3"
	help
	  Say Y here if you are using a Radxa CM3

config MACH_WOLFVISION_PF5
	select ARCH_RK3568
	select BOARD_WOLFVISION
	bool "WolfVision PF5 mainboard"
	help
	  Say Y here if you are using a WolfVision PF5 mainboard

config MACH_XUNLONG_ORANGEPI_5_PLUS
       select ARCH_RK3588
       bool "Xunlong Orange Pi 5 Plus"
       help
         Say Y here if you are using a Xunlong Orange Pi 5 Plus

endif

comment "select board features:"

config ARCH_ROCKCHIP_ATF
	bool "Build rockchip ATF binaries into barebox"
	depends on ARCH_ROCKCHIP_V8
	default y
	help
	  When deselected, barebox proper will run in EL3. This can be
	  useful for debugging early startup, but for all other cases,
	  say y here.

config ARCH_ROCKCHIP_ATF_PASS_FDT
	bool "Pass device tree to TF-A"
	depends on ARCH_ROCKCHIP_ATF
	help
	  Enable this option if you are using an upstream OP-TEE that uses the
	  device tree to initialize dynamic shared memory, which is passed
	  through the upstream TF-A.

	  Disable the option if you are using a downstream TF-A since it
	  doesn't always cope with device trees. Supposedly this happens if the
	  device tree is too large, for example if CONFIG_OF_OVERLAY_LIVE is
	  enabled.

config ARCH_ROCKCHIP_ATF_FDT_SIZE
	hex
	default 0x0
	default 0x60000 if ARCH_ROCKCHIP_ATF_PASS_FDT
	prompt "Reserved size for the FDT blob passed to the TF-A"
	help
	  Set this size to CFG_DTB_MAX_SIZE in the OP-TEE configuration. OP-TEE
	  may modify the passed device tree and increase it's size. This
	  ensures that barebox reserves enough memory for the modifications.

config ARCH_ROCKCHIP_OPTEE
	bool "Build rockchip OP-TEE binary into barebox"
	depends on ARCH_ROCKCHIP_ATF
	select PBL_OPTEE
	help
	  With this option enabled the OP-TEE binary is compiled
	  into barebox and started along with the BL31 trusted firmware.

endmenu
```

## arch/arm/mach-s3c24xx/Kconfig
```kconfig
config CPU_S3C2410
	select ARCH_S3C24xx
	bool

config CPU_S3C2440
	select ARCH_S3C24xx
	bool

if ARCH_S3C24xx

menu "Board specific settings       "

choice
	prompt "A9M2440 baseboard"
	depends on MACH_A9M2440

config MACH_A9M2410DEV
	bool
	prompt "A9M2410dev"
	select HAS_CS8900
	help
	  Digi's evaluation board.

endchoice

endmenu

menu "S3C24X0 Features              "

config S3C24XX_LOW_LEVEL_INIT
	bool

config S3C24XX_PLL_INIT
	bool
	prompt "Reconfigure PLL"
	select S3C24XX_LOW_LEVEL_INIT
	help
	  This adds generic code to reconfigure the internal PLL very early
	  after reset.

config S3C24XX_SDRAM_INIT
	bool
	prompt "Initialize SDRAM"
	select S3C24XX_LOW_LEVEL_INIT
	help
	  This adds generic code to configure the SDRAM controller after reset.
	  The initialisation will be skipped if the code is already running
	  from SDRAM.

config S3C24XX_NAND_BOOT
	bool
	prompt "Booting from NAND"
	select NAND_S3C24X0
	help
	  Add generic support to boot from NAND flash. Image loading will be
	  skipped if the code is running from NOR or already from SDRAM.

endmenu

endif
```

## arch/arm/mach-samsung/Kconfig
```kconfig
# SPDX-License-Identifier: GPL-2.0-only

if ARCH_SAMSUNG

config MACH_EXYNOS
	bool "Samsung Exynos boards support"
	depends on 64BIT
	select CPU_V8
	select ARM_PSCI_CLIENT
	select HW_HAS_PCI
	select OF_OVERLAY

endif
```

## arch/arm/mach-stm/Kconfig
```kconfig
if ARCH_STM

config ARCH_TEXT_BASE
	hex
	default 0x41000000 if MACH_MX23EVK
	default 0x42000000 if MACH_CHUMBY

config BOARDINFO
	default "Freescale i.MX23-EVK" if MACH_MX23EVK
	default "Chumby Falconwing" if MACH_CHUMBY

comment "SigmaTel/Freescale i.MX System-on-Chip"

choice
	prompt "Freescale i.MX Processor"

config ARCH_IMX23
	bool "i.MX23"
	select CPU_ARM926T

config ARCH_IMX28
	bool "i.MX28"
	select CPU_ARM926T

endchoice

if ARCH_IMX23

choice
	prompt "i.MX23 Board Type"

config MACH_MX23EVK
	bool "mx23-evk"
	help
	  Say Y here if you are using the Freescale i.MX23-EVK board

config MACH_CHUMBY
	bool "Chumby Falconwing"
	select HAVE_MMU
	help
	  Say Y here if you are using the "chumby one" aka falconwing from
	  Chumby Industries

endchoice

endif

menu "Board specific settings       "

endmenu

endif
```

## arch/arm/mach-stm32mp/Kconfig
```kconfig
# SPDX-License-Identifier: GPL-2.0-only

if ARCH_STM32MP

config ARCH_NR_GPIO
	int
	default 416

config ARCH_STM32MP13
	select ARM_PSCI_CLIENT
	bool

config ARCH_STM32MP157
	select ARM_PSCI_CLIENT
	bool

config MACH_STM32MP13XX_DK
	select ARCH_STM32MP13
	bool "STM32MP135F DK board"

config MACH_STM32MP15XX_DKX
	select ARCH_STM32MP157
	bool "STM32MP157 DK1 and DK2 boards"
	help
	  builds a single barebox-stm32mp15xx-dkx.stm32 that can be deployed
	  as SSBL on both the stm32mp157a-dk1 and stm32mp157c-dk2

config MACH_LXA_MC1
	select ARCH_STM32MP157
	bool "Linux Automation MC-1 board"

config MACH_SEEED_ODYSSEY
	select ARCH_STM32MP157
	bool "Seeed Studio Odyssey"

config MACH_STM32MP15X_EV1
	select ARCH_STM32MP157
	bool "STM32MP15X-EV1 board"
	help
	  builds a single barebox-stm32mp15x-ev1.stm32 that can be deployed
	  as SSBL on any STM32MP15X-EVAL platform, like the
	  STM32MP157C-EV1

config MACH_PROTONIC_STM32MP1
	select ARCH_STM32MP157
	bool "Protonic PRTT1L family of boards"
	help
	  Builds all barebox-prtt1*.stm32 that can be deployed as SSBL
	  on the respective PRTT1L family board

config MACH_PHYTEC_PHYCORE_STM32MP1
	select ARCH_STM32MP157
	bool "phyCORE-STM32MP1"
	help
	  builds an additional barebox-phytec-phycore.stm32
	  that can be deployed as SSBL on the phyCORE-STM32MP1

endif
```

## arch/arm/mach-stm32mp1/Kconfig
```kconfig
if ARCH_STM32MP1

config ARCH_STM32MP1157
	bool

config MACH_STM32MP157C_DK2
	select ARCH_STM32MP1157
	bool "STM32MP157C-DK2 board"

endif
```

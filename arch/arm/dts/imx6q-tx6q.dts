/dts-v1/;

#include <arm/nxp/imx/imx6q.dtsi>
#include <arm/nxp/imx/imx6qdl-tx6.dtsi>
#include "imx6q.dtsi"
#include "imx6qdl-tx6x.dtsi"

/ {
	model = "Ka-Ro electronics TX6Q Module";
	compatible = "karo,imx6q-tx6q", "fsl,imx6q";
	barebox,disable-deep-probe;
};


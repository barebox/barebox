// SPDX-License-Identifier: (GPL-2.0 OR MIT)
/*
 * Copyright (C) 2026 Pengutronix, Fabian Pflug <kernel@pengutronix.de>
 */

/dts-v1/;

#include "imx8mp-tqma8mpqs-mb-smarc-2-upstream.dts"
#include "imx8mp.dtsi"

&{pmic/regulators} {
	barebox,allow-dummy-supply;
};

/delete-node/ &{/memory@40000000};

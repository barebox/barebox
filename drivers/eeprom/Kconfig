## drivers/eeprom/Kconfig
```kconfig
menu "EEPROM support"

config EEPROM_AT25
	tristate "SPI EEPROMs from most vendors"
	depends on SPI
	help
	  Enable this driver to get read/write support to most SPI EEPROMs,
	  after you configure the board init code to know about each eeprom
	  on your target board.

config EEPROM_AT24
	bool "at24 based eeprom"
	depends on I2C
	help
	  Enable this driver to get read/write support to most I2C EEPROMs,
	  after you configure the driver to know about each EEPROM on
	  your target board. Use these generic chip names, instead of
	  vendor-specific ones like at24c64 or 24lc02:

	    24c00, 24c01, 24c02, spd (readonly 24c02), 24c04, 24c08,
	    24c16, 24c32, 24c64, 24c128, 24c256, 24c512, 24c1024

	  Unless you like data loss puzzles, always be sure that any chip
	  you configure as a 24c32 (32 kbit) or larger is NOT really a
	  24c16 (16 kbit) or smaller, and vice versa. Marking the chip
	  as read-only won't help recover from this. Also, if your chip
	  has any software write-protect mechanism you may want to review the
	  code to make sure this driver won't turn it on by accident.

endmenu
```

## drivers/efi/Kconfig
```kconfig
# SPDX-License-Identifier: GPL-2.0
config EFI_BOOTUP
	bool
	select BLOCK
	select PARTITION_DISK
	select HW_HAS_PCI
```

## drivers/firmware/Kconfig
```kconfig
# SPDX-License-Identifier: GPL-2.0-only
menu "Firmware Drivers"

config FIRMWARE_ALTERA_SERIAL
	bool "Altera SPI programming"
	depends on OFDEVICE
	depends on GENERIC_GPIO
	depends on SPI
	select FIRMWARE
	help
	  Programming an Altera FPGA via a few GPIOs for the control lines and
	  MOSI, MISO and clock from an SPI interface for the data lines

config FIRMWARE_ALTERA_SOCFPGA
	bool "Altera SoCFPGA fpga loader"
	depends on ARCH_SOCFPGA
	select FIRMWARE

config FIRMWARE_ZYNQMP_FPGA
	bool "Xilinx ZynqMP FPGA loader"
	depends on ARCH_ZYNQMP
	select FIRMWARE
	help
	  Load a bitstream to the PL of Zynq Ultrascale+

config QEMU_FW_CFG
	bool "QEMU FW CFG interface"
	help
	  This driver exposes the QEMU FW CFG conduit as a single
	  character device.

	  The selector key can be set via ioctl or device parameter
	  and read/writes are translated to the MMIO/IO port appropriate
	  for the platform.

config TI_SCI_PROTOCOL
	bool "TI System Control Interface (TISCI) Message Protocol"
	depends on TI_MESSAGE_MANAGER
	help
	  TI System Control Interface (TISCI) Message Protocol is used to manage
	  compute systems such as ARM, DSP etc with the system controller in
	  complex System on Chip(SoC) such as those found on certain keystone
	  generation SoC from TI.

	  System controller provides various facilities including power
	  management function support.

	  This protocol library is used by client drivers to use the features
	  provided by the system controller.

source "drivers/firmware/arm_scmi/Kconfig"

endmenu
```

## drivers/fpga/Kconfig
```kconfig
# SPDX-License-Identifier: GPL-2.0-only
#
# FPGA framework configuration
#

menu "FPGA Configuration Support"

config FPGA
	tristate "FPGA Configuration Framework"
	help
	  Say Y here if you want support for configuring FPGAs from barebox.

if FPGA

config FPGA_BRIDGE
	tristate "FPGA Bridge Framework"
	help
	  Say Y here if you want to support bridges connected between host
	  processors and FPGAs or between FPGAs.

config SOCFPGA_FPGA_BRIDGE
	tristate "Altera SoCFPGA FPGA Bridges"
	depends on ARCH_SOCFPGA && FPGA_BRIDGE
	select RESET_CONTROLLER
	help
	  Say Y to enable drivers for FPGA bridges for Altera SOCFPGA
	  devices.

endif # FPGA

endmenu
```

## drivers/gpio/Kconfig
```kconfig
# SPDX-License-Identifier: GPL-2.0-only
config GPIOLIB
	bool
	select GENERIC_GPIO

if GPIOLIB

menu "GPIO"

config GPIO_GENERIC
	bool

config GPIO_DIGIC
	bool "GPIO support for Canon DIGIC"
	depends on ARCH_DIGIC || COMPILE_TEST

config GPIO_74164
	bool "Generic SPI attached shift register"
	depends on SPI
	help
	  Driver for 74x164 compatible serial-in/parallel-out 8-outputs
	  shift registers. This driver can be used to provide access
	  to more gpio outputs.

config GPIO_74XX_MMIO
	tristate "GPIO driver for 74xx-ICs with MMIO access"
	depends on OFDEVICE
	select GPIO_GENERIC
	help
	  Say yes here to support GPIO functionality for 74xx-compatible ICs
	  with MMIO access. Compatible models include:
	    1 bit:	741G125 (Input), 741G74 (Output)
	    2 bits:	742G125 (Input), 7474 (Output)
	    4 bits:	74125 (Input), 74175 (Output)
	    6 bits:	74365 (Input), 74174 (Output)
	    8 bits:	74244 (Input), 74273 (Output)
	    16 bits:	741624 (Input), 7416374 (Output)

config GPIO_CLPS711X
	bool "GPIO support for CLPS711X"
	depends on ARCH_CLPS711X || COMPILE_TEST
	select GPIO_GENERIC
	help
	  Say yes here to enable the GPIO driver for the CLPS711X CPUs

config GPIO_DAVINCI
	bool "TI Davinci/Keystone GPIO support"
	default y if ARCH_DAVINCI
	depends on (ARM && ARCH_DAVINCI) || COMPILE_TEST
	help
	  Say yes here to enable GPIO support for TI Davinci/Keystone SoCs.

config GPIO_GENERIC_PLATFORM
	bool "Generic memory-mapped GPIO controller support"
	select GPIO_GENERIC
	help
	  Say yes here to support basic platform memory-mapped
	  GPIO controllers

config GPIO_IMX
	bool "i.MX GPIO controller" if COMPILE_TEST
	default y if ARCH_IMX

config GPIO_VF610
	bool "VF610 GPIO controller" if COMPILE_TEST
	depends on ARCH_IMX || ARCH_VF610 || COMPILE_TEST
	default y if ARCH_VF610 || ARCH_IMX93

config GPIO_MXS
	bool "MXS GPIO controller" if COMPILE_TEST
	default y if ARCH_MXS

config GPIO_JZ4740
	bool "GPIO support for Ingenic SoCs"
	depends on MACH_MIPS_XBURST || COMPILE_TEST
	help
	  Say yes here to enable the GPIO driver for the Ingenic SoCs.

config GPIO_MALTA_FPGA_I2C
	bool "Malta CBUS FPGA I2C GPIO"
	depends on MACH_MIPS_MALTA || COMPILE_TEST
	help
	  Support access to the CBUS FPGA I2C lines through the gpio library.

	  This driver provides common support for accessing the device,
	  additional drivers must be enabled in order to use the
	  functionality of the device.

config GPIO_MPC8XXX
	bool "MPC512x/MPC8xxx/QorIQ GPIO support"
	depends on ARCH_LAYERSCAPE || COMPILE_TEST
	select GPIO_GENERIC
	help
	  Say Y here if you're going to use hardware that connects to the
	  MPC512x/831x/834x/837x/8572/8610/QorIQ GPIOs.

config GPIO_OMAP
	bool "OMAP GPIO controller" if COMPILE_TEST
	default y if ARCH_OMAP

config GPIO_ORION
	bool "GPIO support for Marvell Orion/MVEBU SoCs"
	depends on ARCH_MVEBU || COMPILE_TEST
	help
	  Say yes here to add the driver for the GPIO controller
	  found on Marvell Orion and MVEBU SoCs (Armada 370/XP,
	  Dove, Kirkwood, MV78x00, Orion5x).

config GPIO_PCA953X
	bool "PCA95[357]x, PCA9698, TCA64xx, and MAX7310 I/O ports"
	depends on I2C
	help
	  Say yes here to provide access to several register-oriented
	  SMBus I/O expanders, made mostly by NXP or TI.  Compatible
	  models include:

	  4 bits:  pca9536, pca9537

	  8 bits:  max7310, max7315, pca6107, pca9534, pca9538, pca9554,
	           pca9556, pca9557, pca9574, tca6408, xra1202

	  16 bits: max7312, max7313, pca9535, pca9539, pca9555, pca9575,
	           tca6416

	  24 bits: tca6424

	  40 bits: pca9505, pca9698

config GPIO_PCF857X
	tristate "PCF857x, PCA{85,96}7x, and MAX732[89] I2C GPIO expanders"
	depends on I2C
	depends on OFDEVICE
	help
	  Say yes here to provide access to most "quasi-bidirectional" I2C
	  GPIO expanders used for additional digital outputs or inputs.
	  Most of these parts are from NXP, though TI is a second source for
	  some of them.  Compatible models include:

	  8 bits:   pcf8574, pcf8574a, pca8574, pca8574a,
	            pca9670, pca9672, pca9674, pca9674a,
	  	    max7328, max7329

	  16 bits:  pcf8575, pcf8575c, pca8575,
	            pca9671, pca9673, pca9675

config GPIO_PL061
	bool "PrimeCell PL061 GPIO support"
	depends on ARM_AMBA
	help
	  Say yes here to support the PrimeCell PL061 GPIO device

config GPIO_RASPBERRYPI_EXP
	bool "Raspberry Pi 3 GPIO Expander"
	depends on ARCH_BCM283X
	help
	  Turn on GPIO support for the expander on Raspberry Pi 3 boards, using
	  the firmware mailbox to communicate with VideoCore on BCM283x chips.

config GPIO_ROCKCHIP
	bool "Rockchip GPIO support"
	depends on ARCH_ROCKCHIP
	help
	  Say yes here to include the driver for the GPIO controller found on
	  Rockchip SoCs.

config GPIO_STMPE
	depends on MFD_STMPE
	bool "STMPE GPIO Expander"

config GPIO_TEGRA
	bool "GPIO support for the Tegra SoCs"
	depends on ARCH_TEGRA || COMPILE_TEST
	help
	  Say yes here to include the driver for the GPIO controller found on the
	  Tegra line of SoCs.

config GPIO_DESIGNWARE
	tristate "Synopsys DesignWare GPIO driver"
	help
	  Say Y or M here to build support for the Synopsys DesignWare APB
	  GPIO block.

config GPIO_SX150X
	bool "Semtec SX150x I/O ports"
	depends on I2C
	help
	  Say Y here to build support for the Semtec Sx150x I2C GPIO
	  expander chip.

config GPIO_SIFIVE
	bool "SiFive GPIO support"
	depends on OF_GPIO
	select GPIO_GENERIC
	help
	  Say yes here to support the GPIO device on SiFive SoCs.

config GPIO_STARFIVE
	bool "StarFive GPIO support"
	depends on SOC_STARFIVE || CROSS_COMPILE
	depends on OF_GPIO
	select GPIO_GENERIC
	help
	  Say yes here to support the GPIO device on StarFive SoCs.

config GPIO_LIBFTDI1
	bool "libftdi1 driver"
	depends on SANDBOX

config GPIO_ZYNQ
	tristate "Xilinx Zynq GPIO support"
	depends on ARCH_ZYNQ || ARCH_ZYNQMP || CROSS_COMPILE
	depends on OFDEVICE
	help
	  Say yes here to support Xilinx Zynq GPIO controller.

config GPIO_LATCH
	tristate "GPIO latch driver"
	help
	  Say yes here to enable a driver for GPIO multiplexers based on latches
	  connected to other GPIOs.

endmenu

endif
```

## drivers/hw_random/Kconfig
```kconfig
# SPDX-License-Identifier: GPL-2.0-only
menuconfig HWRNG
	bool "HWRNG Support"
	help
	  Support for HWRNG(Hardware Random Number Generator) devices.

	  If unsure, say no.

if HWRNG

config HWRNG_MXC_RNGC
	tristate "Freescale i.MX RNGC Random Number Generator"
	depends on ARCH_IMX25 || ARCH_IMX35 || ARCH_IMX53 || COMPILE_TEST
	help
	  This driver provides barebox support for the Random Number
	  Generator hardware found on some Freescale i.MX processors.

config HWRNG_STM32
	tristate "STM32 Random Number Generator"
	depends on ARCH_STM32 || COMPILE_TEST
	help
	  This driver provides barebox support for the Random Number
	  Generator hardware found on the STM32 family of MPUs and MCUs.

config HWRNG_DEV_RANDOM
	tristate "Linux /dev/urandom RNG"
	depends on SANDBOX
	default y
	help
	  This driver allows use of the host provided /dev/urandom
	  as barebox HWRNGs.

config HW_RANDOM_VIRTIO
	tristate "VirtIO Random Number Generator support"
	depends on VIRTIO
	help
	  This driver provides guest-side support for the virtual Random Number
	  Generator hardware.

config HW_RANDOM_STARFIVE
	tristate "StarFive Random Number Generator"
	depends on SOC_STARFIVE || COMPILE_TEST
	help
	  This driver provides barebox support for the Random Number
	  Generator hardware found on the StarFive family of SoCs.

config HW_RANDOM_EFI
	tristate "EFI Random Number Generator"
	depends on EFI
	help
	  This driver provides barebox support for the Random Number
	  Generator Protocol offered by EFI firmware

config HW_RANDOM_OPTEE
	tristate "OP-TEE based Random Number Generator support"
	depends on OPTEE
	help
	  This driver provides support for OP-TEE based Random Number
	  Generator on ARM SoCs where hardware entropy sources are not
	  accessible to normal world (barebox and e.g. Linux after it).

config HW_RANDOM_ATMEL
	tristate "Atmel Random Number Generator support"
	depends on ARCH_AT91 || COMPILE_TEST
	help
	  This driver provides barebox support for the Random Number
	  Generator hardware found on Atmel AT91 devices.

config HW_RANDOM_BCM2835
	tristate "Broadcom BCM2835/BCM63xx Random Number Generator support"
	depends on ARCH_BCM283X || COMPILE_TEST
	help
	  This driver provides barebox support for the Random Number
	  Generator hardware found on the Broadcom BCM2835 SoCs.

config HW_RANDOM_IPROC_RNG200
	tristate "Broadcom iProc/STB RNG200 support"
	depends on ARCH_BCM283X || COMPILE_TEST
	help
	  This driver provides barebox support for the RNG200
	  hardware found on the BCM2711.

endif
```

## drivers/i2c/Kconfig
```kconfig
menuconfig I2C
	bool "I2C drivers"

if I2C

source drivers/i2c/algos/Kconfig
source drivers/i2c/busses/Kconfig

config I2C_MUX
	tristate "I2C bus multiplexing support"
	help
	  Say Y here if you want the I2C core to support the ability to
	  handle multiplexed I2C bus topologies, by presenting each
	  multiplexed segment as a I2C adapter.

source drivers/i2c/muxes/Kconfig

endif
```

## drivers/i2c/algos/Kconfig
```kconfig
# SPDX-License-Identifier: GPL-2.0-only
#
# I2C algorithm drivers configuration
#

config I2C_ALGOBIT
	bool
```

## drivers/i2c/busses/Kconfig
```kconfig
# SPDX-License-Identifier: GPL-2.0-only
#
# Sensor device configuration
#

menu "I2C Hardware Bus support"

config I2C_GPIO
	tristate "GPIO-based bitbanging I2C"
	depends on GENERIC_GPIO
	select I2C_ALGOBIT
	help
	  This is a very simple bitbanging I2C driver utilizing the
	  arch-neutral GPIO API to control the SCL and SDA lines.

config I2C_AT91
	bool "AT91 I2C Master driver"
	depends on ARCH_AT91

config I2C_BCM283X
	bool "BCM283X I2C Master driver"
	depends on ARCH_BCM283X || COMPILE_TEST

config I2C_IMX
	bool "MPC85xx/MPC5200/i.MX I2C Master driver"
	depends on ARCH_IMX || ARCH_MPC85XX || ARCH_MPC5200 || ARCH_LAYERSCAPE
	help
	  If you say yes to this option, support will be included for many
	  built-in I2C master controllers found in Freescale SoCs. This is true
	  for many i.MX ARM based SoCs, for MPC85xx and MPC5200 PowerPC based
	  SoCs.

config I2C_IMX_LPI2C
	tristate "IMX Low Power I2C interface"
	depends on ARCH_IMX || COMPILE_TEST
	help
	  Say Y here if you want to use the Low Power IIC bus controller
	  on the Freescale i.MX processors.

config I2C_DESIGNWARE
	bool "Synopsys DesignWare I2C Master driver"
	help
	  If you say yes to this option, support will be included for the
	  Synopsys DesignWare I2C adapter. Only master mode is supported.

config I2C_MV64XXX
	bool "Marvell mv64xxx I2C Controller"
	depends on HAVE_CLK && OFDEVICE
	help
	  If you say yes to this option, support will be included for the
	  built-in I2C interface on the Marvell 64xxx line of host bridges.
	  This driver is also used for Allwinner SoCs I2C controllers.

config I2C_OMAP
	bool "OMAP I2C Master driver"
	depends on ARCH_OMAP

config I2C_TEGRA
	bool "Tegra I2C master driver"
	depends on ARCH_TEGRA

config I2C_VERSATILE
	tristate "ARM Versatile/Realview I2C bus support"
	depends on ARCH_VERSATILE
	select I2C_ALGOBIT
	help
	  Say yes if you want to support the I2C serial bus on ARMs Versatile
	  range of platforms.

config I2C_STM32
	bool "STM32 I2C master driver"
	select RESET_CONTROLLER
	depends on HAVE_CLK
	depends on ARCH_STM32 || COMPILE_TEST

config I2C_RK3X
	tristate "Rockchip RK3xxx I2C adapter"
	depends on HAVE_CLK
	depends on ARCH_ROCKCHIP || COMPILE_TEST
	help
	  Say Y here to include support for the I2C adapter in Rockchip RK3xxx
	  SoCs.

config I2C_CADENCE
	bool "Cadence I2C adapter"
	depends on HAVE_CLK
	depends on ARCH_ZYNQMP || COMPILE_TEST
	help
	  Say Y here to include support for the Cadence I2C host controller found
	  in Zynq UltraScale+ MPSoCs.

endmenu
```

## drivers/net/phy/Kconfig
```kconfig
#
# PHY Layer Configuration
#

menu "phylib"

if PHYLIB

comment "MII PHY device drivers"

config AR8327N_PHY
	bool "Driver for QCA AR8327N PHYs"
	---help---
	  Currently supports the AR8327N PHY.

config AT803X_PHY
	bool "Driver for Atheros AT803X PHYs"
	---help---
	  Currently supports the AT8030, AT8031 and AT8035 PHYs.

config DAVICOM_PHY
	bool "Driver for Davicom PHYs"
	---help---
	  Currently supports dm9161e and dm9131

config DP83867_PHY
	tristate "Texas Instruments DP83867 Gigabit PHY"
	---help---
	  Currently supports the DP83867 PHY.

config LXT_PHY
	bool "Driver for the Intel LXT PHYs"
	---help---
	  Currently supports the lxt971 PHY.

config MARVELL_PHY
	tristate "Drivers for Marvell PHYs"
	---help---
	  Add support for various Marvell PHYs (e.g. 88E1121R).

config MICREL_PHY
	bool "Driver for Micrel PHYs"
	---help---
	  Supports the KSZ9021, VSC8201, KS8001 PHYs.

config NATIONAL_PHY
	bool "Driver for National Semiconductor PHYs"
	---help---
	  Currently supports the DP83865 PHY.

config SMSC_PHY
	bool "Drivers for SMSC PHYs"
	---help---
	  Currently supports the LAN83C185, LAN8187 and LAN8700 PHYs

config NET_DSA_MV88E6XXX
	tristate "Marvell 88E6xxx Ethernet switch fabric support"
	help
	  This driver adds support for most of the Marvell 88E6xxx models of
	  Ethernet switch chips, except 88E6060.

comment "MII bus device drivers"

config MDIO_MVEBU
	bool "Driver for MVEBU SoC MDIO bus"
	depends on ARCH_MVEBU
	---help---
	  Driver for the MDIO bus found on Marvell EBU SoCs.

config MDIO_BITBANG
        bool "Support for bitbanged MDIO buses"
	---help---
          This module implements the MDIO bus protocol in software,
          for use by low level drivers that export the ability to
          drive the relevant pins.

          If in doubt, say N.

config MDIO_GPIO
	bool "Support for GPIO lib-based bitbanged MDIO buses"
	depends on MDIO_BITBANG && GPIOLIB
	---help---
	  Supports GPIO lib-based MDIO busses.

config MDIO_BUS_MUX
	bool
	help
	  This module provides a driver framework for MDIO bus
	  multiplexers which connect one of several child MDIO busses
	  to a parent bus.  Switching between child busses is done by
	  device specific drivers.

config MDIO_BUS_MUX_GPIO
	bool "GPIO controlled MDIO bus multiplexers"
	depends on OF_GPIO
	select MDIO_BUS_MUX
	help
	  This module provides a driver for MDIO bus multiplexers that
	  are controlled via GPIO lines.  The multiplexer connects one of
	  several child MDIO busses to a parent bus.  Child bus
	  selection is under the control of GPIO lines.

endif

endmenu
```

## drivers/net/realtek-dsa/Kconfig
```kconfig
# SPDX-License-Identifier: GPL-2.0-only
menuconfig DRIVER_NET_DSA_REALTEK
	tristate "Realtek Ethernet switch family support"
	depends on DSA
	select PHYLIB
	select REALTEK_PHY
	select REGMAP
	help
	  Select to enable support for Realtek Ethernet switch chips.

	  Note that at least one interface driver must be enabled for the
	  subdrivers to be loaded. Moreover, an interface driver cannot achieve
	  anything without at least one subdriver enabled.

config NET_DSA_TAG_RTL4_A
	bool
	help
	  Selected to enable support for tagging frames for the
	  Realtek switches with 4 byte protocol A tags, sich as found in
	  the Realtek RTL8366RB.

config NET_DSA_TAG_RTL8_4
	bool
	help
	  Selected to enable support for tagging frames for Realtek
	  switches with 8 byte protocol 4 tags, such as the Realtek RTL8365MB-VC.

if DRIVER_NET_DSA_REALTEK


config NET_DSA_REALTEK_MDIO
	tristate "Realtek MDIO interface driver"
	depends on OFDEVICE
	help
	  Select to enable support for registering switches configured
	  through MDIO.

config NET_DSA_REALTEK_SMI
	tristate "Realtek SMI interface driver"
	depends on OFDEVICE
	help
	  Select to enable support for registering switches connected
	  through SMI.

config NET_DSA_REALTEK_RTL8365MB
	tristate "Realtek RTL8365MB switch subdriver"
	imply NET_DSA_REALTEK_SMI
	imply NET_DSA_REALTEK_MDIO
	select NET_DSA_TAG_RTL8_4
	help
	  Select to enable support for Realtek RTL8365MB-VC and RTL8367S.

config NET_DSA_REALTEK_RTL8366RB
	tristate "Realtek RTL8366RB switch subdriver"
	imply NET_DSA_REALTEK_SMI
	imply NET_DSA_REALTEK_MDIO
	select NET_DSA_TAG_RTL4_A
	help
	  Select to enable support for Realtek RTL8366RB.

endif
```

## drivers/nor/Kconfig
```kconfig
menu "flash drivers                 "

menuconfig DRIVER_CFI
	bool "CFI            "
	help
	  If you have NOR Flash devices connected to your system and wish
	  to use them say yes here.

if DRIVER_CFI

config DRIVER_CFI_INTEL
	default y
	depends on DRIVER_CFI
	bool "Support Intel flash chips"

config DRIVER_CFI_AMD
	default y
	depends on DRIVER_CFI
	bool "support AMD flash chips"

config DRIVER_CFI_BANK_WIDTH_1
	bool "Support  8-bit buswidth"
	depends on DRIVER_CFI
	default y
	help
	  If you wish to support CFI devices on a physical bus which is
	  8 bits wide, say 'Y'.

config DRIVER_CFI_BANK_WIDTH_2
	bool "Support 16-bit buswidth"
	depends on DRIVER_CFI
	default y
	help
	  If you wish to support CFI devices on a physical bus which is
	  16 bits wide, say 'Y'.

config DRIVER_CFI_BANK_WIDTH_4
	bool "Support 32-bit buswidth"
	depends on DRIVER_CFI
	default y
	help
	  If you wish to support CFI devices on a physical bus which is
	  32 bits wide, say 'Y'.

config DRIVER_CFI_BANK_WIDTH_8
	bool "Support 64-bit buswidth"
	depends on DRIVER_CFI
	default n
	help
	  If you wish to support CFI devices on a physical bus which is
	  64 bits wide, say 'Y'.

config CFI_BUFFER_WRITE
	bool "use cfi driver with buffer write"
	depends on DRIVER_CFI || DRIVER_CFI

endif

config MTD_M25P80
	tristate "SPI Flash chips (AT26DF, M25P, W25X, ...)"
	depends on SPI
	help
	  This enables access to most modern SPI flash chips, used for
	  program and data storage.   Series supported include Atmel AT26DF,
	  Spansion S25SL, SST 25VF, ST M25P, and Winbond W25X.  Other chips
	  are supported as well.  See the driver source for the current list,
	  or to add other chips.

	  Note that the original DataFlash chips (AT45 series, not AT26DF),
	  need an entirely different driver.

	  Set up your spi devices with the right board-specific platform data,
	  if you want to specify device partitioning or to use a device which
	  doesn't support the JEDEC ID instruction.

config MTD_SST25L
	tristate "Support SST25L (non JEDEC) SPI Flash chips"
	depends on MTD_M25P80
	help
	  This enables access to the non JEDEC SST25L SPI flash chips, used
	  for program and data storage.

	  Set up your spi devices with the right board-specific platform data,
	  if you want to specify device partitioning.

endmenu
```

## drivers/nvme/Kconfig
```kconfig
# SPDX-License-Identifier: GPL-2.0-only
menu "NVME Support"

source "drivers/nvme/host/Kconfig"

endmenu
```

## drivers/nvme/host/Kconfig
```kconfig
config NVME_CORE
	bool

config BLK_DEV_NVME
	bool "NVM Express block device"
	depends on PCI && BLOCK
	select NVME_CORE
	---help---
	  The NVM Express driver is for solid state drives directly
	  connected to the PCI or PCI Express bus.  If you know you
	  don't have one of these, it is safe to answer N.
```

## drivers/nvmem/Kconfig
```kconfig
# SPDX-License-Identifier: GPL-2.0-only
menuconfig NVMEM
	bool "NVMEM Support"
	help
	  Support for NVMEM(Non Volatile Memory) devices like EEPROM, EFUSES...

	  This framework is designed to provide a generic interface to NVMEM

	  If unsure, say no.

if NVMEM

config NVMEM_RMEM
	bool "Reserved Memory Based Driver Support"
	help
	  This driver maps reserved memory into an nvmem device. It might be
	  useful to expose information left by firmware in memory.

config NVMEM_SNVS_LPGPR
	tristate "Freescale SNVS LPGPR support"
	select MFD_SYSCON
	help
	  If you say yes here you get NVMEM support for the Freescale SNVS
	  Low Power Generic Purpose Register (LPGPR).

config IMX_OCOTP
	tristate "i.MX6 On Chip OTP controller"
	depends on ARCH_IMX6 || ARCH_VF610 || ARCH_IMX8M || ARCH_IMX7
	depends on OFDEVICE
	help
	  This adds support for the i.MX6 On-Chip OTP controller. Currently the
	  only supported functionality is reading the MAC address and assigning
	  it to an ethernet device.

config IMX_OCOTP_WRITE
	bool
	prompt "Enable write support of i.MX6 CPUs OTP fuses"
	depends on IMX_OCOTP
	help
	  This adds write support to IMX6 On-Chip OTP registers. Example of set
	  MAC to 12:34:56:78:9A:BC (2 words with address 0x22 (OCOTP_MAC0) and
	  address 0x23 (OCOTP_MAC1)). To calculate the file offset multiply
	  the value of the address by 4.
	    mw -l -d /dev/imx-ocotp 0x8C 0x00001234
	    mw -l -d /dev/imx-ocotp 0x88 0x56789ABC

config IMX_OCOTP_ELE
	tristate "i.MX9 On Chip OTP controller"
	depends on ARCH_IMX93
	depends on OFDEVICE
	help
	  This adds support for the i.MX9 On-Chip OTP controller.

config RAVE_SP_EEPROM
	tristate "Rave SP EEPROM Support"
	depends on RAVE_SP_CORE
	help
	  Say y here to enable Rave SP EEPROM support.

config EEPROM_93XX46
	bool "Microwire EEPROM 93XX46 support"
	depends on SPI
	help
	  Driver for the microwire EEPROM chipsets 93xx46x. The driver
	  supports both read and write commands and also the command to
	  erase the whole EEPROM.

config NVMEM_ROCKCHIP_OTP
	tristate "Rockchip OTP controller support"
	depends on ARCH_ROCKCHIP || COMPILE_TEST
	help
	  This is a simple driver to dump specified values of Rockchip SoC
	  from otp, such as cpu-leakage, id etc.

config STM32_BSEC
	tristate "STM32 Boot and security and OTP control"
	depends on ARCH_STM32MP
	depends on OFDEVICE
	help
	  This adds support for the STM32 OTP controller.

config STM32_BSEC_WRITE
	bool
	prompt "Enable write support of STM32 CPUs OTP fuses"
	depends on STM32_BSEC
	help
	  This adds write support to STM32 On-Chip OTP registers. Example of set
	  MAC to 12:34:56:78:9A:BC:
	    bsec0.permanent_write_enable=1
	    mw -l -d /dev/stm32-bsec 0x000000e4+4 0x78563412
	    mw -l -d /dev/stm32-bsec 0x000000e8+4 0x0000bc9a

config STM32_BSEC_OPTEE_TA
	def_bool STM32_BSEC && OPTEE
	help
	  Say y here to enable the accesses to STM32MP SoC OTPs by the OP-TEE
	  trusted application STM32MP BSEC.

config KVX_OTP_NV
	tristate "kalray KVX OTP Non volatile regs Support"
	depends on KVX
	help
	  This is a simple driver to dump specified values of KVX OTP non
	  volatile regs.

config STARFIVE_OTP
	tristate "Starfive OTP Supprot"
	depends on SOC_STARFIVE
	depends on OFDEVICE
	help
	  This adds support for the StarFive OTP controller. Only reading
	  is currently supported.

endif
```

## drivers/nvmem/layouts/Kconfig
```kconfig
# SPDX-License-Identifier: GPL-2.0

config NVMEM_LAYOUTS
	bool
	depends on OF

if NVMEM_LAYOUTS

menu "Layout Types"

endmenu

endif
```

## drivers/of/Kconfig
```kconfig
# SPDX-License-Identifier: GPL-2.0-only
config OFTREE
	select DTC
	bool

config OFTREE_MEM_GENERIC
	depends on OFTREE
	depends on PPC || ARM || EFI_PAYLOAD || OPENRISC || SANDBOX || RISCV || KVX
	def_bool y

config DTC
	bool

config OF
	bool

config OFDEVICE
	select OFTREE
	select OF
	select DTC
	bool "Enable probing of devices from the devicetree"

config FEATURE_CONTROLLER_FIXUP
	bool "Fix up DT nodes gated by feature controller"
	depends on FEATURE_CONTROLLER
	default y
	help
	  When specified, barebox feature controller drivers are consulted
	  prior to probing nodes to detect whether the device may not
	  be available (e.g. because support is fused out).
	  This option additionally fixes up the kernel device tree,
	  so it doesn't attempt probing these devices either.
	  If unsure, say y.

config OF_ADDRESS_PCI
	bool

config OF_GPIO
	depends on GPIOLIB
	depends on OFDEVICE
	def_bool y

config OF_GPIO_PINCONF
	depends on OF_GPIO && HAVE_GPIO_PINCONF
	select GPIO_PINCONF
	bool "Enable support for extra GPIO pin configuration binding"
	default y
	help
	  In addition to the normal pinctrl-names/pinctrl-X binding, there's
	  also a binding to add flags like GPIO_OPEN_DRAIN or GPIO_PULL_UP
	  OR-ed into the cell of the gpios property used for
	  GPIO_ACTIVE_HIGH/LOW. This latter binding is optional and many
	  drivers don't support it.

	  If unsure and not size conscious, say y here to enable the
	  extra binding.

config OF_PCI
	bool
	depends on PCI
	select OF_ADDRESS_PCI
	help
	  OpenFirmware PCI bus accessors

config OF_BAREBOX_DRIVERS
	depends on OFDEVICE
	depends on ENV_HANDLING
	bool "Enable barebox specific devicetree configuration drivers"
	help
	  barebox supports being configured from devicetree. This enables
	  support for this feature. This currently allows to configure the
	  environment path from devicetree and to partition devices. See
	  Documentation/devicetree/bindings/barebox/ for more information.

config OF_BAREBOX_ENV_IN_FS
	depends on OF_BAREBOX_DRIVERS
	bool "Allow environment to come from file"
	help
	  Allow the devie tree configuration of the barebox environment path
	  to specify a file in filesystem, which will be mounted.

config OF_OVERLAY
	select OFTREE
	select FIRMWARE
	bool "Devicetree overlays"
	help
	  Overlays allow to patch the devicetree. Unlike Linux, Barebox does
	  not patch the live devicetree, but applies the overlays as fixup to
	  the devicetree. Furthermore, overlays cannot be removed after they
	  have been applied.

config OF_OVERLAY_LIVE
	depends on OF_OVERLAY
	bool "Support devicetree overlays on live devicetree"
	help
	  This option allows to use devicetree overlays with the live
	  devicetree. It is not required to apply overlays to any other
	  devicetree.

	  This builds the build-in devicetree with __symbols__, which
	  significantly increases the size of the dtb file.

	  Enable this option only if you actually need the live devicetree
	  while applying in the devicetree overlay. This is usually the case if
	  applying the overlay has other side effects than changing the
	  devicetree.
```

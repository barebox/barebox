/*
 * Copyright (C) 2017 PHYTEC Messtechnik GmbH,
 * Author: Daniel Schultz <d.schultz@phytec.de>
 *
 * This program is free software; you can redistribute it and/or
 * modify it under the terms of the GNU General Public License
 * version 2 as published by the Free Software Foundation.
 *
 * This program is distributed in the hope that it will be useful,
 * but WITHOUT ANY WARRANTY; without even the implied warranty of
 * MERCHANTABILITY or FITNESS FOR A PARTICULAR PURPOSE.  See the
 * GNU General Public License for more details.
 */

/dts-v1/;

#include "am33xx.dtsi"
#include "am335x-phytec-phycore-som.dtsi"
#include "am335x-phytec-state.dtsi"

/ {
	model = "Phytec phyCORE EMMC AM335x";
	compatible = "phytec,phycore-am335x-som", "phytec,am335x-som", "ti,am33xx";
};

&mmc2 {
	status = "okay";
};

&spi0 {
	status = "okay";
};

&eeprom {
	status = "okay";
};

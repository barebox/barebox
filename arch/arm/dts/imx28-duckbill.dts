#include <arm/nxp/mxs/imx28-duckbill.dts>

/ {
	barebox,disable-deep-probe;

	chosen {
		stdout-path = &duart;
	};
};

&duart {
	arm,primecell-periphid = <0x00041011>;
};

&ocotp {
	status = "okay";
};

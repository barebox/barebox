/*
 * Barebox specific DT overlay for OpenBlocks AX3-4 board
 *   Sebastian Hesselbarth <sebastian.hesselbarth@gmail.com>
 */

#include "arm/marvell/armada-xp-openblocks-ax3-4.dts"

/ {
	barebox,disable-deep-probe;

	chosen {
		stdout-path = &uart0;
	};
};

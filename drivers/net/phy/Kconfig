## drivers/remoteproc/Kconfig
```kconfig
# SPDX-License-Identifier: GPL-2.0-only
menu "Remoteproc drivers"

config REMOTEPROC
	tristate "Support for Remote Processor subsystem"
	select CRC32
	select FIRMWARE
	help
	  Support for remote processors (such as DSP coprocessors). These
	  are mainly used on embedded systems.

if REMOTEPROC

config IMX_REMOTEPROC
	tristate "IMX6/7 remoteproc support"
	depends on ARCH_IMX
	select MFD_SYSCON
	help
	  Say y here to support iMX's remote processors (Cortex M4
	  on iMX7D) via the remote processor framework.

	  It's safe to say N here.

endif # REMOTEPROC

endmenu
```

## drivers/reset/Kconfig
```kconfig
# SPDX-License-Identifier: GPL-2.0-only
config ARCH_HAS_RESET_CONTROLLER
	bool

menuconfig RESET_CONTROLLER
	bool "Reset Controller Support"
	default y if ARCH_HAS_RESET_CONTROLLER
	help
	  Generic Reset Controller support.

	  This framework is designed to abstract reset handling of devices
	  via GPIOs or SoC-internal reset controller modules.

	  If unsure, say no.

if RESET_CONTROLLER

config RESET_SIMPLE
	bool "Simple Reset Controller Driver" if COMPILE_TEST
	help
	  This enables a simple reset controller driver for reset lines that
	  that can be asserted and deasserted by toggling bits in a contiguous,
	  exclusive register space.

	  Currently this driver supports:
	   - Altera 64-Bit SoCFPGAs
	   - ASPEED BMC SoCs
	   - Bitmain BM1880 SoC
	   - Realtek SoCs
	   - RCC reset controller in STM32 MCUs
	   - Allwinner SoCs
	   - SiFive FU740 SoCs


config RESET_IMX7
	bool "i.MX7 Reset Driver"
	default ARCH_IMX7
	select MFD_SYSCON
	help
	  This enables the reset controller driver for i.MX7 SoCs.

config RESET_STARFIVE
	bool "StarFive Controller Driver" if COMPILE_TEST
	depends on COMMON_CLK
	default SOC_STARFIVE
	help
	  This enables the reset controller driver for the StarFive JH7100.

config RESET_SCMI
	tristate "Reset driver controlled via ARM SCMI interface"
	depends on ARM_SCMI_PROTOCOL || COMPILE_TEST
	default ARM_SCMI_PROTOCOL
	help
	  This driver provides support for reset signal/domains that are
	  controlled by firmware that implements the SCMI interface.

	  This driver uses SCMI Message Protocol to interact with the
	  firmware controlling all the reset signals.

config RESET_SOCFPGA32
	bool "SoCFPGA 32-bit Reset Driver"
	default ARCH_SOCFPGA && 32BIT
	help
	  This enables the reset controller driver for 32-bit SoCFPGA platforms.

endif
```

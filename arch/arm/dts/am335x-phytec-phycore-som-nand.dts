/*
 * Copyright (C) 2014 Teresa Gámez <t.gamez@phytec.de> Phytec Messtechnik GmbH
 *
 * This program is free software; you can redistribute it and/or modify
 * it under the terms of the GNU General Public License version 2 as
 * published by the Free Software Foundation.
 */
/dts-v1/;

#include "am33xx.dtsi"
#include "am335x-phytec-phycore-som.dtsi"

/ {
	model = "Phytec phyCORE AM335x";
	compatible = "phytec,phycore-am335x-som", "phytec,am335x-som", "ti,am33xx";
};

&gpmc {
	status = "okay";
};

&spi0 {
	status = "okay";
};

&eeprom {
	status = "okay";
};

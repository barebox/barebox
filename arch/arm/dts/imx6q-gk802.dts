/*
 * Copyright (C) 2013 Philipp Zabel
 *
 * This file is licensed under the terms of the GNU General Public License
 * version 2.  This program is licensed "as is" without any warranty of any
 * kind, whether express or implied.
 */

#include <arm/imx6q-gk802.dts>
#include "imx6q.dtsi"

/* External USB-A port (USBOTG) */
&usbotg {
	phy_type = "utmi";
	dr_mode = "host";
};

/* Internal USB port (USBH1), connected to RTL8192CU */
&usbh1 {
	phy_type = "utmi";
	dr_mode = "host";
};

## lib/Kconfig.hardening
```kconfig
menu "Hardening options"

if HAS_INSECURE_DEFAULTS
comment "This barebox configuration has CONFIG_HAS_INSECURE_DEFAULTS=y indicating"
comment "that some of the configured options have potentially insecure defaults."
comment "Extra care needs to be taken in secure booted systems."
endif

config BUG_ON_DATA_CORRUPTION
	bool "Trigger a BUG when data corruption is detected"
	select DEBUG_LIST
	help
	  Select this option if barebox should BUG when it encounters
	  data corruption in its memory structures when they get checked
	  for validity.

	  If unsure, say N.

menu "Memory initialization"

config CC_HAS_AUTO_VAR_INIT_PATTERN
	def_bool $(cc-option,-ftrivial-auto-var-init=pattern)

config CC_HAS_AUTO_VAR_INIT_ZERO_BARE
	def_bool $(cc-option,-ftrivial-auto-var-init=zero)

config CC_HAS_AUTO_VAR_INIT_ZERO_ENABLER
	# Clang 16 and later warn about using the -enable flag, but it
	# is required before then.
	def_bool $(cc-option,-ftrivial-auto-var-init=zero -enable-trivial-auto-var-init-zero-knowing-it-will-be-removed-from-clang)
	depends on !CC_HAS_AUTO_VAR_INIT_ZERO_BARE

config CC_HAS_AUTO_VAR_INIT_ZERO
	def_bool CC_HAS_AUTO_VAR_INIT_ZERO_BARE || CC_HAS_AUTO_VAR_INIT_ZERO_ENABLER

choice
	prompt "Initialize barebox stack variables at function entry"
	default INIT_STACK_ALL_PATTERN if COMPILE_TEST && CC_HAS_AUTO_VAR_INIT_PATTERN
	default INIT_STACK_ALL_ZERO if CC_HAS_AUTO_VAR_INIT_ZERO
	default INIT_STACK_NONE
	help
	  This option enables initialization of stack variables at
	  function entry time. This has the possibility to have the
	  greatest coverage (since all functions can have their
	  variables initialized), but the performance impact depends
	  on the function calling complexity of a given workload's
	  syscalls.

	  This chooses the level of coverage over classes of potentially
	  uninitialized variables. The selected class of variable will be
	  initialized before use in a function.

	config INIT_STACK_NONE
		bool "no automatic stack variable initialization (weakest)"
		help
		  Disable automatic stack variable initialization.
		  This leaves barebox vulnerable to the standard
		  classes of uninitialized stack variable exploits
		  and information exposures.

	config INIT_STACK_ALL_PATTERN
		bool "pattern-init everything (strongest)"
		depends on CC_HAS_AUTO_VAR_INIT_PATTERN
		help
		  Initializes everything on the stack (including padding)
		  with a specific debug value. This is intended to eliminate
		  all classes of uninitialized stack variable exploits and
		  information exposures, even variables that were warned about
		  having been left uninitialized.

		  Pattern initialization is known to provoke many existing bugs
		  related to uninitialized locals, e.g. pointers receive
		  non-NULL values, buffer sizes and indices are very big. The
		  pattern is situation-specific; Clang on 64-bit uses 0xAA
		  repeating for all types and padding except float and double
		  which use 0xFF repeating (-NaN). Clang on 32-bit uses 0xFF
		  repeating for all types and padding.

	config INIT_STACK_ALL_ZERO
		bool "zero-init everything (strongest and safest)"
		depends on CC_HAS_AUTO_VAR_INIT_ZERO
		help
		  Initializes everything on the stack (including padding)
		  with a zero value. This is intended to eliminate all
		  classes of uninitialized stack variable exploits and
		  information exposures, even variables that were warned
		  about having been left uninitialized.

		  Zero initialization provides safe defaults for strings
		  (immediately NUL-terminated), pointers (NULL), indices
		  (index 0), and sizes (0 length), so it is therefore more
		  suitable as a production security mitigation than pattern
		  initialization.

endchoice

config INIT_ON_ALLOC_DEFAULT_ON
	bool "Enable heap memory zeroing on allocation by default"
	depends on !MALLOC_LIBC
	help
	  When this is enabled, all allocator memory will be zeroed
	  when allocated, eliminating many kinds of "uninitialized
	  heap memory" flaws, especially heap content exposures.

config INIT_ON_FREE_DEFAULT_ON
	bool "Enable heap memory zeroing on free by default"
	depends on !MALLOC_DUMMY && !MALLOC_LIBC
	help
	  When this is enabled, all allocator memory will be zeroed
	  when freed, eliminating many kinds of "uninitialized heap memory"
	  flaws, especially heap content exposures. The primary difference
	  is that data lifetime in memory is reduced, as anything freed is
	  wiped immediately, making live forensics or cold boot memory
	  attacks unable to recover freed memory contents.

config CC_HAS_ZERO_CALL_USED_REGS
	def_bool $(cc-option,-fzero-call-used-regs=used-gpr)
	# https://github.com/ClangBuiltLinux/linux/issues/1766
	# https://github.com/llvm/llvm-project/issues/59242
	depends on !CC_IS_CLANG || CLANG_VERSION > 150006

config ZERO_CALL_USED_REGS
	bool "Enable register zeroing on function exit"
	depends on CC_HAS_ZERO_CALL_USED_REGS
	help
	  At the end of functions, always zero any caller-used register
	  contents. This helps ensure that temporary values are not
	  leaked beyond the function boundary. This means that register
	  contents are less likely to be available for side channels
	  and information exposures. Additionally, this helps reduce the
	  number of useful ROP gadgets by about 20% (and removes compiler
	  generated "write-what-where" gadgets) in the resulting kernel
	  image. This has a less than 1% performance impact on most
	  workloads. Image size growth depends on architecture, and should
	  be evaluated for suitability. For example, x86_64 grows by less
	  than 1%, and arm64 grows by about 5%.

endmenu

config STACK_GUARD_PAGE
	bool "Place guard page to catch stack overflows"
	depends on ARM && MMU
	help
	  When enabled, barebox places a faulting guard page to catch total
	  stack usage exceeding CONFIG_STACK_SIZE. On overflows, that hit
	  the reserved 4KiB, barebox will panic and report a stack overflow.
	  The report may not always succeed if the stack overflow impacts
	  operation of the exception handler.

config STACKPROTECTOR
	bool

choice
	prompt "Stack Protector buffer overflow detection"

config STACKPROTECTOR_NONE
	bool "None"

config STACKPROTECTOR_STRONG
	bool "Strong"
	depends on $(cc-option,-fstack-protector-strong)
	select STACKPROTECTOR
	help
	  This option turns on the "stack-protector" GCC feature. This
	  feature puts, at the beginning of functions, a canary value on
	  the stack just before the return address, and validates
	  the value just before actually returning.  Stack based buffer
	  overflows (that need to overwrite this return address) now also
	  overwrite the canary, which gets detected and the attack is then
	  neutralized via a barebox panic.

	  Functions will have the stack-protector canary logic added in any
	  of the following conditions:

	  - local variable's address used as part of the right hand side of an
	    assignment or function argument
	  - local variable is an array (or union containing an array),
	    regardless of array type or length
	  - uses register local variables

	  The canary will be a fixed value at first, but will be replaced by
	  one generated from a hardware random number generator if available
	  later on.

config STACKPROTECTOR_ALL
	bool "All"
	depends on $(cc-option,-fstack-protector-all)
	depends on COMPILE_TEST
	select STACKPROTECTOR
	help
	  This pushes and verifies stack protector canaries on all functions,
	  even those that don't need it. As this implies injection of a
	  global variable dependency on every function, this option is useful
	  for crashing functions called prior to prerelocation, which lack a
	  __prereloc attribute. This is likely the only upside compared to
	  the strong variant, so it's not selectable by default.

endchoice

choice
	prompt "Stack Protector buffer overflow detection for PBL" if PBL_IMAGE

config PBL_STACKPROTECTOR_NONE
	bool "None"

config PBL_STACKPROTECTOR_STRONG
	bool "Strong"
	depends on $(cc-option,-fstack-protector-strong)
	depends on PBL_IMAGE
	select STACKPROTECTOR
	help
	  For PBL, This option turns on the "stack-protector" GCC feature. This
	  feature puts, at the beginning of functions, a canary value on
	  the stack just before the return address, and validates
	  the value just before actually returning.  Stack based buffer
	  overflows (that need to overwrite this return address) now also
	  overwrite the canary, which gets detected and the attack is then
	  neutralized via a barebox panic.

	  Functions will have the stack-protector canary logic added in any
	  of the following conditions:

	  - local variable's address used as part of the right hand side of an
	    assignment or function argument
	  - local variable is an array (or union containing an array),
	    regardless of array type or length
	  - uses register local variables

	  The canary is always a fixed value.

config PBL_STACKPROTECTOR_ALL
	bool "PBL"
	depends on $(cc-option,-fstack-protector-strong)
	depends on PBL_IMAGE && COMPILE_TEST
	select STACKPROTECTOR
	help
	  This pushes and verifies stack protector canaries on all functions,
	  even those that don't need it. As this implies injection of a
	  global variable dependency on every function, this option is useful
	  for crashing functions called prior to prerelocation, which lack a
	  __prereloc attribute. This is likely the only upside compared to
	  the strong variant.

endchoice

config MEMORY_ATTRIBUTES
	bool "record memory attributes" if EXPERIMENTAL
	help
	  Tag all SDRAM memory region requests with type and attributes.
	  This is currently not acted upon, but protections (e.g. read-only)
	  will in future be enforced by the MMU.

endmenu
```

## lib/Kconfig.ubsan
```kconfig
# SPDX-License-Identifier: GPL-2.0-only
config ARCH_HAS_UBSAN_SANITIZE_ALL
	bool

config UBSAN
	bool "Undefined behaviour sanity checker"
	help
	  This option enables undefined behaviour sanity checker
	  Compile-time instrumentation is used to detect various undefined
	  behaviours in runtime.

if UBSAN

config UBSAN_SANITIZE_ALL
	bool "Enable instrumentation for all of barebox"
	depends on ARCH_HAS_UBSAN_SANITIZE_ALL
	default y
	help
	  This option activates instrumentation for all of barebox.
	  If you don't enable this option, you have to explicitly specify
	  UBSAN_SANITIZE := y for the files/directories you want to check for UB.
	  Enabling this option will get barebox image size increased
	  significantly.

config UBSAN_NO_ALIGNMENT
	bool "Disable checking of pointers alignment"
	default y if HAVE_EFFICIENT_UNALIGNED_ACCESS
	help
	  This option disables the check of unaligned memory accesses.
	  This option should be used when building allmodconfig.
	  Disabling this option on architectures that support unaligned
	  accesses may produce a lot of false positives.

config UBSAN_STANDALONE
	def_bool !SANDBOX

config UBSAN_ALIGNMENT
	def_bool !UBSAN_NO_ALIGNMENT

endif
```

## lib/bootstrap/Kconfig
```kconfig
# SPDX-License-Identifier: GPL-2.0-only

menuconfig BOOTSTRAP
	bool "Library bootstrap routines"
	depends on SHELL_NONE

if BOOTSTRAP

config BOOTSTRAP_DEVFS
	bool "devfs support"

config BOOTSTRAP_DISK
	bool "disk support"

endif
```

## lib/fonts/Kconfig
```kconfig
# SPDX-License-Identifier: GPL-2.0-only

#
# Font configuration
#

config FONTS
	bool "Select compiled-in fonts"
	depends on FRAMEBUFFER_CONSOLE

if FONTS

config FONT_8x16
	bool "VGA 8x16 font"
	help
	  This is the "high resolution" font for the VGA frame buffer (the one
	  provided by the VGA text console 80x25 mode).

config FONT_8x8
	bool "VGA 8x8 font"

config FONT_7x14
	bool "7x14 font"

config FONT_MINI_4x6
	bool "Mini 4x6 font"

config FONT_CUSTOM_16X
	bool "Custom 16x16 font"
	help
	  This font is useful for Chinese and other non ascii chars.

config FONT_TER16x32
	bool "Terminus 16x32 font"
	help
	  Terminus Font is a clean, fixed width bitmap font, designed
	  for long (8 and more hours per day) work with computers.
	  This is the high resolution, large version for use with HiDPI screens.
	  If the standard font is unreadable for you, say Y, otherwise say N.

config FONT_6x8
	bool "6x8 font"
	help
	  This font is useful for small displays (OLED).

config FONT_AUTOSELECT
	def_bool y
	depends on !FONT_8x8
	depends on !FONT_MINI_4x6
	depends on !FONT_7x14
	depends on !FONT_6x8
	depends on !FONT_TER16x32
	select FONT_8x16

endif # FONTS
```

## lib/gui/Kconfig
```kconfig
menu "Library gui routines"

config IMAGE_RENDERER
	bool
	select FILETYPE

if IMAGE_RENDERER

config 2D_PRIMITIVES
       bool

config BMP
	bool "bmp"

config PNG
	bool "png"
	select ZLIB

if PNG

choice
	prompt "PNG Lib"

config LODEPNG
	bool "lodePNG"
	help
	  This PNG library supports most PNG formats.

config PICOPNG
	bool "picoPNG"
	help
	  This PNG library only supports RGBA PNG8 but is much smaller
	  in binary size than lodepng.

endchoice

endif

endif

endmenu
```

## lib/kasan/Kconfig
```kconfig
# SPDX-License-Identifier: GPL-2.0-only

config CC_HAS_KASAN_GENERIC
	def_bool $(cc-option, -fsanitize=kernel-address)

config KASAN
	bool "KASAN: runtime memory debugger"
	depends on (HAVE_ARCH_KASAN && CC_HAS_KASAN_GENERIC)
	depends on MALLOC_TLSF
	select PRINTF_HEXSTR
	help
	  Enables KASAN (KernelAddressSANitizer) - runtime memory debugger,
	  designed to find out-of-bounds accesses and use-after-free bugs.
```

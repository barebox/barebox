## security/Kconfig
```kconfig
# SPDX-License-Identifier: GPL-2.0-only
#
# Security configuration
#

menu "Security options"

config INSECURE
	bool "enable convenient defaults that are unsuitable for secure-booting systems"
	default y
	select HAS_INSECURE_DEFAULTS
	help
	  Say n here when barebox is part of a secure boot chain and you
	  want to disable defaults that may compromise the boot chain.

	  This option is a moving target. Currently it:

	    - changes the default of global.env.autoprobe to 1

config PASSWORD
	bool
	prompt "Password Framework"
	select DIGEST
	help
	  allow you to have password protection framework

config PASSWORD_DEFAULT
	string
	prompt "Password default file"
	depends on PASSWORD
	help
	  Set this to a file which is used as default password file. This file
	  has to contain the passwd encoded with the selected password digest.
	  i.e.:
	  echo -ne "MyPassword" | md5sum | while read a b; do echo $a > passwdfile; done


if PASSWORD

choice
	prompt "passwd checksum"
	default PASSWD_CRYPTO_PBKDF2

config PASSWD_SUM_MD5
	bool "MD5"
	select DIGEST_MD5_GENERIC
	select HAS_INSECURE_DEFAULTS
	help
	  MD5 had been widely used historically as a cryptographic hash function,
	  but has been found to suffer from extensive vulnerabilities.
	  Use of MD5 to hash passwords is strongly discouraged.

config PASSWD_SUM_SHA1
	bool "SHA1"
	select DIGEST_SHA1_GENERIC
	select HAS_INSECURE_DEFAULTS
	help
	  SHA1 had been widely used historically as a cryptographic hash function,
	  but has since been cryptographically broken.
	  SHA-1 was designed for speed and thus use as password hash is strongly
	  discouraged as it's easier for an attacker to brute force.

config PASSWD_SUM_SHA256
	bool "SHA256"
	select DIGEST_SHA256_GENERIC

config PASSWD_SUM_SHA512
	bool "SHA512"
	select DIGEST_SHA512_GENERIC

config PASSWD_CRYPTO_PBKDF2
	bool "PBKDF2"
	select CRYPTO_PBKDF2

endchoice

endif

config CRYPTO_BUILTIN_DEVELOPMENT_KEYS
	select HAS_INSECURE_DEFAULTS
	depends on CRYPTO_BUILTIN_KEYS
	bool "Include development keys in build"
	help
	  Say y here to include well known development keys in build. These can be
	  used to authenticate FIT images during development. The private keys can
	  be found at [1]. This option should never be enabled in a production build.

	  [1] https://git.pengutronix.de/cgit/ptx-code-signing-dev/

config CRYPTO_KEYSTORE
	bool "Keystore"
	help
	  This is a simple keystore, which can be used to pass keys
	  between several components via simple interface.

config BLOBGEN
	select BASE64
	bool "include blob encode/decode support"

config JWT
	bool "JSON Web Token support" if COMPILE_TEST
	select JSMN
	select BASE64
	select CRYPTO_RSA
	select TEST_KEY_RSA2048 if FUZZ

menu "OP-TEE loading"

config HAVE_OPTEE
	bool
	help
	  This symbol is selected by configuration where barebox either
	  starts OP-TEE or runs while OP-TEE is running. Actual
	  bidirectional communication with OP-TEE is enabled via
	  CONFIG_OPTEE.

config OPTEE_SIZE
	hex
	default 0x02000000
	prompt "OP-TEE Memory Size"
	depends on HAVE_OPTEE
	help
	  Size to reserve in main memory for OP-TEE, including its shared memory.
	  Can be larger than the actual size used by OP-TEE, this is used to prevent
	  barebox from using or speculating into this area.
	  On i.MX, this should be at least OP-TEE CFG_TZDRAM + CFG_SHMEM_SIZE.
	  The name of the CFG_ options may differ on other platforms.

config OPTEE_SHM_SIZE
	hex
	default 0x400000
	prompt "OP-TEE Shared Memory Size"
	depends on HAVE_OPTEE
	help
	  Size to reserve in main memory for static OP-TEE shared memory
	  communication. The OP-TEE shared memory starts directly after
	  the OPTEE TZDRAM region. It should be chosen to be equivalent
	  to CFG_SHMEM_SIZE in OP-TEE.

	  This value can be used for fixing up the OP-TEE OF node.

	  A shared memory size of 0 means that only dynamic shared memory
	  will be supported for communication with OP-TEE. This is the only
	  mode supported by barebox anyway, but support needs to be enabled
	  in OP-TEE at compile-time.

config BOOTM_OPTEE
	bool
	prompt "support booting OP-TEE"
	depends on BOOTM && ARM32
	select HAVE_OPTEE
	select HAS_INSECURE_DEFAULTS
	help
	  OP-TEE is a trusted execution environment (TEE). With this option
	  enabled barebox supports starting optee_os as part of the bootm command.
	  Instead of the kernel bootm starts the optee_os binary which then starts
	  the kernel in nonsecure mode. Pass the optee_os binary with the -t option
	  or in the global.bootm.tee variable.

	  This mode of late loading OP-TEE just before the kernel is deprecated
	  in favor of early loading OP-TEE in the PBL (CONFIG_PBL_OPTEE).
	  Early-loading greatly reduces the attack surface and is the only mode
	  supported outside of ARMv7.

config PBL_OPTEE
	bool "Enable OP-TEE early start"
	depends on ARM
	select HAVE_OPTEE
	help
	  Allows starting OP-TEE during lowlevel initialization of the PBL.
	  Requires explicit support in the board's lowlevel file (for ARM32)
	  or the generic SoC support (for ARM64).

	  OP-TEE versions older than 3.11.0 do not support jumping back from OP-TEE
	  to barebox in THUMB2 mode. Make sure you do not compile barebox in THUMB2
	  mode for OP-TEE versions older than this.

endmenu

source "lib/Kconfig.hardening"

config HAS_INSECURE_DEFAULTS
	bool
	help
	  This is selected by options that have potentially insecure defaults.
	  Extra care needs to be taken when these options are not disabled
	  in secure booted systems.

	  Any option selecting this should include in its help text
	  an explanation of the security considerations.

if HAS_INSECURE_DEFAULTS
comment "This barebox configuration has CONFIG_HAS_INSECURE_DEFAULTS=y indicating"
comment "that some of the configured options have potentially insecure defaults."
comment "Extra care needs to be taken in secure booted systems."
endif


endmenu
```

## security/Kconfig.policy
```kconfig
# SPDX-License-Identifier: GPL-2.0-only
#
# barebox Security Policy Support

menuconfig SECURITY_POLICY
	bool "Security Policy Support"
	help
	  A Security policy is a collection of security configuration options
	  that can be activated together at runtime.
	  Together, the describe a security state that barebox should operate in.

	  Policies can be registered by board code or supplied by
	  an external build system. The policy name must be unique across
	  all registered policies.

	  Policies are selected by name and only one can be active at a given time.
	  barebox does not mandate any specific behavior for a policy according
	  to its name. Boards have full freedom to name policies and configure the
	  options as they deem appropriate.

	  However, we recommend using established terms to make it easier to reason
	  about the different security states:

	    devel     Security policy should permit everything for
	              development purposes.

	    factory   System is in a secure boot mode, but policy allows
	              interactive use for factory bring up purposes.
	              Board code usually enforces via eFuse that factory
	              mode can not be re-selected once deselected.

	    lockdown  Factory bring up is done and device is ready for use
	              in the field with barebox as part of the secure boot
	              chain. This policy usually disallows booting unsigned
	              images

	    tamper    Tampering attempt was detected. The security policy would
	              take steps to protect secrets (up to bricking the device).

	    return    For use in field-return devices, the policy should
	              take steps to unlock the device for analysis purposes.
	              Board code should make sure to delete secret and
	              confidential data before activating this policy.

if SECURITY_POLICY

config SECURITY_POLICY_INIT
	string
	prompt "Initial security policy"
	help
	  The policy named here will be automatically selected the first
	  time a security policy is to be consulted.
	  It's recommended to use a restrictive policy here and remove
	  the restrictions if needed instead of the other way round.

config SECURITY_POLICY_DEFAULT_PERMISSIVE
	bool "Be permissive on missing security policy"
	select HAS_INSECURE_DEFAULTS
	help
	  In absence of a selected security policy, by enabling this option
	  everything is allowed. A warning will be printed the first time a
	  security policy would need to be consulted.

	  With this option disabled everything is forbidden until a security
	  policy is selected.

	  This is a development aid and unsuitable for use in the field:
	  A security policy should always be selected, either early on by
	  board code or via CONFIG_SECURITY_POLICY_INIT.

config SECURITY_POLICY_PATH
	string
	depends on SECURITY_POLICY
	prompt "Paths to additional security policies"
	help
	  Space separated list of security policies that should be
	  compiled into barebox and registered. This option currently
	  requires each security policy to match security/*.sconfig, i.e.
	  be directly located in the security/ directory of the source
	  source tree and have the .sconfig extension.
	  If left empty, only security policies explicitly provided
	  and registered by board code will be available.

	  Absolute paths are disallowed.

config SECURITY_POLICY_NAMES
	bool

endif
```

## test/Kconfig
```kconfig
# SPDX-License-Identifier: GPL-2.0-only

menuconfig TEST
	bool "Testing"

if TEST

source "test/self/Kconfig"

config FUZZ
	bool "fuzz tests"
	select RAMDISK_BLK
	select DISK
	help
	  Say y here to add include fuzz tests into barebox.
	  These need to be exercised either via command or
	  by libfuzzer

config FUZZ_EXTERNAL
	bool "link against libfuzzer"
	depends on SANDBOX && CC_IS_CLANG
	help
	  LibFuzzer is an in-process, coverage-guided, evolutionary fuzzing
	  engine. It can be linked against barebox on the sandbox
	  architecture to feed fuzzed inputs into the fuzz tests.

if FUZZ

config CMD_FUZZ
	bool "fuzz command"
	depends on COMMAND_SUPPORT
	default y
	help
	  Command to run enabled barebox fuzz tests on fixed input.
	  If run without arguments, all tests are run.

	  This is mostly useful for debugging, use FUZZ_EXTERNAL
	  to have fuzzed inputs be bed automatically .

	  Usage: fuzz [-ls] -f FILE [test]

	  Options:
	    -l        list registered fuzz tests
	    -f FILE   use FILE as fuzz input
	    -s SIZE   read only SIZE bytes from file

endif

config TEST_KEY_RSA2048
	bool
	help
	  This is selected by crypto test code that needs a RSA2048 public
	  key. The key added by this option is stand-alone, i.e., it is
	  not part of the key ring and won't be consulted for FIT image
	  verification.

endif
```

## test/self/Kconfig
```kconfig
# SPDX-License-Identifier: GPL-2.0

config SELFTEST
	bool "Self-tests"
	help
	  Configures support for in-barebox testing

if SELFTEST

config CMD_SELFTEST
	bool "selftest command"
	depends on COMMAND_SUPPORT
	default y
	help
	  Command to run enabled barebox self-tests.
	  If run without arguments, all tests are run

	  Usage: selftest [-l] [tests...]

	  Options:
	    -l     list available tests

config SELFTEST_AUTORUN
	bool "Run self-tests on startup"
	help
	  Self tests are run automatically after initcalls are done,
	  but before barebox_main (shell or board-specific startup).

config SELFTEST_ENABLE_ALL
	bool "Enable all self-tests"
	select SELFTEST_PRINTF
	select SELFTEST_MALLOC
	select SELFTEST_PROGRESS_NOTIFIER
	select SELFTEST_OF_MANIPULATION
	select SELFTEST_ENVIRONMENT_VARIABLES if ENVIRONMENT_VARIABLES
	select SELFTEST_FS_RAMFS if FS_RAMFS
	select SELFTEST_TFTP if FS_TFTP
	select SELFTEST_JSON if JSMN
	select SELFTEST_JWT if JWT
	select SELFTEST_DIGEST if DIGEST
	select SELFTEST_MMU if MMU
	select SELFTEST_STRING
	select SELFTEST_SETJMP if ARCH_HAS_SJLJ
	select SELFTEST_REGULATOR if REGULATOR && OFDEVICE
	select SELFTEST_TEST_COMMAND if CMD_TEST
	select SELFTEST_IDR
	help
	  Selects all self-tests compatible with current configuration

config SELFTEST_MALLOC
	bool "malloc() selftest"
	help
	  Tests barebox memory allocator

config SELFTEST_PRINTF
	bool "printf selftest"
	help
	  Tests barebox vsnprintf() functionality

config SELFTEST_OF_MANIPULATION
	bool "OF manipulation selftest"
	select OFTREE
	help
	  Tests barebox device tree manipulation functionality

config SELFTEST_PROGRESS_NOTIFIER
	bool "progress notifier selftest"

config SELFTEST_ENVIRONMENT_VARIABLES
	bool "environment variable selftest"

config SELFTEST_FS_RAMFS
	bool "ramfs selftest"
	depends on FS_RAMFS

config SELFTEST_JSON
	bool "JSON selftest"
	depends on JSMN

config SELFTEST_JWT
	bool "JSON Web Token selftest"
	depends on JWT

config SELFTEST_MMU
	bool "MMU remapping selftest"
	select MEMTEST
	depends on MMU

config SELFTEST_DIGEST
	bool "Digest selftest"
	depends on DIGEST
	select PRINTF_HEXSTR

config SELFTEST_STRING
	bool "String library selftest"
	select VERSION_CMP

config SELFTEST_SETJMP
	bool "setjmp/longjmp library selftest"
	depends on ARCH_HAS_SJLJ

config SELFTEST_REGULATOR
	bool "Regulator selftest"
	depends on REGULATOR && OFDEVICE
	select OF_OVERLAY

config SELFTEST_TEST_COMMAND
	bool "test command selftest"
	depends on CMD_TEST

config SELFTEST_IDR
	bool "idr selftest"
	select IDR

endif
```

## test/testdata/multi_v7_defconfig-gzipped.its
```
/dts-v1/;

/ {
    description = "fitImage for testing";
    #address-cells = <1>;
    images {
        kernel-1 {
            description = "barebox image";
            data = /incbin/("barebox-dt-2nd.img.gz");
            type = "kernel";
            arch = "arm";
            os = "linux";
            compression = "gzip";
            hash-1 {
                algo = "sha256";
            };
        };
        fdt-qemu-virt32.dtb {
            description = "Flattened Device Tree blob";
            data = /incbin/("arch/arm/dts/qemu-virt32.dtb");
            type = "flat_dt";
            arch = "arm";
            compression = "none";
            hash-1 {
                algo = "sha256";
            };
        };
        ramdisk-1 {
            description = "initramfs 1 (compressed)";
            data = /incbin/("testfs/ramdisk1.cpio.gz");
            type = "ramdisk";
            arch = "arm";
            os = "linux";
            compression = "none";
            hash-1 {
                algo = "sha256";
            };
        };
        ramdisk-2 {
            description = "initramfs 2 (uncompressed)";
            data = /incbin/("testfs/ramdisk2.cpio");
            type = "ramdisk";
            arch = "arm";
            os = "linux";
            compression = "none";
            hash-1 {
                algo = "sha256";
            };
        };
        ramdisk-3 {
            description = "initramfs 3 (compressed)";
            data = /incbin/("testfs/ramdisk3.cpio.gz");
            type = "ramdisk";
            arch = "arm";
            os = "linux";
            compression = "none";
            hash-1 {
                algo = "sha256";
            };
        };
    };

    configurations {
        default = "conf-qemu-virt32.dtb";
        conf-qemu-virt32.dtb {
            description = "Qemu Virt32";
            kernel = "kernel-1";
            fdt = "fdt-qemu-virt32.dtb";
            ramdisk = "ramdisk-1", "ramdisk-2", "ramdisk-3";
            compatible = "linux,dummy-virt";
            signature-1 {
                algo = "sha256,rsa2048";
                sign-images = "kernel", "fdt", "ramdisk";
                signer-name = "None";
                signer-version = "None";
            };
        };
    };
};
```

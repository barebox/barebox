/dts-v1/;

#include <arm/nxp/imx/imx6dl.dtsi>
#include <arm/nxp/imx/imx6qdl-tx6.dtsi>
#include "imx6qdl.dtsi"
#include "imx6qdl-tx6x.dtsi"

/ {
	model = "Ka-Ro electronics TX6U-801x Module";
	compatible = "karo,imx6dl-tx6dl", "fsl,imx6dl";
	barebox,disable-deep-probe;
};


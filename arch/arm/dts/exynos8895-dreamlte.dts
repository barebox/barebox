// SPDX-License-Identifier: GPL-2.0 OR BSD-3-Clause
/*
 * Samsung Galaxy S8 (dreamlte/SM-G950F) barebox device tree source
 *
 * Copyright (c) 2025, Ivaylo Ivanov <ivo.ivanov.ivanov1@gmail.com>
 */

/dts-v1/;
#include <arm64/exynos/exynos8895-dreamlte.dts>

/ {
	barebox,deep-probe;
};

// SPDX-License-Identifier: (GPL-2.0+ OR BSD-3-Clause)
/*
 * Copyright (C) 2020 Ahmad Fatoum, Pengutronix
 */

#include <arm/st/stm32mp157c-odyssey.dts>

/ {
	barebox,disable-deep-probe;

	chosen {
		environment-sd {
			compatible = "barebox,environment";
			device-path = &sdmmc1, "partname:barebox-environment";
			status = "disabled";
		};

		environment-emmc {
			compatible = "barebox,environment";
			device-path = &sdmmc2, "partname:barebox-environment";
			status = "disabled";
		};
	};
};

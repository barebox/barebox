## .github/testfs/multi_v7_defconfig-gzipped.its
```
/dts-v1/;

/ {
    description = "fitImage for testing";
    #address-cells = <1>;
    images {
        kernel-1 {
            description = "barebox image";
            data = /incbin/("barebox-dt-2nd.img.gz");
            type = "kernel";
            arch = "arm";
            os = "linux";
            compression = "gzip";
            hash-1 {
                algo = "sha256";
            };
        };
        fdt-qemu-virt32.dtb {
            description = "Flattened Device Tree blob";
            data = /incbin/("arch/arm/dts/qemu-virt32.dtb");
            type = "flat_dt";
            arch = "arm";
            compression = "none";
            hash-1 {
                algo = "sha256";
            };
        };
        ramdisk-1 {
            description = "initramfs";
            data = /incbin/("ramdisk.cpio.gz");
            type = "ramdisk";
            arch = "arm";
            os = "linux";
            compression = "none";
            hash-1 {
                algo = "sha256";
            };
        };
    };

    configurations {
        default = "conf-qemu-virt32.dtb";
        conf-qemu-virt32.dtb {
            description = "Qemu Virt32";
            kernel = "kernel-1";
            fdt = "fdt-qemu-virt32.dtb";
            ramdisk = "ramdisk-1";
            compatible = "linux,dummy-virt";
            signature-1 {
                algo = "sha256,rsa2048";
                sign-images = "kernel", "fdt", "ramdisk";
                signer-name = "None";
                signer-version = "None";
            };
        };
    };
};
```

## .github/testfs/multi_v8_defconfig-gzipped.its
```
/dts-v1/;

/ {
    description = "fitImage for testing";
    #address-cells = <1>;
    images {
        kernel-1 {
            description = "barebox image";
            data = /incbin/("barebox-dt-2nd.img.gz");
            type = "kernel";
            arch = "arm64";
            os = "linux";
            compression = "gzip";
            hash-1 {
                algo = "sha256";
            };
        };
        fdt-qemu-virt64.dtb {
            description = "Flattened Device Tree blob";
            data = /incbin/("arch/arm/dts/qemu-virt64.dtb");
            type = "flat_dt";
            arch = "arm64";
            compression = "none";
            hash-1 {
                algo = "sha256";
            };
        };
        ramdisk-1 {
            description = "initramfs";
            data = /incbin/("ramdisk.cpio.gz");
            type = "ramdisk";
            arch = "arm64";
            os = "linux";
            compression = "none";
            hash-1 {
                algo = "sha256";
            };
        };
    };

    configurations {
        default = "conf-qemu-virt64.dtb";
        conf-qemu-virt64.dtb {
            description = "Qemu Virt64";
            kernel = "kernel-1";
            fdt = "fdt-qemu-virt64.dtb";
            ramdisk = "ramdisk-1";
            compatible = "linux,dummy-virt";
            signature-1 {
                algo = "sha256,rsa2048";
                sign-images = "kernel", "fdt", "ramdisk";
                signer-name = "None";
                signer-version = "None";
            };
        };
    };
};
```

## Documentation/devicetree/bindings/barebox.txt
```
barebox specific devicetree bindings
====================================

barebox uses some barebox specific devicetree bindings. All of these
are under the /chosen/ hierarchy in the devicetree.

The bindings have the form of a device with regular 'compatible' properties.
drivers matching these devices do not handle physical devices but instead
influence / configure certain behaviours of barebox like the place where to
find the persistent environment.
```

## Documentation/devicetree/bindings/barebox/barebox,environment.txt
```
barebox environment
===================

This driver provides an environment for barebox from the devicetree.

Required properties:
- compatible: should be "barebox,environment"
- device-path: path to the environment

The device-path is a multistring property. The first string should be a
nodepath to the node containing the physical device of the environment.
The subsequent strings are of the form <type>:<options> to further describe
the path to the environment. Supported values for <type>:

partname:<partname>  This describes a partition on a device. <partname> can
                     be the label for mtd partitions, the number for DOS
		     partitions (beginning with 0) or the name for GPT
		     partitions

Example:

environment@0 {
	compatible = "barebox,environment";
	device-path = &flash, "partname:barebox-environment";
};
```

## Documentation/devicetree/bindings/display/panel/panel-ilitek-ili9488.yaml
```yaml
# SPDX-License-Identifier: (GPL-2.0-only OR BSD-2-Clause)
%YAML 1.2
---
$id: "http://devicetree.org/schemas/video/panel-ilitek-ili9488.yaml#"
$schema: "http://devicetree.org/meta-schemas/core.yaml#"

title: Ilitek ILI9488 TFT LCD Panel (MIPI DBI SPI)

maintainers:
  - Giandomenico Rossi <rossi@amelchem.com>

description: |
  Ilitek ILI9488 TFT LCD controller connected over MIPI DBI Type C
  Option 1 using an SPI bus.

  Specific panels such as the Winstar WF35-320480UD may provide a
  vendor-specific compatible string followed by "ilitek,ili9488"
  as fallback.

  The controller supports RGB666 (18-bit) pixel format over SPI.

properties:
  compatible:
    oneOf:
      - items:
          - const: winstar,wf35-320480ud
          - const: ilitek,ili9488
      - const: ilitek,ili9488

  reg:
    description: SPI chip select number
    maxItems: 1

  spi-max-frequency:
    $ref: /schemas/types.yaml#/definitions/uint32
    maximum: 48000000
    description: Maximum SPI clock frequency in Hz

  reset-gpios:
    description: Optional hardware reset GPIO
    maxItems: 1

  power-supply:
    description: Regulator supplying panel power

  backlight:
    description: Phandle to a backlight device

  rotation:
    description: |
      Display rotation in degrees clockwise.

      The driver uses this value to configure the ILI9488
      Memory Access Control (MADCTL) register.
    enum: [0, 90, 180, 270]
    default: 0

  panel-timing:
    description: |
      Panel timing description.

      For MIPI DBI panels the pixel clock and porch values are ignored,
      but xactive/yactive must be provided.
    type: object
    properties:
      clock-frequency:
        description: Dummy pixel clock (may be 0)
      hactive:
        description: Horizontal resolution in pixels
      vactive:
        description: Vertical resolution in pixels
      hfront-porch:
        default: 0
      hback-porch:
        default: 0
      hsync-len:
        default: 0
      vfront-porch:
        default: 0
      vback-porch:
        default: 0
      vsync-len:
        default: 0

    required:
      - hactive
      - vactive

required:
  - compatible
  - reg
  - panel-timing

additionalProperties: false

examples:
  - |
    spi {
        #address-cells = <1>;
        #size-cells = <0>;

        display@0 {
            compatible = "winstar,wf35-320480ud", "ilitek,ili9488";
            reg = <0>;
            spi-max-frequency = <40000000>;

            reset-gpios = <&gpio1 6 GPIO_ACTIVE_HIGH>;

            power-supply = <&vcc_3v3>;
            backlight = <&backlight>;

            rotation = <90>;

            panel-timing {
                hactive = <480>;
                vactive = <320>;
                clock-frequency = <0>;
            };
        };
    };
```

## Documentation/devicetree/bindings/firmware/altr,passive-serial.txt
```
Altera FPGAs in passive serial mode
-----------------------------------

This binding defines the control interface to Altera FPGAs in
passive serial mode. This is used to upload the firmware and
to start the FPGA.

Required properties:
- compatible: shall be "altr,fpga-passive-serial" or
  "altr,fpga-arria10-passive-serial" for Arria 10
- reg: SPI chip select
- nstat-gpios: Specify GPIO for controlling the nstat pin
- confd-gpios: Specify GPIO for controlling the confd pin
- nconfig-gpios: Specify GPIO for controlling the nconfig pin

Example:

	fpga@0 {
		compatible = "altr,fpga-passive-serial";
		nstat-gpios = <&gpio4 18 0>;
		confd-gpios = <&gpio4 19 0>;
		nconfig-gpios = <&gpio4 20 0>;
		spi-max-frequency = <10000000>;
		reg = <0>;
	};
```

## Documentation/devicetree/bindings/firmware/altr,socfpga-fpga-mgr.txt
```
Altera SOCFPGA FPGA Manager
---------------------------

This binding defines the FPGA Manager on Altera SOCFPGAs. This is used to upload
the firmware to the FPGA part of the SoC.

Required properties:
- compatible: shall be "altr,socfpga-fpga-mgr"
- reg: Must contain 2 register ranges:
	1. The control address space of the FPGA manager.
	2. The configuration data address space where the firmware data is written to.

Example:

	fpgamgr@ff706000 {
		compatible = "altr,socfpga-fpga-mgr";
		reg = <0xff706000 0x1000>,
		      <0xffb90000 0x1000>;
	};
```

## Documentation/devicetree/bindings/leds/common.txt
```
Common leds properties.

- linux,default-trigger barebox,default-trigger:  This parameter, if present, is a
    string defining the trigger assigned to the LED.  Current triggers are:
     "heartbeat" - LED flashes at a constant rate
     "panic" - LED turns on when barebox panics
     "net" - LED indicates network activity
```

## Documentation/devicetree/bindings/misc/fsl,imx-iim.txt
```
Freescale i.MX IIM (Ic Identification Module)

Required properties:

- compatible: fsl,imx-iim
- reg: physical register base and size

Optional properties:

- barebox,provide-mac-address: Provide MAC addresses for ethernet devices. This
  can be multiple entries in the form <&phandle bankno fuseofs> to specify a MAC
  address to a ethernet device.

Example:

iim: iim@83f98000 {
	compatible = "fsl,imx51-iim", "fsl,imx-iim";
	reg = <0x83f98000 0x4000>;
	barebox,provide-mac-address = <&fec 1 9>;
};
```

## Documentation/devicetree/bindings/misc/fsl,imx-ocotp.txt
```
Freescale i.MX OCOTP (On-Chip OTP)

Required properties:

- compatible: fsl,imx6q-ocotp
- reg: physical register base and size

Optional properties:

- barebox,provide-mac-address: Provide MAC addresses for ethernet devices. This
  can be multiple entries in the form <&phandle regofs> to specify a MAC
  address to a ethernet device.

Example:

ocotp1: ocotp@021bc000 {
	compatible = "fsl,imx6q-ocotp";
	reg = <0x021bc000 0x4000>;
	barebox,provide-mac-address = <&fec 0x620>;
};
```

## Documentation/devicetree/bindings/mtd/partition.txt
```
Representing flash partitions in devicetree

In addition to the upstream binding, another property is added:

Optional properties:
- partuuid : The partition UUID for this partition.

Additionally, barebox also supports partitioning the eMMC boot partitions if
the partition table node is named appropriately:
- partitions : user partition
- boot0-partitions : boot0 partition
- boot1-partitions : boot1 partition

Examples:

flash@0 {
	partitions {
		compatible = "fixed-partitions";
		#address-cells = <1>;
		#size-cells = <1>;

		state_part: state {
			partuuid = "16367da7-c518-499f-9aad-e1f366692365";
		};
	};
};

emmc@1 {
	boot0-partitions {
		compatible = "fixed-partitions";
		#address-cells = <1>;
		#size-cells = <1>;

		barebox@0 {
			label = "barebox";
			reg = <0x0 0x300000>;
		};
	};
};
```

## Documentation/devicetree/bindings/nvmem/barebox,environment.yaml
```yaml
# SPDX-License-Identifier: GPL-2.0-only OR BSD-2-Clause
%YAML 1.2
---
$id: http://barebox.org/schemas/nvmem/barebox,environment.yaml#
$schema: http://devicetree.org/meta-schemas/core.yaml#

title: barebox environment variables

description: |
  barebox uses its environment to store non-volatile variables, scripts
  and arbitrary binary blobs.
  By default, the built-in environment compiled into barebox is used, but
  for development purposes, it's possible to override it at runtime.

  Variables can not yet be defined as NVMEM device subnodes.

maintainers:
  - Ahmad Fatoum <a.fatoum@pengutronix.de>

properties:
  compatible:
    const: barebox,environment

  reg:
    maxItems: 1

required:
  - compatible
  - label
  - reg

allOf:
  - $ref: partition.yaml#

additionalProperties: false

examples:
  - |
    partitions {
        compatible = "fixed-partitions";
        #address-cells = <1>;
        #size-cells = <1>;

        partition@0 {
            reg = <0x0 0x100000>;
            label = "barebox";
            read-only;
        };

        partition@100000 {
            compatible = "barebox,environment";
            label = "env";
            reg = <0x100000 0x10000>;
        };
    };
```

## Documentation/devicetree/bindings/nvmem/barebox,tlv.yaml
```yaml
# SPDX-License-Identifier: GPL-2.0-only OR BSD-2-Clause
%YAML 1.2
---
$id: http://barebox.org/schemas/nvmem/barebox,tlv.yaml#
$schema: http://devicetree.org/meta-schemas/core.yaml#

title: barebox TLV factory data

description: |
  barebox TLV is a scheme for storing factory data on non-volatile
  storage. Unlike state, it's meant to be read-only and if content
  is limited to already specified tags, it can be extended later on,
  without modifying the bootloader binary.

  Variables can not yet be defined as NVMEM device subnodes.

maintainers:
  - Ahmad Fatoum <a.fatoum@pengutronix.de>

properties:
  compatible:
    items:
      - enum:
        - barebox,tlv-v1        # magic: 0x61bb95f2
        - lxa,tlv-baseboard-v1  # magic: 0xbc288dfe
        - lxa,tlv-powerboard-v1 # magic: 0xdca5a870
      - const: barebox,tlv

  reg:
    maxItems: 1

required:
  - compatible
  - label
  - reg

allOf:
  - $ref: partition.yaml#

additionalProperties: false

examples:
  - |
    partitions {
        compatible = "fixed-partitions";
        #address-cells = <1>;
        #size-cells = <1>;

        partition@0 {
            reg = <0x0 0x100000>;
            label = "barebox";
            read-only;
        };

        partition@100000 {
            compatible = "barebox,tlv";
            label = "tlv";
            reg = <0x100000 0x10000>;
        };
    };
```

## Kconfig
```kconfig
# SPDX-License-Identifier: GPL-2.0-only

#
# For a description of the syntax of this configuration file,
# see Documentation/kbuild/kconfig-language.txt.
#
mainmenu "Barebox/$(ARCH) $(KERNELVERSION) Configuration"

source "scripts/Kconfig.include"

source "arch/Kconfig"

source "common/Kconfig"
source "efi/Kconfig"
source "commands/Kconfig"
source "net/Kconfig"
source "drivers/Kconfig"
source "fs/Kconfig"
source "lib/Kconfig"
source "crypto/Kconfig"
source "firmware/Kconfig"
source "scripts/Kconfig"
source "test/Kconfig"
```

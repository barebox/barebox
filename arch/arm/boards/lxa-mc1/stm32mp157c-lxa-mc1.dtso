// SPDX-License-Identifier: (GPL-2.0+ OR BSD-3-Clause)
/*
 * Copyright (C) 2020 Ahmad Fatoum, Pengutronix
 *
 * What barebox adds to the MC-1 device tree, by path, so it fits any of them.
 */

/dts-v1/;
/plugin/;

#include "stm32mp157c-lxa-mc1-symbols-paths.h"

/ {
	compatible = "lxa,stm32mp157c-mc1";
};

&{/chosen} {
	environment-sd {
		compatible = "barebox,environment";
		device-path = BASE_PATH(sdmmc1), "partname:barebox-environment";
		status = "disabled";
	};

	environment-emmc {
		compatible = "barebox,environment";
		device-path = BASE_PATH(sdmmc2), "partname:barebox-environment";
		status = "disabled";
	};
};

&{/} {
	aliases {
		state = "/state";
	};

	state {
		compatible = "barebox,state";
		magic = <0x778ec0f4>;
		/* backend is fixed up by board code */
		backend-type = "raw";
		backend-storage-type = "direct";
		backend-stridesize = <0x1000>;

		#include "bootstate.dtsi"
	};
};

BASE_NODE(panel) {
	display-timings {
		timing { /* edt,etm0700g0dh6 */
			clock-frequency = <33260000>;
			hactive = <800>;
			vactive = <480>;
			hfront-porch = <40>;
			hsync-len = <128>;
			hback-porch = <88>;
			vfront-porch = <10>;
			vsync-len = <2>;
			vback-porch = <33>;
			hsync-active = <0>;
			vsync-active = <0>;
			de-active = <1>;
			pixelclk-active = <0>;
		};
	};
};

/*
 * Copyright 2013 Christian Hemp, Phytec Messtechnik GmbH
 *
 * The code contained herein is licensed under the GNU General Public
 * License. You may obtain a copy of the GNU General Public License
 * Version 2 or later at the following locations:
 *
 * http://www.opensource.org/licenses/gpl-license.html
 * http://www.gnu.org/copyleft/gpl.html
 */

#include <arm/imx6qdl-phytec-pbab01.dtsi>

&uart1 {
	status = "okay";
};

#ifdef USE_STATE_EXAMPLE
#include "state-example.dtsi"
#endif

// SPDX-License-Identifier: (GPL-2.0+ OR MIT)
/* The barebox additions to a GX device tree, applied to any DT it boots with */

/dts-v1/;
/plugin/;

#include "meson-gx-symbols-paths.h"

/ {
	compatible = "amlogic,meson-gxbb", "amlogic,meson-gxl",
		     "amlogic,meson-gxlx", "amlogic,meson-gxm";
};

&{/chosen} {
	barebox,bootsource-mmc0 = BASE_PATH(sd_emmc_a);
	barebox,bootsource-mmc1 = BASE_PATH(sd_emmc_b);
	barebox,bootsource-mmc2 = BASE_PATH(sd_emmc_c);
};

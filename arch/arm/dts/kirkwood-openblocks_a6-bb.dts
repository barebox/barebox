/*
 * Barebox specific DT overlay for OpenBlocks A6 board
 */

#include "arm/marvell/kirkwood-openblocks_a6.dts"

/ {
	barebox,disable-deep-probe;
};

&{/gpio-leds/led-green} {
	barebox,default-trigger = "heartbeat";
};

## drivers/mfd/Kconfig
```kconfig
# SPDX-License-Identifier: GPL-2.0-only
menu "Multifunction device drivers"

config MFD_ACT8846
	depends on I2C
	bool "ACT8846 driver"

config MFD_DA9053
	depends on I2C
	bool "DA9053 PMIC driver"
	help
	  This power management controller provides configurable power supplies,
	  a machine restart feature and a watchdog.

config MFD_DA9063
	depends on I2C
	bool "DA9063/DA9062 PMIC driver"

config MFD_LP3972
	depends on I2C
	bool "LP3972 driver"

config MFD_MC13XXX
	depends on I2C || SPI
	bool "MC13XXX a.k.a. PMIC driver (MC13783, MC13892, MC34708)"

config MFD_MC34704
	depends on I2C
	bool "MC34704 PMIC driver"

config MFD_MC9SDZ60
	depends on I2C
	bool "MC9SDZ60 driver"

config MFD_STMPE
	depends on I2C
	bool "STMPE-i2c driver"

config MFD_SYSCON
	bool "System Controller Register"
	help
	  Select this option to enable accessing system control registers

config MFD_TWLCORE
	bool

config MFD_TWL4030
	depends on I2C
	select MFD_TWLCORE
	bool "TWL4030 driver"

config MFD_TWL6030
	depends on I2C
	select MFD_TWLCORE
	bool "TWL6030 driver"

config RAVE_SP_CORE
	tristate "RAVE SP MCU core driver"
	depends on SERIAL_DEV_BUS
	select CRC_CCITT
	help
	  Select this to get support for the Supervisory Processor
	  device found on several devices in RAVE line of hardware.

config MFD_STPMIC1
	depends on I2C
	select REGMAP_I2C
	bool "STPMIC1 MFD driver"
	help
	  Select this to support communication with the STPMIC1.

config MFD_PCA9450
	depends on I2C
	select REGMAP_I2C
	bool "PCA9450 MFD driver"
	help
	  Select this to support communication with the PCA9450 PMIC.

config MFD_RN568PMIC
	depends on I2C
	select REGMAP_I2C
	bool "Ricoh RN5T568 MFD driver"
	help
	  Select this to support communication with the Ricoh RN5T568 PMIC.

config MFD_SUPERIO
	bool

config FINTEK_SUPERIO
       bool "Fintek Super I/O chip"
       select MFD_SUPERIO
       depends on X86 || COMPILE_TEST
       help
         Select this to probe for IO-port connected Fintek Super I/O chips.

config SMSC_SUPERIO
       bool "SMSC Super I/O chip"
       select MFD_SUPERIO
       depends on X86 || COMPILE_TEST
       help
         Select this to probe for IO-port connected SMSC Super I/O chips.

config MFD_STM32_TIMERS
	bool "STM32 Timers"
	depends on ARCH_STM32 || COMPILE_TEST
	help
	  Select this to get regmap support for the timer blocks on STM32
	  MCUs and MPUs.

config MFD_ATMEL_FLEXCOM
	tristate "Atmel Flexcom (Flexible Serial Communication Unit)"
	depends on OFDEVICE
	help
	  Select this to get support for Atmel Flexcom. This is a wrapper
	  which embeds a SPI controller, a I2C controller and a USART. Only
	  one function can be used at a time. The choice is done at boot time
	  by the probe function of this MFD driver according to a device tree
	  property.

config MFD_RK808
	tristate "Rockchip RK805/RK808/RK809/RK817/RK818 Power Management Chip"
	depends on I2C && OFDEVICE
	select REGMAP_I2C
	help
	  If you say yes here you get support for the RK805, RK808, RK809,
	  RK817 and RK818 Power Management chips.
	  This driver provides common support for accessing the device
	  through I2C interface.

config MFD_AXP20X_I2C
	tristate "X-Powers AXP series PMICs with I2C"
	depends on I2C && OFDEVICE
	select REGMAP_I2C
	help
	  If you say Y here you get support for the X-Powers AXP series power
	  management ICs (PMICs) controlled with I2C.
	  This driver currently only provide a character device in /dev.

config MFD_ROHM_BD718XX
	tristate "ROHM BD71837 Power Management IC"
	depends on I2C=y
	depends on OFDEVICE
	select REGMAP_I2C
	help
	  Select this option to get support for the ROHM BD71837
	  Power Management ICs. BD71837 is designed to power processors like
	  NXP i.MX8. It contains 8 BUCK outputs and 7 LDOs, voltage monitoring
	  and emergency shut down as well as 32,768KHz clock output.

	  This driver currently only provide a character device in /dev.

config MFD_ATMEL_SMC
	bool
	select MFD_SYSCON

endmenu
```

## drivers/misc/Kconfig
```kconfig
# SPDX-License-Identifier: GPL-2.0-only
#
# Misc strange devices
#

menu "Misc devices"

config JTAG
	tristate "JTAG Bitbang driver"
	depends on GENERIC_GPIO
	help
	  Controls JTAG chains connected to I/O pins

config SRAM
	bool "Generic SRAM driver"
	help
	  This driver adds support for memory mapped SRAM.

config STATE_DRV
	tristate "state driver"
	depends on OFDEVICE
	depends on STATE

config DEV_MEM
        bool "Generic memory I/O device (/dev/mem)"

config DEV_PORT
	bool "Generic port I/O device (/dev/port)"
	depends on X86 || SANDBOX || COMPILE_TEST

config UBOOTVAR
	bool "U-Boot environment storage"
	depends on OFTREE
	help
	  This driver exposes U-Boot environment variable storage as a
	  single mmap-able device, hiding various low-level details
	  such as:
	      - Preamble format differences
	      - Read/write logic in presence of redundant partition

	  While it can be used standalone, it is best when coupled
	  with corresponding filesystem driver.

config STARFIVE_PWRSEQ
	bool "StarFive power sequencing driver"
	depends on SOC_STARFIVE
	help
	  This driver sets up a number of StarFive peripherals not matched
	  by more specific barebox drivers by deasserting reset lines, muxing
	  pins and/or enabling clocks. Peripherals set up by this can then
	  be accessed over /dev/mem or used from kernels which still depend
	  on bootloader for initialization.

config STORAGE_BY_ALIAS
	bool "storage by alias"
	depends on OFDEVICE
	help
	  This adds a driver which matches device tree nodes corresponding
	  to a barebox cdev aliases.

	  Following compatibles are supported:

	  - "barebox,storage-by-uuid"

	  Look for a storage device matching the given DISKUUID and when found
	  registers a new cdev for the device.

	  This driver solved a very specific problem. On EFI the storage devices
	  are not connected to any device tree node. barebox-state however expects
	  a node to use as its backend. The obvious solution would be to create
	  a partition with a specific partuuid and use that for state, in our
	  special usecase though the storage device is partitioned with a MBR
	  which doesn't have any space left to create a new partition. As this
	  driver parses the of partition binding we can use that to create
	  a partition in an unallocated are of the disk which is then used for
	  state.

	  This driver has the problem that it depends on storage devices which
	  are not described in the device tree. This means it cannot work with
	  deep probe. This is not a problem on EFI though. It's a special purpose
	  driver, it's not recommended for general use.

endmenu
```

## drivers/mtd/Kconfig
```kconfig
menuconfig MTD
	bool "Memory Technology Device (MTD) support"

if MTD

config MTD_WRITE
	bool
	default y
	prompt "Support writing to MTD devices"

config MTD_OOB_DEVICE
	bool
	select NAND_READ_OOB if NAND
	default y
	prompt "Create a device for reading the OOB data"

config MTD_RAW_DEVICE
	bool
	select NAND_READ_OOB if NAND
	default n
	prompt "mtdraw device to read/write both data+oob"

config MTD_CONCAT
	bool
	prompt "MTD concatenating support"
	help
	  Support for concatenating several MTD devices into a single
	  (virtual) one. This allows you to have -for example- a JFFS(2)
	  file system spanning multiple physical flash chips. This option
	  needs driver support, currently only the cfi-flash driver supports
	  concatenating MTD devices.

source "drivers/mtd/devices/Kconfig"
source "drivers/mtd/nor/Kconfig"
source "drivers/mtd/nand/Kconfig"
source "drivers/mtd/spi-nor/Kconfig"
source "drivers/mtd/ubi/Kconfig"

endif
```

## drivers/mtd/devices/Kconfig
```kconfig
menu "Self contained MTD devices"
	depends on MTD!=n

config MTD_DATAFLASH
	tristate "Support for AT45xxx DataFlash"
	depends on SPI
	help
	  This enables access to AT45xxx DataFlash chips, using SPI.
	  Sometimes DataFlash chips are packaged inside MMC-format
	  cards; at this writing, the MMC stack won't handle those.

config MTD_DATAFLASH_WRITE_VERIFY
	bool "Verify DataFlash page writes"
	depends on MTD_DATAFLASH
	help
	  This adds an extra check when data is written to the flash.
	  It may help if you are verifying chip setup (timings etc) on
	  your board. There is a rare possibility that even though the
	  device thinks the write was successful, a bit could have been
	  flipped accidentally due to device wear or something else.

config MTD_M25P80
	tristate "Support most SPI Flash chips (AT26DF, M25P, W25X, ...)"
	depends on SPI
	help
	  This enables access to most modern SPI flash chips, used for
	  program and data storage. Series supported include Atmel AT26DF,
	  Spansion S25SL, SST 25VF, ST M25P, and Winbond W25X. Other chips
	  are supported as well. See the driver source for the current list,
	  or to add other chips.

	  Note that the original DataFlash chips (AT45 series, not AT26DF),
	  need an entirely different driver.

	  Set up your spi devices with the right board-specific platform data,
	  if you want to specify device partitioning or to use a device which
	  doesn't support the JEDEC ID instruction.

config MTD_SST25L
	tristate "Support SST25L (non JEDEC) SPI Flash chips"
	depends on MTD_M25P80
	help
	  This enables access to the non JEDEC SST25L SPI flash chips, used
	  for program and data storage.

	  Set up your spi devices with the right board-specific platform data,
	  if you want to specify device partitioning.

config MTD_DOCG3
	bool "M-Systems Disk-On-Chip G3"
	select BCH
	select BITREV
	---help---
	  This provides an MTD device driver for the M-Systems DiskOnChip
	  G3 devices.

	  The driver provides access to G3 DiskOnChip, distributed by
	  M-Systems and now Sandisk. The support is very experimental,
	  and doesn't give access to any write operations.

endmenu
```

## drivers/mtd/nand/Kconfig
```kconfig
# SPDX-License-Identifier: GPL-2.0-only

config MTD_NAND_CORE
	bool

menuconfig NAND
	bool "NAND support"
	help
	  This enables support for accessing all type of NAND flash
	  devices. For further information see
	  <http://www.linux-mtd.infradead.org/doc/nand.html>.

if NAND

source "drivers/mtd/nand/raw/Kconfig"

endif
```

## drivers/mtd/nor/Kconfig
```kconfig
menuconfig DRIVER_CFI
	bool "CFI NOR flash support"
	help
	  If you have NOR Flash devices connected to your system and wish
	  to use them say yes here.

if DRIVER_CFI

config DRIVER_CFI_INTEL
	default y
	bool "Support Intel flash chips"

config DRIVER_CFI_AMD
	default y
	bool "support AMD flash chips"

config DRIVER_CFI_BANK_WIDTH_1
	bool "Support 8-bit buswidth"
	default y
	help
	  If you wish to support CFI devices on a physical bus which is
	  8 bits wide, say 'Y'.

config DRIVER_CFI_BANK_WIDTH_2
	bool "Support 16-bit buswidth"
	default y
	help
	  If you wish to support CFI devices on a physical bus which is
	  16 bits wide, say 'Y'.

config DRIVER_CFI_BANK_WIDTH_4
	bool "Support 32-bit buswidth"
	default y
	help
	  If you wish to support CFI devices on a physical bus which is
	  32 bits wide, say 'Y'.

config DRIVER_CFI_BANK_WIDTH_8
	bool "Support 64-bit buswidth"
	help
	  If you wish to support CFI devices on a physical bus which is
	  64 bits wide, say 'Y'.

config CFI_BUFFER_WRITE
	bool "use cfi driver with buffer write"

endif
```

## drivers/mtd/spi-nor/Kconfig
```kconfig
menuconfig MTD_SPI_NOR
	tristate "SPI-NOR device support"
	depends on MTD
	help
	  This is the framework for the SPI NOR which can be used by the SPI
	  device drivers and the SPI-NOR device driver.

if MTD_SPI_NOR

config MTD_SPI_NOR_USE_4K_SECTORS
	bool "Use small 4096 B erase sectors"
	help
	  Many flash memories support erasing small (4096 B) sectors. Depending
	  on the usage this feature may provide performance gain in comparison
	  to erasing whole blocks (32/64 KiB).
	  Changing a small part of the flash's contents is usually faster with
	  small sectors. On the other hand erasing should be faster when using
	  64 KiB block instead of 16 × 4 KiB sectors.

	  Please note that some tools/drivers/filesystems may not work with
	  4096 B erase size (e.g. UBIFS requires 15 KiB as a minimum).

config SPI_CADENCE_QUADSPI
	tristate "Cadence Quad SPI controller"
	help
	  This enables support for the Cadence Quad SPI controller and NOR flash.

endif
```

## drivers/mtd/ubi/Kconfig
```kconfig
config UBI
	bool "UBI support               "
	select PARTITION_NEED_MTD
	select CRC32
	help
	  This enables support for UBI (unsorted block images)
```

## drivers/mux/Kconfig
```kconfig
# SPDX-License-Identifier: GPL-2.0
#
# Multiplexer devices
#

config MULTIPLEXER
	tristate
	prompt "Multiplexer driver support" if COMPILE_TEST

menu "Multiplexer drivers"
	depends on MULTIPLEXER

config MUX_GPIO
	tristate "GPIO-controlled Multiplexer"
	depends on GPIOLIB || COMPILE_TEST
	help
	  GPIO-controlled Multiplexer controller.

	  The driver builds a single multiplexer controller using a number
	  of gpio pins. For N pins, there will be 2^N possible multiplexer
	  states. The GPIO pins can be connected (by the hardware) to several
	  multiplexers.

	  The barebox driver doesn't implement Linux' fastpath, which enables
	  atomically switching GPIOs in the same bank where possible.
	  This means that board code authors need to ensure that intermediate
	  states when switching some of the GPIOs don't break anything.

endmenu
```

## drivers/nand/Kconfig
```kconfig
menuconfig NAND
	bool "NAND support                  "

if NAND

config NAND_IMX
	bool
	prompt "i.MX NAND driver"
	depends on ARCH_IMX27

config NAND_IMX_BOOT
	bool
	prompt "Support Starting U-Boot from NAND"
	depends on NAND_IMX

endif
```

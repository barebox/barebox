/*
 * Barebox specific DT overlay for Lenovo Iomega ix4-300d
 *   Sebastian Hesselbarth <sebastian.hesselbarth@gmail.com>
 */

#include "arm/marvell/armada-xp-lenovo-ix4-300d.dts"

/ {
	barebox,disable-deep-probe;
};

&{/gpio-leds/power-led} {
	linux,default-trigger = "heartbeat";
};

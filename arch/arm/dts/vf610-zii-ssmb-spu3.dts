// SPDX-License-Identifier: (GPL-2.0 OR MIT)

#include <arm/vf610-zii-ssmb-spu3.dts>

#include "vf610-zii-dev.dtsi"

/ {
	aliases {
		/*
		* NVMEM device corresponding to EEPROM attached to
		* the switch shared DT node with it, so we use that
		* fact to create a desirable naming
		*/
		switch-eeprom = &switch0;
	};
};

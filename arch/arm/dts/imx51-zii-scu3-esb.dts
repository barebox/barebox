// SPDX-License-Identifier: (GPL-2.0 OR MIT)

/*
 * Copyright (C) 2018 Zodiac Inflight Innovations
 */


#include <arm/nxp/imx/imx51-zii-scu3-esb.dts>

/ {
	barebox,disable-deep-probe;
};

&iim {
	barebox,provide-mac-address = <&fec 1 9>;
};

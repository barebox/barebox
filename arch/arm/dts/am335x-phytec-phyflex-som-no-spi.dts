/*
 * Copyright (C) 2015 PHYTEC Messtechnik GmbH
 * Author: Wadim Egorov <w.egorov@phytec.de>
 * 	   Teresa Remmet <t.remmet@phytec.de>
 *
 * This program is free software; you can redistribute it and/or modify
 * it under the terms of the GNU General Public License version 2 as
 * published by the Free Software Foundation.
 */
/dts-v1/;

#include "am33xx.dtsi"
#include "am335x-phytec-phyflex-som.dtsi"

/ {
	model = "Phytec phyFLEX AM335x";
	compatible = "phytec,phyflex-am335x-som", "phytec,am335x-som", "ti,am33xx";
};

&at24c32 {
	status = "okay";
};

/*
 * Barebox specific DT overlay for Globalscale Guruplug
 *   Sebastian Hesselbarth <sebastian.hesselbarth@gmail.com>
 */

#include "arm/marvell/kirkwood-guruplug-server-plus.dts"

/ {
	barebox,disable-deep-probe;
};

&{/gpio-leds/led-health-r} {
	barebox,default-trigger = "heartbeat";
};

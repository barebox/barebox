/*
 * Copyright 2013 Russell King
 *
 * The code contained herein is licensed under the GNU General Public
 * License version 2.
 */
#include <arm/imx6qdl-microsom.dtsi>

&usbotg {
	phy_type = "utmi";
};

&usbh1 {
	phy_type = "utmi";
	dr_mode = "host";
};

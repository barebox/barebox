// SPDX-License-Identifier: GPL-2.0-or-later OR X11
// SPDX-FileCopyrightText: 2023 John Watts <contact@jookia.org>

#include <arm/nxp/imx/imx6q-novena.dts>

/ {
	barebox,deep-probe;

	aliases {
		eeprom0 = &eeprom;
	};
};

&i2c3 {
	eeprom: eeprom@56 {
		compatible = "24c512";
		reg = <0x56>;
		pagesize = <128>;
	};
};

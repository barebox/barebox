// SPDX-License-Identifier: GPL-2.0-or-later OR MIT

#include "imx6qdl-prti6q-emmc.dtsi"

&ecspi1 {
	flash@0 {
		#address-cells = <1>;
		#size-cells = <1>;

		partition@0 {
			label = "barebox";
			reg = <0x0 0x100000>;
		};
	};
};

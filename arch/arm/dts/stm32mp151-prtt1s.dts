// SPDX-License-Identifier: (GPL-2.0-or-later OR BSD-3-Clause)
// SPDX-FileCopyrightText: 2021 David Jander, Protonic Holland
// SPDX-FileCopyrightText: 2021 Oleksij Rempel, Pengutronix
/dts-v1/;

#include "stm32mp151-prtt1l.dtsi"
#include "stm32mp151-prtt1l-net.dtsi"

/ {
	model = "Protonic PRTT1S";
	compatible = "prt,prtt1s", "st,stm32mp151";
	barebox,deep-probe;

	chosen {
		environment-sd {
			compatible = "barebox,environment";
			device-path = &sdmmc1, "partname:barebox-environment";
			status = "disabled";
		};
	};
};

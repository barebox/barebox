## arch/arm/mach-davinci/Kconfig
```kconfig
if ARCH_DAVINCI

config ARCH_TEXT_BASE
	hex
	default 0x82000000

choice
	prompt "Davinci Board type"

config MACH_VIRT2REAL
	bool "Virt2Real"

endchoice

endif
```

## arch/arm/mach-digic/Kconfig
```kconfig
if ARCH_DIGIC

choice
	prompt "camera type"

config MACH_CANON_A1100
	bool "Canon PowerShot A1100 IS"

endchoice

config ARCH_TEXT_BASE
	hex
	default 0x00001900 if MACH_CANON_A1100

endif
```

## arch/arm/mach-ep93xx/Kconfig
```kconfig
if ARCH_EP93XX

config EP93XX_SDCE0_PHYS_OFFSET
	bool

config EP93XX_SDCE3_SYNC_PHYS_OFFSET
	bool

comment "Cirrus EP93xx System-on-Chip"

choice
	prompt "Cirrus Logic EP93XX Processor"

config ARCH_EP9301
	bool "EP9301"

config ARCH_EP9302
	bool "EP9302"

config ARCH_EP9307
	bool "EP9307"

config ARCH_EP9312
	bool "EP9312"

config ARCH_EP9315
	bool "EP9315"

endchoice

# ----------------------------------------------------------

if ARCH_EP9301

choice
	prompt "EP9301 Board Type"

config MACH_EDB9301
	bool "Cirrus Logic EDB9301"
	select EP93XX_SDCE3_SYNC_PHYS_OFFSET
	help
	  Say y here if you are using Cirrus Logic's EDB9301 Evaluation board

endchoice

if MACH_EDB9301

config ARCH_TEXT_BASE
	hex
	default 0x05700000

config EP93XX_SDRAM_NUM_BANKS
	int
	default 4

config EP93XX_SDRAM_BANK0_BASE
	hex
	default 0x00000000

config EP93XX_SDRAM_BANK0_SIZE
	hex
	default 0x00800000

config EP93XX_SDRAM_BANK1_BASE
	hex
	default 0x01000000

config EP93XX_SDRAM_BANK1_SIZE
	hex
	default 0x00800000

config EP93XX_SDRAM_BANK2_BASE
	hex
	default 0x04000000

config EP93XX_SDRAM_BANK2_SIZE
	hex
	default 0x00800000

config EP93XX_SDRAM_BANK3_BASE
	hex
	default 0x05000000

config EP93XX_SDRAM_BANK3_SIZE
	hex
	default 0x00800000

endif

endif

# ----------------------------------------------------------

if ARCH_EP9302

choice
	prompt "EP9302 Board Type"

config MACH_EDB9302
	bool "Cirrus Logic EDB9302"
	select EP93XX_SDCE3_SYNC_PHYS_OFFSET
	help
	  Say y here if you are using Cirrus Logic's EDB9302 Evaluation board

config MACH_EDB9302A
	bool "Cirrus Logic EDB9302A"
	select EP93XX_SDCE0_PHYS_OFFSET
	help
	  Say y here if you are using Cirrus Logic's EDB9302A Evaluation board

endchoice

if MACH_EDB9302

config ARCH_TEXT_BASE
	hex
	default 0x05700000

config EP93XX_SDRAM_NUM_BANKS
	int
	default 4

config EP93XX_SDRAM_BANK0_BASE
	hex
	default 0x00000000

config EP93XX_SDRAM_BANK0_SIZE
	hex
	default 0x00800000

config EP93XX_SDRAM_BANK1_BASE
	hex
	default 0x01000000

config EP93XX_SDRAM_BANK1_SIZE
	hex
	default 0x00800000

config EP93XX_SDRAM_BANK2_BASE
	hex
	default 0x04000000

config EP93XX_SDRAM_BANK2_SIZE
	hex
	default 0x00800000

config EP93XX_SDRAM_BANK3_BASE
	hex
	default 0x05000000

config EP93XX_SDRAM_BANK3_SIZE
	hex
	default 0x00800000

endif

if MACH_EDB9302A

config ARCH_TEXT_BASE
	hex
	default 0xc5700000

config EP93XX_SDRAM_NUM_BANKS
	int
	default 4

config EP93XX_SDRAM_BANK0_BASE
	hex
	default 0xc0000000

config EP93XX_SDRAM_BANK0_SIZE
	hex
	default 0x00800000

config EP93XX_SDRAM_BANK1_BASE
	hex
	default 0xc1000000

config EP93XX_SDRAM_BANK1_SIZE
	hex
	default 0x00800000

config EP93XX_SDRAM_BANK2_BASE
	hex
	default 0xc4000000

config EP93XX_SDRAM_BANK2_SIZE
	hex
	default 0x00800000

config EP93XX_SDRAM_BANK3_BASE
	hex
	default 0xc5000000

config EP93XX_SDRAM_BANK3_SIZE
	hex
	default 0x00800000

endif

endif

# ----------------------------------------------------------

if ARCH_EP9307

choice
	prompt "EP9307 Board Type"

config MACH_EDB9307
	bool "Cirrus Logic EDB9307"
	select EP93XX_SDCE3_SYNC_PHYS_OFFSET
	help
	  Say y here if you are using Cirrus Logic's EDB9307 Evaluation board

config MACH_EDB9307A
	bool "Cirrus Logic EDB9307A"
	select EP93XX_SDCE0_PHYS_OFFSET
	help
	  Say y here if you are using Cirrus Logic's EDB9307A Evaluation board

endchoice

if MACH_EDB9307

config ARCH_TEXT_BASE
	hex
	default 0x01f00000

config EP93XX_SDRAM_NUM_BANKS
	int
	default 2

config EP93XX_SDRAM_BANK0_BASE
	hex
	default 0x00000000

config EP93XX_SDRAM_BANK0_SIZE
	hex
	default 0x02000000

config EP93XX_SDRAM_BANK1_BASE
	hex
	default 0x04000000

config EP93XX_SDRAM_BANK1_SIZE
	hex
	default 0x02000000

endif

if MACH_EDB9307A

config ARCH_TEXT_BASE
	hex
	default 0xc1f00000

config EP93XX_SDRAM_NUM_BANKS
	int
	default 2

config EP93XX_SDRAM_BANK0_BASE
	hex
	default 0xc0000000

config EP93XX_SDRAM_BANK0_SIZE
	hex
	default 0x02000000

config EP93XX_SDRAM_BANK1_BASE
	hex
	default 0xc4000000

config EP93XX_SDRAM_BANK1_SIZE
	hex
	default 0x02000000

endif

endif

# ----------------------------------------------------------

if ARCH_EP9312

choice
	prompt "EP9312 Board Type"

config MACH_EDB9312
	bool "Cirrus Logic EDB9312"
	select EP93XX_SDCE3_SYNC_PHYS_OFFSET
	help
	  Say y here if you are using Cirrus Logic's EDB9312 Evaluation board

endchoice

if MACH_EDB9312

config ARCH_TEXT_BASE
	hex
	default 0x01f00000

config EP93XX_SDRAM_NUM_BANKS
	int
	default 2

config EP93XX_SDRAM_BANK0_BASE
	hex
	default 0x00000000

config EP93XX_SDRAM_BANK0_SIZE
	hex
	default 0x02000000

config EP93XX_SDRAM_BANK1_BASE
	hex
	default 0x04000000

config EP93XX_SDRAM_BANK1_SIZE
	hex
	default 0x02000000

endif

endif

# ----------------------------------------------------------

if ARCH_EP9315

choice
	prompt "EP9315 Board Type"

config MACH_EDB9315
	bool "Cirrus Logic EDB9315"
	select EP93XX_SDCE3_SYNC_PHYS_OFFSET
	help
	  Say y here if you are using Cirrus Logic's EDB9315 Evaluation board

config MACH_EDB9315A
	bool "Cirrus Logic EDB9315A"
	select EP93XX_SDCE0_PHYS_OFFSET
	help
	  Say y here if you are using Cirrus Logic's EDB9315A Evaluation board

endchoice

if MACH_EDB9315

config ARCH_TEXT_BASE
	hex
	default 0x01f00000

config EP93XX_SDRAM_NUM_BANKS
	int
	default 2

config EP93XX_SDRAM_BANK0_BASE
	hex
	default 0x00000000

config EP93XX_SDRAM_BANK0_SIZE
	hex
	default 0x02000000

config EP93XX_SDRAM_BANK1_BASE
	hex
	default 0x04000000

config EP93XX_SDRAM_BANK1_SIZE
	hex
	default 0x02000000

endif

if MACH_EDB9315A

config ARCH_TEXT_BASE
	hex
	default 0xc1f00000

config EP93XX_SDRAM_NUM_BANKS
	int
	default 2

config EP93XX_SDRAM_BANK0_BASE
	hex
	default 0xc0000000

config EP93XX_SDRAM_BANK0_SIZE
	hex
	default 0x02000000

config EP93XX_SDRAM_BANK1_BASE
	hex
	default 0xc4000000

config EP93XX_SDRAM_BANK1_SIZE
	hex
	default 0x02000000

endif

endif

endif
```

## arch/arm/mach-highbank/Kconfig
```kconfig
if ARCH_HIGHBANK

config ARCH_TEXT_BASE
	hex
	default 0x03f00000

choice
	prompt "Calxeda Board type"

config MACH_HIGHBANK
	bool "Calxeda Highbank"
	select OFTREE

endchoice

endif
```

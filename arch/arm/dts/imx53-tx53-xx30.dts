/dts-v1/;
#include <arm/nxp/imx/imx53-tx53.dtsi>

/ {
	model = "Ka-Ro electronics TX53 module";
	compatible = "karo,tx53-xx30", "karo,tx53", "fsl,imx53";
	barebox,disable-deep-probe;

	chosen {
		stdout-path = &uart1;
	};

	sgtl5000: dummy { };
};

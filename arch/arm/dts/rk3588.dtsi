// SPDX-License-Identifier: (GPL-2.0+ OR MIT)

/ {
	dmc: memory-controller {
		compatible = "rockchip,rk3588-dmc";
		rockchip,pmu = <&pmu1grf>;
	};
};

&scmi_clk {
	assigned-clocks =
		<&scmi_clk SCMI_CLK_CPUL>,
		<&scmi_clk SCMI_CLK_CPUB01>,
		<&scmi_clk SCMI_CLK_CPUB23>;
	assigned-clock-rates =
		<1200000000>,
		<1200000000>,
		<1200000000>;
};

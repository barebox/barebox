// SPDX-License-Identifier: GPL-2.0
/*
 * Copyright 2017 NXP
 * Copyright (C) 2017 Pengutronix, Lucas Stach <kernel@pengutronix.de>
 */

/ {
	chosen {
		barebox,bootsource-mmc0 = &usdhc1;
		barebox,bootsource-mmc1 = &usdhc2;
	};

	remoteproc_cm4: remoteproc-cm4 {
		compatible = "fsl,imx8mq-cm4";
		clocks = <&clk IMX8MQ_CLK_M4_CORE>;
		syscon = <&src>;
	};
};

&clk {
	assigned-clocks = <&clk IMX8MQ_CLK_USDHC1>,
			  <&clk IMX8MQ_CLK_USDHC2>,
			  <&clk IMX8MQ_CLK_ENET_AXI>,
			  <&clk IMX8MQ_CLK_ENET_TIMER>,
			  <&clk IMX8MQ_CLK_ENET_REF>,
			  <&clk IMX8MQ_ARM_PLL>,
			  <&clk IMX8MQ_CLK_A53_DIV>;

	assigned-clock-parents =  <&clk IMX8MQ_SYS1_PLL_400M>,
				  <&clk IMX8MQ_SYS1_PLL_400M>,
				  <&clk IMX8MQ_SYS1_PLL_266M>,
				  <&clk IMX8MQ_SYS2_PLL_100M>,
				  <&clk IMX8MQ_SYS2_PLL_125M>;

	assigned-clock-rates = <200000000>,
			       <200000000>,
			       <266000000>,
			       <25000000>,
			       <125000000>,
			       <800000000>,
			       <800000000>;
};

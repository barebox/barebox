// SPDX-License-Identifier: GPL-2.0+
/*
 * dts file for Xilinx ZynqMP ZCU106
 *
 * Copyright (C) 2021, WolfVision GmbH
 * Author: Michael Riesch <michael.riesch@wolfvision.net>
 *
 * Based on the dts for the Xilinx ZynqMP ZCU104.
 */

#include <arm64/xilinx/zynqmp-zcu106-revA.dts>

/ {
	barebox,disable-deep-probe;

	chosen {
		environment {
			compatible = "barebox,environment";
			device-path = &sdhci1, "partname:0";
			file-path = "barebox.env";
		};
	};
};

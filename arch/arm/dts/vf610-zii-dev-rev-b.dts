// SPDX-License-Identifier: (GPL-2.0+ OR MIT)

/*
 * Copyright (C) 2015, 2016 Zodiac Inflight Innovations
 */

#include <arm/nxp/vf/vf610-zii-dev-rev-b.dts>

#include "vf610-zii-dev.dtsi"

/ {
	barebox,disable-deep-probe;
};

&{/spi-0/flash@0} {
	#address-cells = <1>;
	#size-cells = <0>;

	partition@0 {
		label = "bootloader";
		reg = <0x0 0x100000>;
	};
};

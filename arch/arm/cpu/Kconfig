## arch/arm/mach-imx/Kconfig
```kconfig
if ARCH_IMX

config ARCH_TEXT_BASE
	hex
	default 0x83f00000 if MACH_EUKREA_CPUIMX25
	default 0xa0000000 if MACH_EUKREA_CPUIMX27
	default 0x87f00000 if MACH_EUKREA_CPUIMX35
	default 0x97f00000 if MACH_EUKREA_CPUIMX51SD
	default 0xc0000000 if MACH_IMX21ADS
	default 0xa0000000 if MACH_IMX27ADS
	default 0x83f00000 if MACH_FREESCALE_MX25_3STACK && FREESCALE_MX25_3STACK_SDRAM_64MB_DDR2
	default 0x87f00000 if MACH_FREESCALE_MX25_3STACK && FREESCALE_MX25_3STACK_SDRAM_128MB_MDDR
	default 0x87f00000 if MACH_FREESCALE_MX35_3STACK
	default 0xa7f00000 if MACH_PCA100
	default 0xa0000000 if MACH_PCM038
	default 0x87f00000 if MACH_PCM037
	default 0x87f00000 if MACH_MX31MOBOARD
	default 0x87f00000 if MACH_PCM043
	default 0xa7e00000 if MACH_NESO
	default 0x97f00000 if MACH_FREESCALE_MX51_PDK
	default 0x7ff00000 if MACH_FREESCALE_MX53_LOCO
	default 0x7ff00000 if MACH_FREESCALE_MX53_SMD
	default 0x7ff00000 if MACH_FREESCALE_MX53_VMX53
	default 0x87f00000 if MACH_GUF_CUPID
	default 0x93d00000 if MACH_TX25
	default 0x7ff00000 if MACH_TQMA53
	default 0x97f00000 if MACH_TX51
	default 0x4fc00000 if MACH_SABRELITE
	default 0x8fe00000 if MACH_TX53
	default 0x97f00000 if MACH_EFIKA_MX_SMARTBOOK
	default 0x17800000 if MACH_SABRESD
	default 0x4fc00000 if MACH_REALQ7
	default 0x4fc00000 if MACH_GK802
	default 0x87f00000 if MACH_KINDLE3
	default 0x2fc00000 if MACH_TQMA6X
	default 0x4fc00000 if MACH_DFI_FS700_M60
	default 0x4fc00000 if MACH_UDOO
	default 0x4fc00000 if MACH_VARISCITE_MX6
	default 0x4fc00000 if MACH_PHYTEC_SOM_IMX6
	default 0x9fc00000 if MACH_WARP7

config ARCH_IMX_IMXIMAGE
	bool
	default y
	help
	  if enabled the imx-image tool is compiled

config ARCH_IMX_IMXIMAGE_SSL_SUPPORT
	bool
	help
	  This enables SSL support for the imx-image tool. This is required
	  for created images for HABv3. This adds openssl to the build dependencies

config ARCH_IMX_EXTERNAL_BOOT_NAND
	bool
	depends on ARCH_IMX25 || ARCH_IMX27 || ARCH_IMX31 || ARCH_IMX35
	prompt "Support Starting barebox from NAND in external bootmode"

config BAREBOX_UPDATE_IMX_EXTERNAL_NAND
	bool
	depends on ARCH_IMX_EXTERNAL_BOOT_NAND
	depends on BAREBOX_UPDATE
	depends on MTD
	depends on MTD_WRITE
	default y

config RESET_IMX_SRC
	def_bool y
	depends on ARCH_IMX6 || ARCH_IMX50 || ARCH_IMX51 || ARCH_IMX53

#
# PMIC configuration found on i.MX51 Babbadge board
#
config MACH_FREESCALE_MX51_PDK_POWER
        bool
	select SPI
	select DRIVER_SPI_IMX
	select MFD_MC13XXX

comment "Freescale i.MX System-on-Chip"

config ARCH_IMX1
	bool
	select CPU_ARM920T
	select ARCH_HAS_IMX_GPT
	select PINCTRL_IMX_IOMUX_V1

config ARCH_IMX21
	bool
	select CPU_ARM926T
	select ARCH_HAS_IMX_GPT
	select PINCTRL_IMX_IOMUX_V1

config ARCH_IMX25
	bool
	select CPU_ARM926T
	select ARCH_HAS_FEC_IMX
	select ARCH_HAS_IMX_GPT
	select PINCTRL_IMX_IOMUX_V3

config ARCH_IMX27
	bool
	select CPU_ARM926T
	select ARCH_HAS_FEC_IMX
	select ARCH_HAS_IMX_GPT
	select PINCTRL_IMX_IOMUX_V1

config ARCH_IMX31
	select CPU_V6
	bool
	select ARCH_HAS_IMX_GPT
	select PINCTRL_IMX_IOMUX_V2

config ARCH_IMX35
	bool
	select CPU_V6
	select ARCH_HAS_FEC_IMX
	select ARCH_HAS_IMX_GPT
	select PINCTRL_IMX_IOMUX_V3

config ARCH_IMX50
	bool
	select CPU_V7
	select ARCH_HAS_FEC_IMX
	select ARCH_HAS_IMX_GPT
	select PINCTRL_IMX_IOMUX_V3

config ARCH_IMX51
	bool
	select CPU_V7
	select ARCH_HAS_FEC_IMX
	select ARCH_HAS_IMX_GPT
	select PINCTRL_IMX_IOMUX_V3

config ARCH_IMX53
	bool
	select CPU_V7
	select ARCH_HAS_FEC_IMX
	select ARCH_HAS_IMX_GPT
	select PINCTRL_IMX_IOMUX_V3

config ARCH_IMX6
	bool
	select ARCH_HAS_L2X0
	select ARCH_HAS_FEC_IMX
	select ARCH_HAS_IMX_GPT
	select CPU_V7
	select PINCTRL_IMX_IOMUX_V3
	select OFTREE
	select COMMON_CLK_OF_PROVIDER
	select HW_HAS_PCI

config ARCH_IMX6SL
	bool
	select ARCH_IMX6

config ARCH_IMX6SX
	bool
	select ARCH_IMX6
	select OFTREE
	select COMMON_CLK_OF_PROVIDER

config ARCH_IMX6UL
	bool
	select ARCH_IMX6

config ARCH_IMX7
	bool
	select CPU_V7
	select PINCTRL_IMX_IOMUX_V3
	select OFTREE
	select COMMON_CLK_OF_PROVIDER
	select ARCH_HAS_FEC_IMX
	select ARCH_HAS_IMX_GPT
	select HW_HAS_PCI

config ARCH_IMX8MQ
	bool
	select CPU_V8
	select PINCTRL_IMX_IOMUX_V3
	select OFTREE
	select SYS_SUPPORTS_64BIT_KERNEL
	select COMMON_CLK_OF_PROVIDER
	select ARCH_HAS_FEC_IMX
	select HW_HAS_PCI
	select PBL_VERIFY_PIGGY if HABV4

config ARCH_VF610
	bool
	select ARCH_HAS_L2X0
	select ARCH_HAS_FEC_IMX
	select CPU_V7
	select PINCTRL
	select OFDEVICE
	select OFTREE
	select COMMON_CLK
	select COMMON_CLK_OF_PROVIDER
	select NVMEM
	select IMX_OCOTP	# Needed for clock adjustement
	select CLOCKSOURCE_ARM_GLOBAL_TIMER

config IMX_MULTI_BOARDS
	bool "Allow multiple boards to be selected"
	select HAVE_PBL_MULTI_IMAGES

if IMX_MULTI_BOARDS

config MACH_SCB9328
	bool "Synertronixx scb9328"
	select ARCH_IMX1
	select HAS_DM9000
	help
	  Say Y here if you are using the Synertronixx scb9328 board

config MACH_TX25
	bool "Ka-Ro TX25"
	select ARCH_IMX25
	select ARCH_IMX_EXTERNAL_BOOT_NAND
	help
	  Say Y here if you are using the Ka-Ro tx25 board

config MACH_PCA100
	bool "phyCard-i.MX27"
	select ARCH_IMX27
	select ARCH_IMX_EXTERNAL_BOOT_NAND
	help
	  Say Y here if you are using Phytec's phyCard-i.MX27 (pca100) equipped
	  with a Freescale i.MX27 Processor

config MACH_PCM038
	bool "phyCORE-i.MX27"
	select ARCH_IMX27
	select SPI
	select DRIVER_SPI_IMX
	select MFD_MC13XXX
	select ARCH_IMX_EXTERNAL_BOOT_NAND
	help
	  Say Y here if you are using Phytec's phyCORE-i.MX27 (pcm038) equipped
	  with a Freescale i.MX27 Processor

config MACH_KINDLE_MX50
	bool "i.MX50 based Amazon Kindle 4 and 5"
	select ARCH_IMX50
	select SPI
	select DRIVER_SPI_IMX
	select I2C
	select I2C_IMX
	select MFD_MC13XXX
	select ARM_BOARD_APPEND_ATAG
	select ARM_LINUX
	select OFTREE
	help
	  Say Y here if you are using the fourth or fifth generation Amazon
	  Kindle Model No. D01100 (Kindle Wi-Fi), D01200 (Kindle Touch) or
	  EY21 (Kindle Paperwhite).

config MACH_CCMX51
	bool "ConnectCore i.MX51"
	select ARCH_IMX51
	select IMX_IIM
	select SPI
	select DRIVER_SPI_IMX
	select MFD_MC13XXX
	select RELOCATABLE
	help
	  Say Y here if you are using Digi ConnectCore (W)i-i.MX51
	  equipped with a Freescale i.MX51 Processor

config MACH_EFIKA_MX_SMARTBOOK
	bool "Efika MX smartbook"
	select ARCH_IMX51
	select SPI
	select DRIVER_SPI_IMX
	select MFD_MC13XXX
	help
	  Choose this to compile barebox for the Efika MX Smartbook

config MACH_EMBEDSKY_E9
	bool "Embedsky E9 Mini-PC"
	select ARCH_IMX6
	help
	  Choose this to compile barebox for the Embedsky E9 Mini PC

config MACH_FREESCALE_MX51_PDK
	bool "Freescale i.MX51 PDK"
	select ARCH_IMX51
	select MACH_FREESCALE_MX51_PDK_POWER

config MACH_CCMX53
	bool "Digi ConnectCore i.MX53"
	select ARCH_IMX53
	select I2C
	help
	  Say Y here if you are using the Digi ConnectCore ccxmx53
	  series SoM

config MACH_FREESCALE_MX53_LOCO
	bool "Freescale i.MX53 LOCO"
	select ARCH_IMX53
	select I2C
	select I2C_IMX
	select MFD_MC13XXX

config MACH_GUF_VINCELL
	bool "Garz-Fricke Vincell"
	select ARCH_IMX53

config MACH_TQMA53
	bool "TQ i.MX53 TQMa53"
	select ARCH_IMX53

config MACH_FREESCALE_MX53_VMX53
	bool "Voipac i.MX53"
	select ARCH_IMX53
	help
	  Say Y here if you are using the Voipac Technologies X53-DMM-668
	  module equipped with a Freescale i.MX53 Processor

config MACH_TX53
	bool "Ka-Ro TX53"
	select ARCH_IMX53
	help
	  Say Y here if you are using the Ka-Ro tx53 board

config MACH_PHYTEC_SOM_IMX6
        bool "Phytec phyCARD-i.MX6 and phyFLEX-i.MX6"
        select ARCH_IMX6
	select ARCH_IMX6UL

config MACH_KONTRON_SAMX6I
        bool "Kontron sAMX6i"
        select ARCH_IMX6

config MACH_DFI_FS700_M60
	bool "DFI i.MX6 FS700 M60 Q7 Board"
	select ARCH_IMX6

config MACH_GUF_SANTARO
	bool "Garz+Fricke Santaro Board"
	select ARCH_IMX6
	select I2C
	select I2C_IMX

config MACH_REALQ7
	bool "DataModul i.MX6Q Real Qseven Board"
	select ARCH_IMX6

config MACH_GK802
	bool "Zealz GK802 Mini PC"
	select ARCH_IMX6

config MACH_ELTEC_HIPERCAM
	bool "ELTEC HiPerCam"
	select ARCH_IMX6

config MACH_TQMA6X
	bool "TQ tqma6x on mba6x"
	select ARCH_IMX6

config MACH_TX6X
	bool "Karo TX6x"
	select ARCH_IMX6
	select I2C
	select I2C_IMX

config MACH_SABRELITE
	bool "Freescale i.MX6 Sabre Lite"
	select ARCH_IMX6

config MACH_SABRESD
	bool "Freescale i.MX6 SabreSD"
	select ARCH_IMX6

config MACH_FREESCALE_IMX6SX_SABRESDB
	bool "Freescale i.MX6sx SabreSDB"
	select ARCH_IMX6SX
	select I2C
	select I2C_IMX

config MACH_NITROGEN6
	bool "BoundaryDevices Nitrogen6 boards"
	select ARCH_IMX6

config MACH_SOLIDRUN_MICROSOM
	bool "SolidRun MicroSOM based devices"
	select ARCH_IMX6

config MACH_TECHNEXION_PICO_HOBBIT
	bool "Technexion Pico Hobbit"
	select ARCH_IMX6
	select ARCH_IMX6UL
	select ARM_USE_COMPRESSED_DTB

config MACH_TECHNEXION_WANDBOARD
	bool "Technexion Wandboard"
	select ARCH_IMX6
	select ARM_USE_COMPRESSED_DTB
	select MCI_IMX_ESDHC_PBL

config MACH_EMBEST_MARSBOARD
	bool "Embest MarSboard"
	select ARCH_IMX6
	select ARM_USE_COMPRESSED_DTB

config MACH_EMBEST_RIOTBOARD
	bool "Embest RIoTboard"
	select ARCH_IMX6

config MACH_UDOO
	bool "Freescale i.MX6 UDOO Board"
	select ARCH_IMX6

config MACH_UDOO_NEO
	bool "i.MX6 UDOO Neo Board (full variant)"
	select ARCH_IMX6SX

config MACH_VARISCITE_MX6
	bool "Variscite i.MX6 Quad SOM"
	select ARCH_IMX6
	select I2C
	select I2C_IMX

config MACH_GW_VENTANA
	bool "Gateworks Ventana SBC"
	select ARCH_IMX6
	select I2C
	select I2C_IMX

config MACH_CM_FX6
	bool "CM FX6"
	select ARCH_IMX6

config MACH_ADVANTECH_ROM_742X
	bool "Advantech ROM 742X"
	select ARCH_IMX6
	select ARM_USE_COMPRESSED_DTB

config MACH_WARP7
	bool "NXP i.MX7: element 14 WaRP7 Board"
	select ARCH_IMX7

config MACH_VF610_TWR
	bool "Freescale VF610 Tower Board"
	select ARCH_VF610

config MACH_ZII_COMMON
	bool

config MACH_ZII_RDU1
	bool "ZII i.MX51 RDU1"
	select ARCH_IMX51
	select MACH_FREESCALE_MX51_PDK_POWER
	select CRC8
	select MACH_ZII_COMMON
	select ARM_USE_COMPRESSED_DTB

config MACH_ZII_RDU2
	bool "ZII i.MX6Q(+) RDU2"
	select ARCH_IMX6
	select MCI_IMX_ESDHC_PBL
	select MACH_ZII_COMMON
	select ARM_USE_COMPRESSED_DTB

config MACH_ZII_IMX8MQ_DEV
	bool "ZII i.MX8MQ based devices"
	select ARCH_IMX8MQ
	select FIRMWARE_IMX_LPDDR4_PMU_TRAIN
	select FIRMWARE_IMX8MQ_ATF
	select ARM_SMCCC
	select MCI_IMX_ESDHC_PBL
	select MACH_ZII_COMMON
	select ARM_USE_COMPRESSED_DTB

config MACH_ZII_VF610_DEV
	bool "ZII VF610 Dev Family"
	select ARCH_VF610
	select CLKDEV_LOOKUP
	select ARM_USE_COMPRESSED_DTB

config MACH_ZII_IMX7D_DEV
	bool "ZII i.MX7D based devices"
	select ARCH_IMX7
	select ARM_USE_COMPRESSED_DTB

config MACH_PHYTEC_PHYCORE_IMX7
	bool "Phytec phyCORE i.MX7"
	select ARCH_IMX7

config MACH_FREESCALE_MX7_SABRESD
	bool "NXP i.MX7 SabreSD Board"
	select ARCH_IMX7
	# Nedded to de-assert reset on Ethernet PHY
	select DRIVER_SPI_GPIO if DRIVER_NET_FEC_IMX
	select GPIO_74164 if DRIVER_NET_FEC_IMX
	help
	  Support for NXP i.MX7 SabreSD board - one of the official
	  i.MX7 evaluation boards from NXP.

	  https://goo.gl/6EKGdk

config MACH_NXP_IMX6ULL_EVK
	bool "NXP i.MX6ull EVK Board"
	select ARCH_IMX6UL

config MACH_NXP_IMX8MQ_EVK
	bool "NXP i.MX8MQ EVK Board"
	select ARCH_IMX8MQ
	select FIRMWARE_IMX_LPDDR4_PMU_TRAIN
	select FIRMWARE_IMX8MQ_ATF
	select ARM_SMCCC
	select MCI_IMX_ESDHC_PBL

config MACH_PHYTEC_SOM_IMX8MQ
	bool "Phytec i.MX8M SOM"
	select ARCH_IMX8MQ
	select FIRMWARE_IMX_LPDDR4_PMU_TRAIN
	select FIRMWARE_IMX8MQ_ATF
	select ARM_SMCCC
	select MCI_IMX_ESDHC_PBL

config MACH_GRINN_LITEBOARD
	bool "Grinn liteboard"
	select ARCH_IMX6UL

config MACH_DIGI_CCIMX6ULSBCPRO
	bool "Digi Internal CC-IMX6UL SBC Pro"
	select ARCH_IMX6
	select ARCH_IMX6UL
	select ARM_USE_COMPRESSED_DTB

endif

# ----------------------------------------------------------

choice
	prompt "Select Board"
	depends on !IMX_MULTI_BOARDS

# ----------------------------------------------------------

comment "i.MX21 Boards"

config MACH_IMX21ADS
	bool "Freescale i.MX21ADS"
	select ARCH_IMX21
	select HAS_CS8900
	help
	  Say Y here if you are using the Freescale i.MX21ads board equipped
	  with a Freescale i.MX21 Processor

# ----------------------------------------------------------

comment "i.MX25 Boards"

config MACH_EUKREA_CPUIMX25
	bool "Eukrea CPUIMX25"
	select ARCH_IMX25
	help
	  Say Y here if you are using the Eukrea Electromatique's CPUIMX25
	  equipped with a Freescale i.MX25 Processor

config MACH_FREESCALE_MX25_3STACK
	bool "Freescale MX25 3stack"
	select ARCH_IMX25
	select I2C
	select MFD_MC34704
	help
	  Say Y here if you are using the Freescale MX25 3stack board equipped
	  with a Freescale i.MX25 Processor

# ----------------------------------------------------------

comment "i.MX27 Boards"

config MACH_EUKREA_CPUIMX27
	bool "EUKREA CPUIMX27"
	select ARCH_IMX27
	help
	  Say Y here if you are using Eukrea's CPUIMX27 equipped
	  with a Freescale i.MX27 Processor

config MACH_IMX27ADS
	bool "Freescale i.MX27ADS"
	select ARCH_IMX27
	help
	  Say Y here if you are using the Freescale i.MX27ads board equipped
	  with a Freescale i.MX27 Processor

config MACH_NESO
	bool "Garz+Fricke Neso"
	select ARCH_IMX27
	help
	  Say Y here if you are using the Garz+Fricke Neso board equipped
	  with a Freescale i.MX27 Processor

# ----------------------------------------------------------

comment "i.MX31 Boards"

config MACH_PCM037
	bool "phyCORE-i.MX31"
	select ARCH_IMX31
	select USB_ULPI if USB
	select ARCH_HAS_L2X0
	help
	  Say Y here if you are using Phytec's phyCORE-i.MX31 (pcm037) equipped
	  with a Freescale i.MX31 Processor

config MACH_MX31MOBOARD
	bool "mx31moboard-i.MX31"
	select ARCH_IMX31
	select USB_ULPI if USB
	select ARCH_HAS_L2X0
	help
	  Say Y here if you are using EPFL mx31moboard board equipped
	  with a Freescale i.MX31 Processor

# ----------------------------------------------------------

comment "i.MX35 Boards"

config MACH_EUKREA_CPUIMX35
	bool "EUKREA CPUIMX35"
	select ARCH_IMX35
	select ARCH_HAS_L2X0
	help
	  Say Y here if you are using Eukrea's CPUIMX35 equipped
	  with a Freescale i.MX35 Processor

config MACH_FREESCALE_MX35_3STACK
	bool "Freescale MX35 3stack"
	select ARCH_IMX35
	select I2C
	select I2C_IMX
	select MFD_MC13XXX
	select MFD_MC9SDZ60
	help
	  Say Y here if you are using the Freescale MX35 3stack board equipped
	  with a Freescale i.MX35 Processor

config MACH_PCM043
	bool "phyCORE-i.MX35"
	select ARCH_IMX35
	select ARCH_HAS_L2X0
	help
	  Say Y here if you are using Phytec's phyCORE-i.MX35 (pcm043) equipped
	  with a Freescale i.MX35 Processor

config MACH_GUF_CUPID
	bool "Garz+Fricke Cupid"
	select ARCH_IMX35
	select ARCH_HAS_L2X0
	help
	  Say Y here if you are using the Garz+Fricke Neso board equipped
	  with a Freescale i.MX35 Processor

config MACH_KINDLE3
	bool "Amazon Kindle3"
	select ARCH_IMX35
	select ARCH_HAS_L2X0
	help
	  Say Y here if you are using the Amazon Model No. D00901 Kindle

# ----------------------------------------------------------

comment "i.MX51 Boards"

config MACH_EUKREA_CPUIMX51SD
	bool "EUKREA CPUIMX51"
	select ARCH_IMX51
	help
	  Say Y here if you are using Eukrea's CPUIMX51 equipped
	  with a Freescale i.MX51 Processor

config MACH_TX51
	bool "Ka-Ro TX51"
	select ARCH_IMX51
	help
	  Say Y here if you are using the Ka-Ro tx51 board

# ----------------------------------------------------------

comment "i.MX53 Boards"

config MACH_FREESCALE_MX53_SMD
	bool "Freescale i.MX53 SMD"
	select ARCH_IMX53

endchoice

# ----------------------------------------------------------

menu "Board specific settings"

if MACH_PCM037

choice
	prompt "SDRAM Bank0"
config PCM037_SDRAM_BANK0_128MB
	bool "128MB"
config PCM037_SDRAM_BANK0_256MB
	bool "256MB"
endchoice

choice
	prompt "SDRAM Bank1"
config PCM037_SDRAM_BANK1_NONE
	bool "none"
config PCM037_SDRAM_BANK1_128MB
	bool "128MB"
config PCM037_SDRAM_BANK1_256MB
	bool "256MB"
endchoice

endif

if MACH_EUKREA_CPUIMX27

choice
	prompt "SDRAM Size"
config EUKREA_CPUIMX27_SDRAM_128MB
	bool "128 MB"
config EUKREA_CPUIMX27_SDRAM_256MB
	bool "256 MB"
endchoice

choice
	prompt "NOR Flash Size"
config EUKREA_CPUIMX27_NOR_32MB
	bool "<= 32 MB"
config EUKREA_CPUIMX27_NOR_64MB
	bool "> 32 MB"
endchoice

choice
	prompt "Quad UART Port"
	depends on DRIVER_SERIAL_NS16550
config EUKREA_CPUIMX27_QUART1
	bool "Q1"
config EUKREA_CPUIMX27_QUART2
	bool "Q2"
config EUKREA_CPUIMX27_QUART3
	bool "Q3"
config EUKREA_CPUIMX27_QUART4
	bool "Q4"
endchoice

endif

if MACH_FREESCALE_MX25_3STACK

choice
	prompt "SDRAM Type"
config FREESCALE_MX25_3STACK_SDRAM_64MB_DDR2
	bool "64 MB (DDR2)"
config FREESCALE_MX25_3STACK_SDRAM_128MB_MDDR
	bool "128 MB (mDDR)"
endchoice

endif

endmenu

menu "i.MX specific settings"

config IMX_IIM
	tristate "IIM fusebox device"
	depends on !ARCH_IMX21
	help
	  Device driver for the IC Identification Module (IIM) fusebox. Use the
	  regular md/mw commands to program and read the fusebox.

	  Fuses are grouped in "rows", 8 bits per row. When using md/mw commands,
	  employ the -b switch and consider the region to be specifying the "Fuse
	  Row Index" rather than "Fuse Row Offset" (which is FRI * 4). You should
	  consult the documentation for your chip for more elaborate description,
	  including the eFuse map, e.g. see AN3682 for i.MX25.

config IMX_IIM_FUSE_BLOW
	bool "IIM fuses blow support"
	depends on IMX_IIM
	help
	  Enable this option to add permanent programming of the fusebox, using
	  fuses blowing.

	  Warning: blown fuses can not be unblown. Using this option may damage
	  your CPU, or make it unbootalbe. Use with care.

	  Before being actually able to blow the fuses, you need to explicitely
	  enable it:
	    imx_iim0.permanent_write_enable=1

config HAB
	bool

config HABV4
	tristate "HABv4 support"
	select HAB
	select NVMEM
	select IMX_OCOTP
	depends on ARCH_IMX6 || ARCH_IMX8MQ
	depends on OFDEVICE
	help
	  High Assurance Boot, as found on i.MX28/i.MX6/i.MX8MQ.

config HAB_CERTS_ENV
	depends on HAB
	bool "Specify certificates in environment"
	help
	  If this option is enabled the pathes to the HAB certificates are
	  taken from environment variables which allows for better integration
	  with build systems. With this option disabled the pathes can be
	  specified below.

	  The environment variables have the same name as the corresponding
	  Kconfig variables. For HABv3 these are:

	  CONFIG_HABV3_SRK_PEM
	  CONFIG_HABV3_CSF_CRT_DER
	  CONFIG_HABV3_IMG_CRT_DER

	  For HABv4:

	  CONFIG_HABV4_TABLE_BIN
	  CONFIG_HABV4_CSF_CRT_PEM
	  CONFIG_HABV4_IMG_CRT_PEM

if HABV4 && !HAB_CERTS_ENV

config HABV4_TABLE_BIN
	string "Path to SRK table"
	default "../crts/SRK_1_2_3_4_table.bin"
	help
	  Path to the Super Root Key (SRK) table, produced by the
	  Freescale Code Signing Tool (cst).

	  This file will be inserted into the Command Sequence File
	  (CSF) when using the CSF template that comes with barebox.

config HABV4_CSF_CRT_PEM
	string "Path to CSF certificate"
	default "../crts/CSF1_1_sha256_4096_65537_v3_usr_crt.pem"
	help
	  Path to the Command Sequence File (CSF) certificate, produced by the
	  Freescale Public Key Infrastructure (PKI) script.

	  This file will be inserted into the Command Sequence File
	  (CSF) when using the CSF template that comes with barebox.

config HABV4_IMG_CRT_PEM
	string "Path to IMG certificate"
	default "../crts/IMG1_1_sha256_4096_65537_v3_usr_crt.pem"
	help
	  Path to the Image certificate, produced by the Freescale
	  Public Key Infrastructure (PKI) script.

	  This file will be inserted into the Command Sequence File
	  (CSF) when using the CSF template that comes with barebox.

endif

config HABV3
	tristate "HABv3 support"
	select HAB
	select IMX_IIM
	select ARCH_IMX_IMXIMAGE_SSL_SUPPORT
	depends on ARCH_IMX25
	help
	  High Assurance Boot, as found on i.MX25.

if HABV3 && !HAB_CERTS_ENV

config HABV3_SRK_PEM
	string "Path to SRK Certificate (PEM)"
	default "../crts/SRK1_sha256_2048_65537_v3_ca_x509_crt.pem"

config HABV3_CSF_CRT_DER
	string "Path to CSF certificate"
	default "../crts/CSF1_1_sha256_2048_65537_v3_ca_crt.der"

config HABV3_IMG_CRT_DER
	string "Path to IMG certificate"
	default "../crts/IMG1_1_sha256_2048_65537_v3_usr_crt.der"

endif

endmenu

endif
```

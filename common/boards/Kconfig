## common/boards/Kconfig
```kconfig
# SPDX-License-Identifier: GPL-2.0-only

config BOARD_HGS
	bool
	select ARCH_IMX_ATF_PASS_BL_PARAMS
	select ARM_SMCCC
	select FIRMWARE_IMX_LPDDR4_PMU_TRAIN
	select I2C_IMX_EARLY
	select IMX8M_DRAM
	select MCI_IMX_ESDHC_PBL
	select MFD_HGS_EFI

config BOARD_QEMU
	bool "Extra support for QEMU-emulated boards" if COMPILE_TEST

config BOARD_QEMU_VIRT
	bool
	select OF_OVERLAY
	select BOARD_QEMU

config BOARD_QEMU_VIRT
	bool
	select OF_OVERLAY

config BOARD_PHYTEC_SOM_DETECTION
	bool

config BOARD_PHYTEC_SOM_IMX8M_DETECTION
	bool
	select BOARD_PHYTEC_SOM_DETECTION

config BOARD_TQ
	select CRC_ITU_T
	bool

config BOARD_WOLFVISION
	bool
	select AIODEV
	select ROCKCHIP_SARADC

config BOARD_LXA
	bool "LXA common board support" if COMPILE_TEST
	select TLV
	select TLV_BAREBOX
```

## common/efi/Kconfig
```kconfig
# SPDX-License-Identifier: GPL-2.0

menu "EFI (Extensible Firmware Interface) Support"

config EFI
	bool

config EFI_GUID
	bool
	help
	  With this option a table of EFI guids is compiled in.

config EFI_DEVICEPATH
	bool

endmenu
```

## common/partitions/Kconfig
```kconfig
# SPDX-License-Identifier: GPL-2.0-only

config PARTITION_DISK
	depends on PARTITION
	depends on BLOCK
	bool "DISK partition support"
	help
	  Add support for handling common partition tables on all kind of disk
	  like devices (harddisks, CF cards, SD cards and so on)

config PARTITION_DISK_DOS
	depends on PARTITION_DISK
	default y
	bool "DOS partition support"
	help
	  Add support to handle partitions in DOS style.

config PARTITION_DISK_EFI
	depends on PARTITION_DISK
	select CRC32
	select PRINTF_UUID
	select PARTITION_DISK_DOS if PARTITION_MANIPULATION
	bool "EFI: GPT partition support"
	help
	  Add support to handle partitions in GUID Partition Table style.

config PARTITION_DISK_EFI_REFRESH
	depends on PARTITION_DISK_EFI
	select PARTITION_MANIPULATION
	bool "refresh GPT partition on demand"
	help
	  The GPT alternative header must be at the end of the device. When disk
	  images are written to a device this often is not the case which results
	  in warnings:

	  GPT:Primary header thinks Alt. header is not at the end of the disk.

	  Enable this option and set global.system.gpt_refresh to true to refresh
	  GPT partition tables when necessary. Only erroneous partition tables will
	  be rewritten, once fixed up partition tables will not be touched.

config PARTITION_DISK_EFI_GPT_NO_FORCE
	depends on PARTITION_DISK_EFI
	default y
	bool "EFI: GPT: force test Protective MBR for validity"
	help
	  This will be added to the EFI Spec. per Intel after v1.02

config PARTITION_DISK_EFI_GPT_COMPARE
	depends on PARTITION_DISK_EFI
	default y
	bool "EFI: GPT: compare primary and Alternate GPT header for validity"
```

## common/ratp/Kconfig
```kconfig
config CONSOLE_RATP
	bool
	select RATP
	select CRC16
	select POLLER
	select CMDLINE_EDITING
	depends on CONSOLE_FULL
	prompt "RATP console support"
	help
	  This option adds support for remote controlling barebox via serial
	  port. The regular console is designed for human interaction whereas
	  this option adds a machine readable interface for controlling barebox.
	  Say yes here if you want to control barebox from a remote host.

config RATP_CMD_I2C
	bool
	depends on RATP
	depends on I2C
	prompt "RATP i2c support"
	help
	  This option adds support for i2c read/write commands via RATP.

config RATP_CMD_GPIO
	bool
	depends on RATP
	depends on GENERIC_GPIO
	prompt "RATP GPIO support"
	help
	  This option adds support for GPIO get/set/direction commands via RATP.
```

## crypto/Kconfig
```kconfig
# SPDX-License-Identifier: GPL-2.0-only

menu "Crypto support"

config CRC32
	bool

config CRC_ITU_T
	bool

config CRC7
	bool

menuconfig DIGEST
	bool "Digest"

if DIGEST

config HAVE_DIGEST_MD5
	bool

config HAVE_DIGEST_SHA1
	bool

config HAVE_DIGEST_SHA224
	bool

config HAVE_DIGEST_SHA256
	bool

config HAVE_DIGEST_SHA384
	bool

config HAVE_DIGEST_SHA512
	bool

config HAVE_DIGEST_HMAC
	bool

config DIGEST_CRC32_GENERIC
	bool "CRC32"
	select CRC32

config DIGEST_MD5_GENERIC
	bool "MD5"
	select HAVE_DIGEST_MD5

config DIGEST_SHA1_GENERIC
	bool "SHA1"
	select HAVE_DIGEST_SHA1

config DIGEST_SHA224_GENERIC
	bool "SHA224"
	select HAVE_DIGEST_SHA224

config DIGEST_SHA256_GENERIC
	bool "SHA256"
	select HAVE_DIGEST_SHA256

config DIGEST_SHA384_GENERIC
	bool "SHA384"
	select HAVE_DIGEST_SHA384

config DIGEST_SHA512_GENERIC
	bool "SHA512"
	select HAVE_DIGEST_SHA512

config DIGEST_HMAC_GENERIC
	bool "HMAC"
	select HAVE_DIGEST_HMAC

config DIGEST_SHA1_ARM
	tristate "SHA1 digest algorithm (ARM-asm)"
	depends on ARM && !CPU_V8
	select HAVE_DIGEST_SHA1
	help
	  SHA-1 secure hash standard (FIPS 180-1/DFIPS 180-2) implemented
	  using optimized ARM assembler.

config DIGEST_SHA256_ARM
	tristate "SHA-224/256 digest algorithm (ARM-asm and NEON)"
	depends on ARM && !CPU_V8
	select HAVE_DIGEST_SHA256
	select HAVE_DIGEST_SHA224
	help
	  SHA-256 secure hash standard (DFIPS 180-2) implemented
	  using optimized ARM assembler and NEON, when available.

config DIGEST_SHA1_ARM64_CE
	tristate "SHA-1 digest algorithm (ARMv8 Crypto Extensions)"
	depends on CPU_V8
	select HAVE_DIGEST_SHA1
	help
	  SHA-1 secure hash algorithm (FIPS 180)

	  Architecture: arm64 using:
	  - ARMv8 Crypto Extensions

config DIGEST_SHA256_ARM64_CE
	tristate "SHA-224/256 digest algorithm (ARMv8 Crypto Extensions)"
	depends on CPU_V8
	select HAVE_DIGEST_SHA256
	select HAVE_DIGEST_SHA224
	help
	  SHA-224 and SHA-256 secure hash algorithms (FIPS 180)

	  Architecture: arm64 using:
	  - ARMv8 Crypto Extensions

endif

config CRYPTO_PBKDF2
	select DIGEST
	select DIGEST_SHA1_GENERIC
	select DIGEST_HMAC_GENERIC
	bool

config CRYPTO_ECC
	bool

config CRYPTO_RSA
	bool "RSA support"
	default y if FITIMAGE_SIGNATURE

config CRYPTO_ECDSA
	bool "ECDSA support"
	select CRYPTO_ECC

config CRYPTO_BUILTIN_KEYS
	bool "builtin keys"
	select KEYTOC
	select IDR

config CRYPTO_PUBLIC_KEYS
	depends on CRYPTO_BUILTIN_KEYS
	string "public keys to compile in"
	help
	  This option should be a space separated list of filenames of public
	  key specifications. While other syntaxes are supported for legacy
	  reasons, each entry should have the format
	  keyring=<keyring>[,fit-hint=<hint>]:<crt>

	  <keyring> specifies the keyring for the key to be included in (e.g.
	  "fit" if this key is to be used for fitimage verification).

	  <fit-hint> is used as a key name hint for fitimage verificaiton to
	  find a key without iterating over all keys.

	  <crt> specifies the path of a public key to be included in barebox.
	  It can be a PEM-formatted file containing an X.509 certificate. If a
	  certificate path starts with "pkcs11:" it is interpreted as a PKCS#11
	  URI rather than a file.

	  Placeholders such as __ENV__VAR_NAME can be used to look up the
	  corresponding value in the environment variable VAR_NAME for public
	  key paths/URIs as well as key name hints.

	  Examples specified directly:

	  - CONFIG_CRYPTO_PUBLIC_KEYS="keyring=fit:pkcs11:object=foo"
	  - CONFIG_CRYPTO_PUBLIC_KEYS="keyring=fit,fit-hint=myhint:pkcs11:object=foo"
	  - CONFIG_CRYPTO_PUBLIC_KEYS="keyring=fit,fit-hint=myhint:pkcs11:object=foo keyring=fit:/foobar/baz.der"
	  - CONFIG_CRYPTO_PUBLIC_KEYS="keyring=fit,fit-hint=myhint:pkcs11:object=foo keyring=fit,fit-hint=myotherhint:/foobar/baz.der"

	  Example specified indirectly by two environment variables:

	  - myhint="myhint"
	  - myname="pkcs11:object=foo" (.der could be used too)
	  - CONFIG_CRYPTO_PUBLIC_KEYS="keyring=fit,fit-hint=__ENV__myhint:__ENV__myname"

	  Example specified indirectly by a single environment variable:

	  - mykey="keyring=fit,fit-hint=myhint:pkcs11:object=foo" (.der could be used too)
	  - CONFIG_CRYPTO_PUBLIC_KEYS="__ENV__mykey"

endmenu
```

## drivers/Kconfig
```kconfig
menu "Drivers"

source "drivers/base/Kconfig"
source "drivers/efi/Kconfig"
source "drivers/of/Kconfig"
source "drivers/aiodev/Kconfig"
source "drivers/amba/Kconfig"
source "drivers/serial/Kconfig"
source "drivers/net/Kconfig"
source "drivers/spi/Kconfig"
source "drivers/i2c/Kconfig"
source "drivers/mtd/Kconfig"
source "drivers/ata/Kconfig"
source "drivers/usb/Kconfig"
source "drivers/video/Kconfig"
source "drivers/mci/Kconfig"
source "drivers/clk/Kconfig"
source "drivers/clocksource/Kconfig"
source "drivers/mfd/Kconfig"
source "drivers/misc/Kconfig"
source "drivers/led/Kconfig"
source "drivers/eeprom/Kconfig"
source "drivers/input/Kconfig"
source "drivers/watchdog/Kconfig"
source "drivers/pwm/Kconfig"
source "drivers/hw_random/Kconfig"
source "drivers/dma/Kconfig"
source "drivers/gpio/Kconfig"
source "drivers/w1/Kconfig"
source "drivers/pinctrl/Kconfig"
source "drivers/nvmem/Kconfig"
source "drivers/bus/Kconfig"
source "drivers/regulator/Kconfig"
source "drivers/remoteproc/Kconfig"
source "drivers/reset/Kconfig"
source "drivers/pci/Kconfig"
source "drivers/rtc/Kconfig"
source "drivers/firmware/Kconfig"
source "drivers/phy/Kconfig"
source "drivers/crypto/Kconfig"
source "drivers/memory/Kconfig"
source "drivers/soc/imx/Kconfig"
source "drivers/nvme/Kconfig"
source "drivers/ddr/Kconfig"

endmenu
```

## drivers/aiodev/Kconfig
```kconfig
# SPDX-License-Identifier: GPL-2.0-only
#
# Misc strange devices
#
menuconfig AIODEV
	bool "Analog I/O drivers"

if AIODEV

config IMX_THERMAL
	tristate "Temperature sensor driver for Freescale i.MX SoCs"
	depends on ARCH_IMX6
	select MFD_SYSCON
	select NVMEM
	select IMX_OCOTP
	help
         Support for Temperature Monitor (TEMPMON) found on Freescale
         i.MX SoCs.

config QORIQ_THERMAL
	tristate "QorIQ Thermal Monitoring Unit"
	depends on ARCH_IMX8MQ || COMPILE_TEST
	help
	  Support for Thermal Monitoring Unit (TMU) found on QorIQ and
	  i.MX8MQ platforms.

config LM75
	tristate "LM75 driver"
	depends on I2C
	help
	  Support for LM75 and similar devices

config ST_GYRO
	tristate "ST L3GD20 SPI gyro driver"
	depends on SPI
	help
	  Support for L3GD20 three-axis angular rate sensor.

config MC13XXX_ADC
	tristate "MC13XXX ADC driver"
	depends on MFD_MC13XXX
	help
	  Support for MC13783, MC13892, MC34708 ADC

config AM335X_ADC
	tristate "AM335X ADC driver"
	depends on ARCH_AM33XX
	help
	  Support for ADC on TI AM335X SoCs.  Supports simple one-shot readings
	  rather than continuous sampling with DMA, etc.  ADC channels should be
	  configured via device tree, using the kernel bindings.

config STM32_ADC
	tristate "STM32 ADC driver"
	depends on ARCH_STM32 || COMPILE_TEST
	help
	  Support for ADC on STM32.  Supports simple one-shot readings
	  rather than continuous sampling with DMA, etc.  ADC channels should be
	  configured via device tree, using the kernel bindings.

config ROCKCHIP_SARADC
	tristate "Rockchip SARADC driver"
	depends on ARCH_RK3568 || ARCH_RK3576 || COMPILE_TEST
	depends on OFDEVICE
	help
	  Support for Successive Approximation Register (SAR) ADC in Rockchip
	  SoCs.

config IMX7D_ADC
	tristate "Freescale IMX7D ADC driver"
	depends on ARCH_IMX7 || COMPILE_TEST
	depends on OFDEVICE
	help
	  Say yes here to build support for IMX7D ADC.

config VF610_ADC
	tristate "Freescale vf610 ADC driver"
	depends on ARCH_IMX6 || COMPILE_TEST
	help
	  Say yes here to support for Vybrid board analog-to-digital converter.
	  Since the IP is used for i.MX6SLX, the driver also support i.MX6SLX.

endif
```

## drivers/amba/Kconfig
```kconfig
# SPDX-License-Identifier: GPL-2.0-only
config ARM_AMBA
	bool

config ARM_AMBA_DABT_MASK
	bool
	prompt "Mask data abort while identifying AMBA devices" if COMPILE_TEST
	depends on ARM_AMBA && ARCH_HAS_DATA_ABORT_MASK
	help
	  Registration of an AMBA device requires reading its pid and cid
	  registers after turning on the device, which can involve enabling
	  clocks, deasserting resets and powering on power domains.
	  In some cases, these resources are not available to barebox running
	  in the normal world and thus need to be setup by a previous
	  stage bootloader running in the secure world.
	  If such setup doesn't happen, accessing devices may lead to
	  a data abort or complete system hang.

	  As a workaround for the former case, this option can be enabled
	  to gracefully handle data aborts during readout of the PID/CID
	  registers. The proper solution is fixing your first stage
	  bootloader or allow barebox access to the missing resources.
```

## drivers/ata/Kconfig
```kconfig
menuconfig DISK
	select BLOCK
	select PARTITION
	select PARTITION_DISK
	bool "Disk support"
	help
	  Add support for disk like drives like harddisks, CDROMs, SD cards and
	  CF cards.

if DISK

config DISK_IDE_SFF
	bool

config DISK_WRITE
	select BLOCK_WRITE
	bool "support writing to disk drives"

source "drivers/block/Kconfig"

comment "drive types"

config DISK_ATA
	bool "ATA type drives"
	help
	  Support for native ATA/IDE drives

config DISK_AHCI
	bool "AHCI support"
	depends on HAS_DMA
	select DISK_ATA

config DISK_AHCI_IMX
	depends on ARCH_IMX
	depends on DISK_AHCI
	bool "i.MX AHCI support"

config DISK_SATA_MV
	depends on ARCH_MVEBU
	select DISK_ATA
	select DISK_IDE_SFF
	bool "Marvell SATA support"

comment "interface types"

config DISK_INTF_PLATFORM_IDE
	bool "Platform IDE"
	select DISK_ATA
	select DISK_IDE_SFF
	help
	  Generic platform driver for simple IDE like interfaces to a connected
	  ATA device.

config DISK_PATA_IMX
	bool "i.MX PATA driver"
	depends on ARCH_IMX
	depends on DISK_INTF_PLATFORM_IDE
	help
	  select this to enable support for the i.MX PATA driver

endif
```

## drivers/base/Kconfig
```kconfig
# SPDX-License-Identifier: GPL-2.0-only

config DEEP_PROBE_DEFAULT
	bool "Probe devices recursively on-demand"
	help
          The barebox 'deep probe' or 'probe on demand' mechanism gets
          rid of the EPROBE_DEFER error code from probes by reordering
          the device population and the driver registration.
          All drivers are registered first and afterwards devices are
          populated. When a device probing requires a resource that's
          not yet available, the device providing that resource is probed
          recursively, hence the probe callstack gets deeper until all
          resources are available.

          This changes the order in which drivers are initialized, which
          can unearth bugs in drivers. Board code that makes use of
          different initcall levels to interleave with driver probes
          will behave differently.

          If unsure and you want to fix implicit assumptions that may
          break your startup, say 'y'.
          If unsure and you want deep probe to only be enabled
          explicitly per top-level machine compatible, say 'n'.

config PM_GENERIC_DOMAINS
	bool

config FEATURE_CONTROLLER
	bool "Feature controller support" if COMPILE_TEST || SANDBOX

config SOC_BUS
	bool

source "drivers/base/regmap/Kconfig"
```

## drivers/base/regmap/Kconfig
```kconfig
# SPDX-License-Identifier: GPL-2.0-only

config REGMAP_FORMATTED
	bool

config REGMAP_I2C
	bool "I2C regmaps" if COMPILE_TEST
	depends on I2C

config REGMAP_SPI
	bool "SPI regmaps" if COMPILE_TEST
	depends on SPI
	select REGMAP_FORMATTED
```

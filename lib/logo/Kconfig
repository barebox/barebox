## lib/logo/Kconfig
```kconfig
# SPDX-License-Identifier: GPL-2.0-only

menuconfig BAREBOX_LOGO
	bool "include barebox logos in build"
	help
	  Say yes here to build the barebox logos. This adds ImageMagick's
	  convert tool to the build dependencies. The logo can be found under
	  /logo/barebox-logo-<width>.<ext> in the running barebox.

if BAREBOX_LOGO

choice
	prompt "Logo image encoding format to be used"
	default BAREBOX_LOGO_PNG

config BAREBOX_LOGO_PNG
	bool "png"
	select PNG
	help
	  Encode logo with the PNG image format

config BAREBOX_LOGO_BMP
	bool "bmp"
	select BMP
	help
	  Encode logo with the BMP image format

config BAREBOX_LOGO_QOI
	bool "qoi"
	select QOI
	select QOICONV
	help
	  Encode logo with the QOI image format

endchoice

config BAREBOX_LOGO_64
	bool "include 64x32 pixel logo"

config BAREBOX_LOGO_240
	bool "include 240x120 pixel logo"

config BAREBOX_LOGO_320
	bool "include 320x160 pixel logo"

config BAREBOX_LOGO_400
	bool "include 400x200 pixel logo"

config BAREBOX_LOGO_640
	bool "include 640x320 pixel logo"

endif # BAREBOX_LOGO
```

## lib/lzo/Kconfig
```kconfig
# SPDX-License-Identifier: GPL-2.0-only

config LZO_DECOMPRESS
	bool "include lzo uncompression support"
	select UNCOMPRESS
```

## net/9p/Kconfig
```kconfig
# SPDX-License-Identifier: GPL-2.0-only
#
# 9P protocol configuration
#

menuconfig NET_9P
	tristate "Plan 9 Resource Sharing Support (9P2000)"
	select NETFS_SUPPORT
	select IDR
	help
	  If you say Y here, you will get experimental support for
	  Plan 9 resource sharing via the 9P2000 protocol.

	  See <http://v9fs.sf.net> for more information.

	  If unsure, say N.

if NET_9P

config NET_9P_VIRTIO
	depends on VIRTIO
	tristate "9P Virtio Transport"
	help
	  This builds support for a transports between
	  guest partitions and a host partition.

config NET_9P_DEBUG
	bool "Debug information"
	help
	  Say Y if you want the 9P subsystem to log debug information.

endif
```

## net/Kconfig
```kconfig
# SPDX-License-Identifier: GPL-2.0-only

menuconfig NET
	bool "Networking Support"
	select POLLER

if NET

config NET_ETHADDR_FROM_MACHINE_ID
	bool
	prompt "generate stable Ethernet address"
	depends on MACHINE_ID && HAVE_DIGEST_SHA256 && HAVE_DIGEST_HMAC
	help
	  By default, barebox will generate random Ethernet addresses for
	  interfaces that had no explicit Ethernet address set via
	  either board code or NVMEM properties in device tree.

	  Say y here, to randomize Ethernet addresses only if no machine ID
	  is available. Should barebox have a machine ID, it will be used
	  alongside the hostname to generate MAC addresses that are unlikely
	  to change between subsequent runs of barebox.

	  This is not recommended for use in production as it may leak
	  information about the machine ID.

config NET_NFS
	bool
	prompt "nfs support"

config NET_NETCONSOLE
	bool
	depends on !CONSOLE_NONE
	prompt "network console support"
	help
	  This option adds support for a simple udp based network console.

config NET_RESOLV
	bool
	prompt "dns support"

config NET_IFUP
	default y
	bool

config NET_DHCP
	bool
	prompt "dhcp support"

config NET_SNTP
	bool
	prompt "sntp support"

config NET_FASTBOOT
	bool
	select BANNER
	select FASTBOOT_BASE
	prompt "Android Fastboot support"
	help
	  This option adds support for the UDP variant of the Fastboot
	  protocol.

endif
```

## pbl/Kconfig
```kconfig
# SPDX-License-Identifier: GPL-2.0-only

config HAVE_PBL_IMAGE
	bool

config HAVE_PBL_MULTI_IMAGES
	bool

config HAVE_IMAGE_COMPRESSION
	bool

config PBL_IMAGE
	bool "Pre-Bootloader image"
	depends on HAVE_PBL_IMAGE

config PBL_MULTI_IMAGES
	bool
	select PBL_IMAGE
	select PBL_RELOCATABLE
	depends on HAVE_PBL_MULTI_IMAGES
	default y

config PBL_SINGLE_IMAGE
	bool
	depends on PBL_IMAGE
	depends on !HAVE_PBL_MULTI_IMAGES
	default y

if PBL_IMAGE

config USE_COMPRESSED_DTB
	bool
	depends on ARM || RISCV
	select LZ4_DECOMPRESS if IMAGE_COMPRESSION_LZ4
	select LZO_DECOMPRESS if IMAGE_COMPRESSION_LZO
	select ZLIB if IMAGE_COMPRESSION_GZIP
	select XZ_DECOMPRESS if IMAGE_COMPRESSION_XZKERN

config PBL_RELOCATABLE
	depends on ARM || MIPS || RISCV
	bool "relocatable pbl image"
	help
	  Generate a pbl binary which can relocate itself during startup to run
	  on different addresses. This is useful if your memory layout is not
	  known during compile time.
	  This option only influences the PBL image. See RELOCATABLE to also make
	  the real image relocatable.

config PBL_VERIFY_PIGGY
	depends on ARM
	bool "Verify barebox proper hash before decompression" if COMPILE_TEST

config BOARD_GENERIC_DT
	bool
	select LIBFDT

config IMAGE_COMPRESSION
	bool
	depends on HAVE_IMAGE_COMPRESSION
	default y

if IMAGE_COMPRESSION

choice
	prompt "Compression"
	default IMAGE_COMPRESSION_LZ4

config IMAGE_COMPRESSION_LZ4
	bool "lz4"

config IMAGE_COMPRESSION_LZO
	bool "lzo"

config IMAGE_COMPRESSION_GZIP
	bool "gzip"

config IMAGE_COMPRESSION_XZKERN
	bool "xz"

config IMAGE_COMPRESSION_NONE
	bool "none"

endchoice

endif

endif
```

## scripts/Kconfig
```kconfig
# SPDX-License-Identifier: GPL-2.0-only

menu "Host Tools"

config COMPILE_HOST_TOOLS
	bool "Allow to enable unused host tools"
	help
	  Usually the needed host tools are selected (or selectable) depending
	  on some config options. If you say yes here, the host tools that are
	  not needed can be selected, too.

	  This is useful for compile coverage testing and for packaging the
	  host tools.

source "scripts/imx/Kconfig"

config SOCFPGA_MKIMAGE
	bool "SoCFPGA mkimage" if COMPILE_HOST_TOOLS
	depends on ARCH_SOCFPGA || COMPILE_HOST_TOOLS
	default y if ARCH_SOCFPGA
	help
	  This enables building the image creation tool for SoCFPGA

config ZYNQ_MKIMAGE
	bool "Zynq mkimage" if COMPILE_HOST_TOOLS
	depends on ARCH_ZYNQ || COMPILE_HOST_TOOLS
	default y if ARCH_ZYNQ
	help
	  This enables building the image creation tool for Zynq

config IMX9_IMAGE
	bool "imx9image"
	depends on ARCH_IMX93 || COMPILE_HOST_TOOLS
	default y if ARCH_IMX93
	help
	  This enables building the image tool for NXP i.MX9 SoCs

config MXS_HOSTTOOLS
	bool "MXS host tools" if COMPILE_HOST_TOOLS
	depends on ARCH_MXS || COMPILE_HOST_TOOLS
	default y if ARCH_MXS
	help
	  This enables building the host tools for Freescale MXS SoCs

config LAYERSCAPE_PBLIMAGE
	bool "Layerscape PBL image tool" if COMPILE_HOST_TOOLS
	depends on ARCH_LAYERSCAPE || COMPILE_HOST_TOOLS
	default y if ARCH_LAYERSCAPE
	help
	  This enables building the PBL image tool for Freescale Layerscape SoCs

config STM32_IMAGE
	bool "STM32MP image tool" if COMPILE_HOST_TOOLS
	depends on ARCH_STM32MP || COMPILE_HOST_TOOLS
	default y if ARCH_STM32MP
	help
	  This enables building the image creation tool for STM32MP SoCs

config RK_IMAGE
	bool "Rockchip image tool" if COMPILE_HOST_TOOLS
	depends on ARCH_ROCKCHIP_V8 || COMPILE_HOST_TOOLS
	default y if ARCH_ROCKCHIP_V8
	help
	  This enables building the image creation tool for Rockchip SoCs

config OMAP_IMAGE
	bool "TI OMAP image tools" if COMPILE_HOST_TOOLS
	depends on ARCH_OMAP || COMPILE_HOST_TOOLS
	default y if ARCH_OMAP
	help
	  This enables building the image creation tools for TI OMAP SoCs

config MVEBU_HOSTTOOLS
	bool "mvebu hosttools" if COMPILE_HOST_TOOLS
	depends on ARCH_MVEBU || COMPILE_HOST_TOOLS
	default y if ARCH_MVEBU
	help
	  This enables building the tools kwbimage to create an image suitable
	  for Marvell mvebu machines and kwboot to boot via UART.

config OMAP3_USB_LOADER
	bool "omap3 USB loader"
	depends on ARCH_OMAP3 || COMPILE_HOST_TOOLS
	help
	  Say Y here to build the omap3 usb loader tool.

	  You need libusb-1.0 to compile this tool.

config OMAP4_HOSTTOOL_USBBOOT
	bool "omap4 usbboot"
	depends on (ARCH_OMAP4 && !MMU) || COMPILE_HOST_TOOLS
	default y if OMAP4_USBBOOT
	help
	  Say Y here to build the omap4 usb loader tool.
	  Note that you need to enable OMAP4_USBBOOT to create an image
	  suitable to boot using this tool.

	  You need libusb-1.0 to compile this tool.

config RK_USB_LOADER
	bool "Rockchip USB loader"
	depends on ARCH_ROCKCHIP || COMPILE_HOST_TOOLS
	help
	  Say Y here to build the rockchip usb loader tool.

	  You need libusb-1.0 to compile this tool.

config QOICONV
	bool "QOI image format conversion" if COMPILE_HOST_TOOLS
	help
	  This enable converting png to qoi images to generate boot logo.

config RSATOC
	bool "RSA to C converter" if COMPILE_HOST_TOOLS
	help
	  This utility converts RSA keys in PEM format to either C or
	  device tree snippets. This requires OpenSSL on the build host
	  and will be selected by the build system if required.

endmenu

menu "Target Tools"

config IMD_TARGET
	bool "build bareboximd target tool"
	depends on IMD

config KERNEL_INSTALL_TARGET
	bool
	prompt "Build kernel-install utility for the target"
	help
	  Enable this to compile the kernel-install script using the cross
	  compiler. The utility for the target will be under
	  scripts/kernel-install-target

config BAREBOXENV_TARGET
	bool
	prompt "build bareboxenv tool for target"
	help
	  'bareboxenv' is a tool to access the barebox environment from a running Linux
	  system. Say yes here to build it for the target.

config BAREBOXCRC32_TARGET
	bool
	prompt "build bareboxcrc32 tool for target"
	help
	  'bareboxcrc32' is a userspacetool to generate the crc32 checksums the same way
	  barebox does. Say yes here to build it for the target.

config HAS_TARGET_LIBUSB_1_0
	def_bool $(success,$(CROSS_PKG_CONFIG) --exists libusb-1.0)
	help
	  Ensure $(CROSS_PKG_CONFIG) is set to a valid pkg-config
	  binary that knows about libusb-1.0 compiled for the
	  target architecture.

config MVEBU_KWBOOT_TARGET
	bool "kwboot target tool"
	help
	  Say Y here to build the kwboot tool for the target
	  to bootstrap over UART.

config ARCH_IMX_USBLOADER_TARGET
	depends on HAS_TARGET_LIBUSB_1_0
	bool "imx-usb-loader for target"
	help
	  Say Y here to build the imx-usb-loader tool for the target.
	  The cross toolchain needs libusb-1.0 to compile this tool.

config OMAP3_USB_LOADER_TARGET
	bool "omap3 USB loader for target"
	depends on HAS_TARGET_LIBUSB_1_0
	help
	  Say Y here to build the omap3 usb loader tool for the target.
	  The cross toolchain needs libusb-1.0 to compile this tool.


config OMAP4_USBBOOT_TARGET
	bool "omap4 usbboot for target"
	depends on HAS_TARGET_LIBUSB_1_0
	help
	  Say Y here to build the omap4 usb loader tool for the target.
	  The cross toolchain needs libusb-1.0 to compile this tool.

config RK_USB_LOADER_TARGET
	bool "Rockchip USB loader for target"
	depends on HAS_TARGET_LIBUSB_1_0
	help
	  Say Y here to build the rockchip usb loader tool for the target.
	  The cross toolchain needs libusb-1.0 to compile this tool.

endmenu
```

## scripts/imx/Kconfig
```kconfig
config ARCH_IMX_USBLOADER
	depends on ARCH_MXS || ARCH_IMX || COMPILE_HOST_TOOLS
	bool "imx-usb-loader"
	help
	  imx-usb-loader is a tool to upload and start imximages to an i.MX SoC
	  in ROM boot mode. It requires libusb, so make sure you have the libusb
	  devel package installed on your machine.
```

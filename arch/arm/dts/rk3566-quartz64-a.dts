// SPDX-License-Identifier: (GPL-2.0+ OR MIT)

/dts-v1/;

#include <arm64/rockchip/rk3566-quartz64-a.dts>
#include "rk356x.dtsi"

/ {
	barebox,disable-deep-probe;

	memory@a00000 {
		device_type = "memory";
		reg = <0x0 0x00a00000 0x0 0x7f600000>;
	};
};

/* SPDX-License-Identifier: GPL-2.0 */
/dts-v1/;
#include <arm/microchip/at91-sama5d3_ksz9477_evb.dts>
#include "sama5d3.dtsi"

/ {
	barebox,disable-deep-probe;

	chosen {
		environment {
			compatible = "barebox,environment";
			device-path = &mmc0, "partname:0";
			file-path = "barebox.env";
		};
	};
};

&reg_vcc_mmc0 {
	status = "disabled";
};

// SPDX-License-Identifier: (GPL-2.0 OR MIT)

#include "vf610-zii-spb4.dtsi"

#include "vf610-zii-dev.dtsi"

/ {
	barebox,disable-deep-probe;

	aliases {
		/*
		* NVMEM device corresponding to EEPROM attached to
		* the switch shared DT node with it, so we use that
		* fact to create a desirable naming
		*/
		switch-eeprom = &switch0;
	};
};

// SPDX-License-Identifier: (GPL-2.0+ OR MIT)

/ {
	aliases {
		gpio0 = &gpio0;
		gpio1 = &gpio1;
		gpio2 = &gpio2;
		gpio3 = &gpio3;
		gpio4 = &gpio4;
	};

	dmc: memory-controller {
		compatible = "rockchip,rk3576-dmc";
		rockchip,pmu = <&pmu1_grf>;
	};
};

&scmi_clk {
	assigned-clocks = <&scmi_clk SCMI_ARMCLK_B>;
	assigned-clock-rates = <816000000>, <816000000>;
};

// SPDX-License-Identifier:     GPL-2.0
/*
 * Copyright (C) 2019-2023 Intel Corporation <www.intel.com>
 */

&soc {
	gmac0: ethernet@10810000 {
		compatible = "intel,socfpga-dwxgmac", "snps,dwxgmac-2.10", "snps,dwxgmac";
		reg = <0x10810000 0x3500>;
		interrupts = <0 190 4>;
		interrupt-names = "macirq";
		resets = <&rst EMAC0_RESET>, <&rst EMAC0_OCP_RESET>;
		reset-names = "stmmaceth", "stmmaceth-ocp";
		tx-fifo-depth = <32768>;
		rx-fifo-depth = <16384>;
		altr,sysmgr-syscon = <&sysmgr 0x44 0>;
		clocks = <&clkmgr AGILEX5_EMAC0_CLK>;
		clock-names = "stmmaceth";
		status = "disabled";
	};

	gmac1: ethernet@10820000 {
		compatible = "intel,socfpga-dwxgmac", "snps,dwxgmac-2.10", "snps,dwxgmac";
		reg = <0x10820000 0x3500>;
		interrupts = <0 207 4>;
		interrupt-names = "macirq";
		resets = <&rst EMAC1_RESET>, <&rst EMAC1_OCP_RESET>;
		reset-names = "stmmaceth", "stmmaceth-ocp";
		tx-fifo-depth = <32768>;
		rx-fifo-depth = <16384>;
		altr,sysmgr-syscon = <&sysmgr 0x48 0>;
		clocks = <&clkmgr AGILEX5_EMAC1_CLK>;
		clock-names = "stmmaceth";
		status = "disabled";
	};

	gmac2: ethernet@10830000 {
		compatible = "intel,socfpga-dwxgmac", "snps,dwxgmac-2.10", "snps,dwxgmac";
		reg = <0x10830000 0x3500>;
		interrupts = <0 224 4>;
		interrupt-names = "macirq";
		resets = <&rst EMAC2_RESET>, <&rst EMAC2_OCP_RESET>;
		reset-names = "stmmaceth", "stmmaceth-ocp";
		tx-fifo-depth = <32768>;
		rx-fifo-depth = <16384>;
		altr,sysmgr-syscon = <&sysmgr 0x4c 0>;
		clocks = <&clkmgr AGILEX5_EMAC2_CLK>;
		clock-names = "stmmaceth";
		status = "disabled";
	};
};

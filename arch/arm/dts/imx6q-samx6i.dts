// SPDX-License-Identifier: GPL-2.0-or-later
/*
 * Copyright 2018 (C) Pengutronix, Michael Grzeschik <mgr@pengutronix.de>
 */

/dts-v1/;
#include <arm/imx6q.dtsi>
#include "imx6q.dtsi"
#include "imx6qdl-smarc-samx6i.dtsi"

/ {
	model = "Kontron sAMX6i";
	compatible = "kontron,imx6q-samx6i", "fsl,imx6q";
};
